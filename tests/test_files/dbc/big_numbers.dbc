/*
 * The MIT License (MIT)
 *
 * Copyright (c) 2015-2019 Erik Moqvist
 *
 * Permission is hereby granted, free of charge, to any person obtaining a copy
 * of this software and associated documentation files (the "Software"), to deal
 * in the Software without restriction, including without limitation the rights
 * to use, copy, modify, merge, publish, distribute, sublicense, and/or sell
 * copies of the Software, and to permit persons to whom the Software is
 * furnished to do so, subject to the following conditions:
 *
 * The above copyright notice and this permission notice shall be included in all
 * copies or substantial portions of the Software.
 *
 * THE SOFTWARE IS PROVIDED "AS IS", WITHOUT WARRANTY OF ANY KIND, EXPRESS OR
 * IMPLIED, INCLUDING BUT NOT LIMITED TO THE WARRANTIES OF MERCHANTABILITY,
 * FITNESS FOR A PARTICULAR PURPOSE AND NONINFRINGEMENT. IN NO EVENT SHALL THE
 * AUTHORS OR COPYRIGHT HOLDERS BE LIABLE FOR ANY CLAIM, DAMAGES OR OTHER
 * LIABILITY, WHETHER IN AN ACTION OF CONTRACT, TORT OR OTHERWISE, ARISING FROM,
 * OUT OF OR IN CONNECTION WITH THE SOFTWARE OR THE USE OR OTHER DEALINGS IN THE
 * SOFTWARE.
 */

VERSION ""

NS_ :

BS_:

BU_: TheNode

BO_ 2147483705 TheMessage: 8 Vector__XXX
 SG_ TheSignal : 0|8@1- (1,0) [0|0] "" Vector__XXX

BO_ 42 TheOtherMessage: 8 Vector__XXX
 SG_ TheSignal : 0|8@1- (1,0) [0|0] "" Vector__XXX

CM_ BU_ TheNode "TheNodeComment";
BA_DEF_ SG_  "TheSignalStringAttribute" STRING ;
BA_DEF_  "TheNetworkAttribute" INT 0 100;
BA_DEF_ BO_  "TheHexAttribute" HEX 0 8;
BA_DEF_ BO_  "TheFloatAttribute" FLOAT 5 87;
BA_DEF_ BU_  "TheNodeAttribute" INT -922337203685478 184467440737096;
BA_DEF_ BU_  "NodeLayerModules" STRING ;
BA_DEF_ BO_  "GenMsgILSupport" ENUM  "No","Yes";
BA_DEF_  "NmBaseAddress" HEX 1024 1087;
BA_DEF_  "BusType" STRING ;
BA_DEF_ BO_  "GenMsgCycleTime" INT 0 50000;
BA_DEF_ BO_  "GenMsgSendType" ENUM  "Cyclic","NotUsed","NotUsed","NotUsed","NotUsed","NotUsed","NotUsed","IfActive","NoMsgSendType","NotUsed","vector_leerstring";
BA_DEF_ SG_  "GenSigSendType" ENUM  "Cyclic","OnWrite","OnWriteWithRepetition","OnChange","OnChangeWithRepetition","IfActive","IfActiveWithRepetition","NoSigSendType","NotUsed","NotUsed","NotUsed","NotUsed","NotUsed";
BA_DEF_DEF_  "TheSignalStringAttribute" "100";
BA_DEF_DEF_  "TheNetworkAttribute" 50;
BA_DEF_DEF_  "TheHexAttribute" 4;
BA_DEF_DEF_  "TheFloatAttribute" 55;
BA_DEF_DEF_  "TheNodeAttribute" 100;
BA_DEF_DEF_  "NodeLayerModules" "CANoeILNLVector.dll";
BA_DEF_DEF_  "GenMsgILSupport" "Yes";
BA_DEF_DEF_  "NmBaseAddress" 1024;
BA_DEF_DEF_  "BusType" "";
BA_DEF_DEF_  "GenMsgCycleTime" 0;
BA_DEF_DEF_  "GenMsgSendType" "NoMsgSendType";
BA_DEF_DEF_  "GenSigSendType" "Cyclic";
BA_ "TheNetworkAttribute" 51;
BA_ "BusType" "CAN";
BA_ "TheNodeAttribute" BU_ TheNode 99;
BA_ "TheFloatAttribute" BO_ 2147483705 58.7;
BA_ "TheHexAttribute" BO_ 2147483705 5;
BA_ "GenMsgSendType" BO_ 2147483705 0;
BA_ "GenMsgCycleTime" BO_ 2147483705 1000;
BA_ "TheSignalStringAttribute" SG_ 2147483705 TheSignal "TestString";
BA_ "GenSigSendType" SG_ 2147483705 TheSignal 1;
BA_ "GenSigSendType" SG_ 42 TheSignal 1;
