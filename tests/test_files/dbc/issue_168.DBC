/*
 * The MIT License (MIT)
 *
 * Copyright (c) 2015-2019 Erik Moqvist
 *
 * Permission is hereby granted, free of charge, to any person obtaining a copy
 * of this software and associated documentation files (the "Software"), to deal
 * in the Software without restriction, including without limitation the rights
 * to use, copy, modify, merge, publish, distribute, sublicense, and/or sell
 * copies of the Software, and to permit persons to whom the Software is
 * furnished to do so, subject to the following conditions:
 *
 * The above copyright notice and this permission notice shall be included in all
 * copies or substantial portions of the Software.
 *
 * THE SOFTWARE IS PROVIDED "AS IS", WITHOUT WARRANTY OF ANY KIND, EXPRESS OR
 * IMPLIED, INCLUDING BUT NOT LIMITED TO THE WARRANTIES OF MERCHANTABILITY,
 * FITNESS FOR A PARTICULAR PURPOSE AND NONINFRINGEMENT. IN NO EVENT SHALL THE
 * AUTHORS OR COPYRIGHT HOLDERS BE LIABLE FOR ANY CLAIM, DAMAGES OR OTHER
 * LIABILITY, WHETHER IN AN ACTION OF CONTRACT, TORT OR OTHERWISE, ARISING FROM,
 * OUT OF OR IN CONNECTION WITH THE SOFTWARE OR THE USE OR OTHER DEALINGS IN THE
 * SOFTWARE.
 */

// A comment.

VERSION "2.0" // Another comment.

NS_ :

BS_:

BU_: FOO BAR FIE FUM
VAL_TABLE_ State 1 "Enabled" 0 "Disabled" ;

BO_ 2147558192 Foo: 8 FOO
 SG_ Foo : 0|12@0- (0.01,250) [229.53|270.47] "degK"  BAR
 SG_ Bar : 24|32@0- (0.1,0) [0|5] "m"  FOO

BO_ 2147558193 Fum: 5 FOO
 SG_ Fum : 0|12@1- (1,0) [0|10] ""  BAR
 SG_ Fam : 12|12@1- (1,0) [0|8] ""  BAR

BO_ 2147558194 Bar: 4 FOO
 SG_ Binary32 : 0|32@1- (1,0) [0|0] ""  FUM

BO_ 2147558195 CanFd: 64 FOO
 SG_ Fie : 0|64@1+ (1,0) [0|0] ""  FUM
 SG_ Fas : 64|64@1+ (1,0) [0|0] "" Vector__XXX

BO_ 780 FOOBAR: 8 FIE
 SG_ ACC_02_CRC : 0|12@1- (1,0) [0|1] ""  BAR

BO_TX_BU_ 2147558194 : FOO,BAR;

CM_ BU_ BAR "fam \"1\"";
CM_ BO_ 2147558192 "Foo.";
CM_ SG_ 2147558192 Bar "Bar.";
BA_DEF_  "DBName" STRING ;
BA_DEF_  "Baudrate" INT 0 1000000;
BA_DEF_  "AFloat" FLOAT 0 100;
BA_DEF_  "BusType" STRING ;
BA_DEF_ BU_  "FOO" INT 0 100;
BA_DEF_ BU_  "BAR" STRING ;
BA_DEF_ BO_  "VFrameFormat" ENUM  "StandardCAN","ExtendedCAN","reserved","reserved","reserved","reserved","reserved","reserved","reserved","reserved","reserved","reserved","reserved","reserved","StandardCAN_FD","ExtendedCAN_FD";
BA_DEF_ BO_  "GenMsgCycleTime" INT 0 1000;
BA_DEF_REL_ BU_SG_REL_  "AFloat2" FLOAT 0 65535;
BA_DEF_REL_ BU_SG_REL_  "GenSigTimeoutTime" INT 0 65535;
BA_DEF_DEF_  "DBName" "";
BA_DEF_DEF_  "Baudrate" 125000;
BA_DEF_DEF_  "AFloat" 0;
BA_DEF_DEF_  "BusType" "";
BA_DEF_DEF_  "FOO" 0;
BA_DEF_DEF_  "BAR" "";
BA_DEF_DEF_  "VFrameFormat" "ExtendedCAN_FD";
BA_DEF_DEF_  "GenMsgCycleTime" 100;
BA_DEF_DEF_REL_ "AFloat2" 0;
BA_DEF_DEF_REL_ "GenSigTimeoutTime" 0;
BA_ "DBName" "TheBusName";
BA_ "AFloat" 33.5;
BA_ "BusType" "CAN FD";
BA_ "BAR" BU_ FIE "FUM";
BA_ "FOO" BU_ FIE 1;
BA_ "VFrameFormat" BO_ 2147558192 1;
BA_ "VFrameFormat" BO_ 2147558193 1;
BA_ "GenMsgCycleTime" BO_ 2147558193 1;
BA_ "VFrameFormat" BO_ 2147558194 1;
BA_ "VFrameFormat" BO_ 780 0;
BA_REL_ "GenSigTimeoutTime" BU_SG_REL_ FOO SG_ 2147558192 Bar 200;
BA_REL_ "AFloat2" BU_SG_REL_ FOO SG_ 2147558192 Bar 500;
VAL_ 2147558193 Fam 1 "Enabled" 0 "Disabled" ;
SIG_GROUP_ 2147558193 SigGroupName 1 : Fam Fum;
SIG_VALTYPE_ 2147558192 Bar : 1;
SIG_VALTYPE_ 2147558194 Binary32 : 1;
