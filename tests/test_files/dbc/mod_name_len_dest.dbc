VERSION ""

NS_ :

BS_:

BU_: node_now_short

BO_ 1 msg_now_short: 8 node_now_short
 SG_ sig_now_short : 1|8@1+ (1,0) [0|0] "" Vector__XXX
