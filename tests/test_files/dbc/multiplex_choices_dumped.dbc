/*
 * The MIT License (MIT)
 *
 * Copyright (c) 2015-2019 Erik Moqvist
 *
 * Permission is hereby granted, free of charge, to any person obtaining a copy
 * of this software and associated documentation files (the "Software"), to deal
 * in the Software without restriction, including without limitation the rights
 * to use, copy, modify, merge, publish, distribute, sublicense, and/or sell
 * copies of the Software, and to permit persons to whom the Software is
 * furnished to do so, subject to the following conditions:
 *
 * The above copyright notice and this permission notice shall be included in all
 * copies or substantial portions of the Software.
 *
 * THE SOFTWARE IS PROVIDED "AS IS", WITHOUT WARRANTY OF ANY KIND, EXPRESS OR
 * IMPLIED, INCLUDING BUT NOT LIMITED TO THE WARRANTIES OF MERCHANTABILITY,
 * FITNESS FOR A PARTICULAR PURPOSE AND NONINFRINGEMENT. IN NO EVENT SHALL THE
 * AUTHORS OR COPYRIGHT HOLDERS BE LIABLE FOR ANY CLAIM, DAMAGES OR OTHER
 * LIABILITY, WHETHER IN AN ACTION OF CONTRACT, TORT OR OTHERWISE, ARISING FROM,
 * OUT OF OR IN CONNECTION WITH THE SOFTWARE OR THE USE OR OTHER DEALINGS IN THE
 * SOFTWARE.
 */

VERSION ""

NS_ :

BS_:

BU_:

BO_ 2148676694 Message1: 8 Vector__XXX
 SG_ BIT_F m24 : 39|1@1+ (1,0) [0|0] "" Vector__XXX
 SG_ BIT_H m24 : 38|1@1+ (1,0) [0|0] "" Vector__XXX
 SG_ BIT_B m24 : 33|1@1+ (1,0) [0|0] "" Vector__XXX
 SG_ BIT_D m24 : 32|1@1+ (1,0) [0|0] "" Vector__XXX
 SG_ BIT_E m24 : 29|1@1+ (1,0) [0|0] "" Vector__XXX
 SG_ BIT_K m24 : 28|1@1+ (1,0) [0|0] "" Vector__XXX
 SG_ BIT_A m24 : 26|1@1+ (1,0) [0|0] "" Vector__XXX
 SG_ BIT_L m8 : 24|1@1+ (1,0) [0|0] "" Vector__XXX
 SG_ BIT_G m8 : 23|1@1+ (1,0) [0|0] "" Vector__XXX
 SG_ BIT_C m8 : 19|1@1+ (1,0) [0|0] "" Vector__XXX
 SG_ BIT_J m8 : 18|1@1+ (1,0) [0|0] "" Vector__XXX
 SG_ Multiplexor M : 2|6@1+ (1,0) [0|0] "" Vector__XXX

BO_ 2148676695 Message2: 8 Vector__XXX
 SG_ BIT_F m24 : 39|1@1+ (1,0) [0|0] "" Vector__XXX
 SG_ BIT_H m24 : 38|1@1+ (1,0) [0|0] "" Vector__XXX
 SG_ BIT_B m24 : 33|1@1+ (1,0) [0|0] "" Vector__XXX
 SG_ BIT_D m24 : 32|1@1+ (1,0) [0|0] "" Vector__XXX
 SG_ BIT_E m24 : 29|1@1+ (1,0) [0|0] "" Vector__XXX
 SG_ BIT_K m24 : 28|1@1+ (1,0) [0|0] "" Vector__XXX
 SG_ BIT_A m24 : 26|1@1+ (1,0) [0|0] "" Vector__XXX
 SG_ BIT_L m8 : 24|1@1+ (1,0) [0|0] "" Vector__XXX
 SG_ BIT_G m8 : 23|1@1+ (1,0) [0|0] "" Vector__XXX
 SG_ BIT_C m8 : 19|1@1+ (1,0) [0|0] "" Vector__XXX
 SG_ BIT_J m8 : 18|1@1+ (1,0) [0|0] "" Vector__XXX
 SG_ Multiplexor M : 2|6@1+ (1,0) [0|0] "" Vector__XXX

BO_ 2148676696 Message3: 8 Vector__XXX
 SG_ BIT_L m8 : 24|1@1+ (1,0) [0|0] "" Vector__XXX
 SG_ BIT_G m8 : 23|1@1+ (1,0) [0|0] "" Vector__XXX
 SG_ BIT_C m8 : 19|1@1+ (1,0) [0|0] "" Vector__XXX
 SG_ BIT_J m8 : 18|1@1+ (1,0) [0|0] "" Vector__XXX
 SG_ Multiplexor M : 2|6@1+ (1,0) [0|0] "" Vector__XXX

CM_ SG_ 2148676694 Multiplexor "Defines data content for response messages.";
BA_DEF_ BO_  "VFrameFormat" ENUM  "StandardCAN","ExtendedCAN","reserved","J1939PG";
BA_DEF_ SG_  "GenSigSendType" ENUM  "Cyclic","OnWrite","OnWriteWithRepetition","OnChange","OnChangeWithRepetition","IfActive","IfActiveWithRepetition","NoSigSendType";
BA_DEF_ BO_  "GenMsgSendType" ENUM  "Cyclic","not_used","not_used","not_used","not_used","Cyclic","not_used","IfActive","NoMsgSendType";
BA_DEF_  "DBName" STRING ;
BA_DEF_  "BusType" STRING ;
BA_DEF_DEF_  "VFrameFormat" "J1939PG";
BA_DEF_DEF_  "GenSigSendType" "Cyclic";
BA_DEF_DEF_  "GenMsgSendType" "NoMsgSendType";
BA_DEF_DEF_  "DBName" "";
BA_DEF_DEF_  "BusType" "CAN";
BA_ "DBName" "Network_A";
VAL_ 2148676694 BIT_L 0 "Off" 1 "On" ;
VAL_ 2148676694 Multiplexor 8 "MULTIPLEXOR_8" 16 "MULTIPLEXOR_16" 24 "MULTIPLEXOR_24" ;
VAL_ 2148676695 Multiplexor 4 "MULTIPLEXOR_4_NO_SIGNALS" 8 "MULTIPLEXOR_8" 16 "MULTIPLEXOR_16" 24 "MULTIPLEXOR_24" ;

SG_MUL_VAL_ 2148676694 BIT_J Multiplexor 8-8, 16-16, 24-24;
SG_MUL_VAL_ 2148676694 BIT_C Multiplexor 8-8, 16-16, 24-24;
SG_MUL_VAL_ 2148676694 BIT_G Multiplexor 8-8, 16-16, 24-24;
SG_MUL_VAL_ 2148676694 BIT_L Multiplexor 8-8, 16-16, 24-24;
SG_MUL_VAL_ 2148676694 BIT_A Multiplexor 24-24;
SG_MUL_VAL_ 2148676694 BIT_K Multiplexor 24-24;
SG_MUL_VAL_ 2148676694 BIT_E Multiplexor 24-24;
SG_MUL_VAL_ 2148676694 BIT_D Multiplexor 24-24;
SG_MUL_VAL_ 2148676694 BIT_B Multiplexor 24-24;
SG_MUL_VAL_ 2148676694 BIT_H Multiplexor 24-24;
SG_MUL_VAL_ 2148676694 BIT_F Multiplexor 24-24;
SG_MUL_VAL_ 2148676695 BIT_J Multiplexor 8-8, 16-16, 24-24;
SG_MUL_VAL_ 2148676695 BIT_C Multiplexor 8-8, 16-16, 24-24;
SG_MUL_VAL_ 2148676695 BIT_G Multiplexor 8-8, 16-16, 24-24;
SG_MUL_VAL_ 2148676695 BIT_L Multiplexor 8-8, 16-16, 24-24;
SG_MUL_VAL_ 2148676695 BIT_A Multiplexor 24-24;
SG_MUL_VAL_ 2148676695 BIT_K Multiplexor 24-24;
SG_MUL_VAL_ 2148676695 BIT_E Multiplexor 24-24;
SG_MUL_VAL_ 2148676695 BIT_D Multiplexor 24-24;
SG_MUL_VAL_ 2148676695 BIT_B Multiplexor 24-24;
SG_MUL_VAL_ 2148676695 BIT_H Multiplexor 24-24;
SG_MUL_VAL_ 2148676695 BIT_F Multiplexor 24-24;
SG_MUL_VAL_ 2148676696 BIT_J Multiplexor 8-8;
SG_MUL_VAL_ 2148676696 BIT_C Multiplexor 8-8;
SG_MUL_VAL_ 2148676696 BIT_G Multiplexor 8-8;
SG_MUL_VAL_ 2148676696 BIT_L Multiplexor 8-8;
