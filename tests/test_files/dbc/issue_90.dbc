VERSION "Created by canmatrix and CSS Electronics (www.csselectronics.com)"

NS_ :

BS_:

BU_:

BO_ 0 Msg0: 8 Vector__XXX
 SG_ MuxedSig0 m0 : 0|32@1+ (1,0) [0|4294967295] "" Vector__XXX
 SG_ MuxedSig1 m1 : 0|32@1+ (1,0) [0|4294967295] "" Vector__XXX
 SG_ MuxedSig2 m2 : 0|32@1+ (1,0) [0|65535] "" Vector__XXX
 SG_ MuxedSig3 m3 : 0|32@1+ (1,0) [0|65535] "" Vector__XXX
 SG_ MuxSig0 m1M : 46|1@1+ (1,0) [0|255] "" Vector__XXX
 SG_ MuxSig1 m2M : 46|1@1+ (1,0) [0|255] "" Vector__XXX
 SG_ Mux M : 47|1@1+ (1,0) [0|15] "" Vector__XXX
 SG_ response : 48|8@1+ (1,0) [0|15] "" Vector__XXX
 SG_ length : 56|8@1+ (1,0) [0|255] "" Vector__XXX

SG_MUL_VAL_ 0 MuxedSig0 MuxSig0 0-0;
SG_MUL_VAL_ 0 MuxedSig1 MuxSig0 1-1;
SG_MUL_VAL_ 0 MuxedSig2 MuxSig1 0-0;
SG_MUL_VAL_ 0 MuxedSig3 MuxSig1 1-1;
SG_MUL_VAL_ 0 MuxSig0 Mux 0-0;
SG_MUL_VAL_ 0 MuxSig1 Mux 1-1;
