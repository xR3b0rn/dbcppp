VERSION ""

NS_ :

BS_:

BU_: Node_will_be_shortened_456789_12

BO_ 1 Msg_will_be_shortened_3456789_12: 8 Node_will_be_shortened_456789_12
 SG_ Sig_will_be_shortened_3456789_12 : 1|8@1+ (1,0) [0|0] "" Vector__XXX

BA_DEF_ BU_  "SystemNodeLongSymbol" STRING ;
BA_DEF_ BO_  "SystemMessageLongSymbol" STRING ;
BA_DEF_ SG_  "SystemSignalLongSymbol" STRING ;
BA_DEF_DEF_  "SystemNodeLongSymbol" "";
BA_DEF_DEF_  "SystemMessageLongSymbol" "";
BA_DEF_DEF_  "SystemSignalLongSymbol" "";
BA_ "SystemNodeLongSymbol" BU_ Node_will_be_shortened_456789_12 "Node_will_be_shortened_456789_12ZZZZ";
BA_ "SystemMessageLongSymbol" BO_ 1 "Msg_will_be_shortened_3456789_12YYYY";
BA_ "SystemSignalLongSymbol" SG_ 1 Sig_will_be_shortened_3456789_12 "Sig_will_be_shortened_3456789_12XXXX";
