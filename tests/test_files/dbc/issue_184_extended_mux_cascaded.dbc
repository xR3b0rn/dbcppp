VERSION ""

NS_ :

BS_:

BU_:

BO_ 2147483649 ext_MUX_cascaded: 8 Vector__XXX
 SG_ muxed_B_1 m1 : 24|8@1- (1,0) [0|0] "" Vector__XXX
 SG_ muxed_B_0 m0 : 16|8@1- (1,0) [0|0] "" Vector__XXX
 SG_ muxed_A_2_MUX_B m2M : 8|8@1- (1,0) [0|0] "" Vector__XXX
 SG_ muxed_A_1 m1 : 8|8@1- (1,0) [0|0] "" Vector__XXX
 SG_ MUX_A M : 0|8@1- (1,0) [0|0] "" Vector__XXX
 SG_ muxed_A_2_MUX_B_MUX_C m2M : 32|8@1- (1,0) [0|0] "" Vector__XXX
 SG_ muxed_C_0 m0 : 40|8@1- (1,0) [0|0] "" Vector__XXX
 SG_ muxed_C_1 m1 : 40|8@1- (1,0) [0|0] "" Vector__XXX

BA_DEF_ SG_  "SigType" ENUM  "Default","Range","RangeSigned","ASCII","Discrete","Control","ReferencePGN","DTC","StringDelimiter","StringLength","StringLengthControl";
BA_DEF_ SG_  "GenSigEVName" STRING ;
BA_DEF_ SG_  "GenSigILSupport" ENUM  "No","Yes";
BA_DEF_ SG_  "GenSigSendType" ENUM  "Cyclic","OnWrite","OnWriteWithRepetition","OnChange","OnChangeWithRepetition","IfActive","IfActiveWithRepetition","NoSigSendType";
BA_DEF_ BO_  "GenMsgILSupport" ENUM  "No","Yes";
BA_DEF_ BU_  "NmStationAddress" INT 0 255;
BA_DEF_ BO_  "GenMsgSendType" ENUM  "cyclic","NotUsed","IfActive","NotUsed","NotUsed","NotUsed","NotUsed","NotUsed","noMsgSendType";
BA_DEF_ BO_  "GenMsgRequestable" INT 0 1;
BA_DEF_  "DBName" STRING ;
BA_DEF_  "BusType" STRING ;
BA_DEF_  "ProtocolType" STRING ;
BA_DEF_ BO_  "VFrameFormat" ENUM  "StandardCAN","ExtendedCAN","reserved","J1939PG";
BA_DEF_DEF_  "SigType" "Default";
BA_DEF_DEF_  "GenSigEVName" "Env@Nodename_@Signame";
BA_DEF_DEF_  "GenSigILSupport" "Yes";
BA_DEF_DEF_  "GenSigSendType" "NoSigSendType";
BA_DEF_DEF_  "GenMsgILSupport" "Yes";
BA_DEF_DEF_  "NmStationAddress" 254;
BA_DEF_DEF_  "GenMsgSendType" "noMsgSendType";
BA_DEF_DEF_  "GenMsgRequestable" 1;
BA_DEF_DEF_  "DBName" "";
BA_DEF_DEF_  "BusType" "CAN";
BA_DEF_DEF_  "ProtocolType" "J1939";
BA_DEF_DEF_  "VFrameFormat" "J1939PG";
BA_ "DBName" "ext_MUX_multiple_values";
BA_ "VFrameFormat" BO_ 2147483649 1;

SG_MUL_VAL_ 2147483649 muxed_B_1 muxed_A_2_MUX_B 1-1;
SG_MUL_VAL_ 2147483649 muxed_B_0 muxed_A_2_MUX_B 0-0;
SG_MUL_VAL_ 2147483649 muxed_A_2_MUX_B MUX_A 2-2;
SG_MUL_VAL_ 2147483649 muxed_A_1 MUX_A 1-1;
SG_MUL_VAL_ 2147483649 muxed_A_2_MUX_B_MUX_C muxed_A_2_MUX_B 2-2;
SG_MUL_VAL_ 2147483649 muxed_C_0 muxed_A_2_MUX_B_MUX_C 0-0;
SG_MUL_VAL_ 2147483649 muxed_C_1 muxed_A_2_MUX_B_MUX_C 1-1;
