VERSION ""

NS_ :

BS_:

BU_:
VAL_TABLE_ Bar 6 "reserved" 5 "reserved" 4 "unused 2" 3 "unused" 2 "unused" 1 "#%=*ä'" 0 "With space" -5 "A negative value" ;

BO_ 0 Foo: 8 Vector__XXX
 SG_ Foo : 0|8@1- (1,0) [-128|127] "" Vector__XXX

VAL_ 0 Foo 6 "reserved" 5 "reserved" 4 "unused 2" 3 "unused" 2 "unused" 1 "#%=*ä'" 0 "With space" -5 "A negative value" ;
