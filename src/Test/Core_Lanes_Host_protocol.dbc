VERSION "4"
//SharepointID=RNDSITE-1050793592-3471

NS_ :

BS_:

BU_: EyeQ4 MCU

//SharepointID=RNDSITE-1050793592-3471

BO_ 142 Core_Lanes_Host_protocol: 136 EyeQ4
 SG_ LH_Zero_byte : 0|8@1+ (1,0) [0|255] "NA" MCU
 SG_ LH_Protocol_Version : 8|8@1+ (1,0) [4|4] "counter" MCU
 SG_ LH_Sync_ID : 16|8@1+ (1,0) [0|255] "counter" MCU
 SG_ LH_Lanes_Count : 24|3@1+ (1,0) [0|2] "counter" MCU
 SG_ Reserved_1 : 27|5@1+ (1,0) [0|0] "NA" MCU
 SG_ LH_Estimated_Width : 32|10@1+ (0.01,0) [0|10] "m" MCU
 SG_ LH_Header_Buffer : 42|22@1+ (1,0) [0|0] "NA" MCU
 SG_ LH_CRC_0 : 64|32@1+ (1,0) [0|4294967295] "NA" MCU
 SG_ LH_Is_Triggered_SDM_Type_0 : 96|2@1+ (1,0) [0|2] "ENUM" MCU
 SG_ LH_Is_Triggered_SDM_Model_0 : 98|2@1+ (1,0) [0|2] "ENUM" MCU
 SG_ LH_Track_ID_0 : 100|8@1+ (1,0) [0|255] "counter" MCU
 SG_ LH_Age_0 : 108|8@1+ (1,0) [0|255] "frames" MCU
 SG_ LH_Existence_Probability_0 : 116|7@1+ (0.01,0) [0|1] "NA" MCU
 SG_ Reserved_2_0 : 123|5@1+ (1,0) [0|0] "NA" MCU
 SG_ LH_Prediction_Source_0 : 128|6@1+ (1,0) [0|63] "BITWIZE" MCU
 SG_ LH_Prediction_Type_0 : 134|2@1+ (1,0) [0|3] "BITWIZE" MCU
 SG_ LH_Color_0 : 136|2@1+ (1,0) [0|3] "ENUM" MCU
 SG_ LH_Color_Confidence_0 : 138|7@1+ (0.01,0) [0|1] "NA" MCU
 SG_ LH_Lanemark_Type_0 : 145|4@1+ (1,0) [0|6] "ENUM" MCU
 SG_ LH_DLM_Type_0 : 149|3@1+ (1,0) [0|5] "ENUM" MCU
 SG_ LH_DECEL_Type_0 : 152|3@1+ (1,0) [0|5] "ENUM" MCU
 SG_ Reserved_3_0 : 155|5@1+ (1,0) [0|0] "NA" MCU
 SG_ LH_Lanemark_Type_Conf_0 : 160|7@1+ (0.01,0) [0|1] "NA" MCU
 SG_ LH_Side_0 : 167|2@1+ (1,0) [0|2] "ENUM" MCU
 SG_ LH_Crossing_0 : 169|1@1+ (1,0) [0|1] "bool" MCU
 SG_ LH_Marker_Width_0 : 170|8@1+ (0.01,0) [0|0.7] "m" MCU
 SG_ LH_Marker_Width_STD_0 : 178|7@1+ (0.005,0) [0|0.5] "m" MCU
 SG_ Reserved_4_0 : 185|7@1+ (1,0) [0|0] "NA" MCU
 SG_ LH_Dash_Average_Length_0 : 192|8@1+ (0.01,0) [0|2] "m" MCU
 SG_ LH_Dash_Average_Gap_0 : 200|8@1+ (0.01,0) [0|2] "m" MCU
 SG_ LH_Is_Multi_Clothoid_0 : 208|1@1+ (1,0) [0|1] "bool" MCU
 SG_ Reserved_5_0 : 209|15@1+ (1,0) [0|0] "NA" MCU
 SG_ LH_Line_First_C0_0 : 224|32@1- (1,0) [-30|30] "m" MCU
 SG_ LH_Line_First_C1_0 : 256|32@1- (1,0) [-2|2] "rad" MCU
 SG_ LH_Line_First_C2_0 : 288|32@1- (1,0) [-0.125|0.125] "INV(m)" MCU
 SG_ LH_Line_First_C3_0 : 320|32@1- (1,0) [-0.004|0.004] "INV(m2)" MCU
 SG_ LH_First_VR_Start_0 : 352|15@1+ (0.01,0) [0|200] "m" MCU
 SG_ LH_First_VR_End_0 : 367|15@1+ (0.01,0) [0|200] "m" MCU
 SG_ Reserved_6_0 : 382|2@1+ (1,0) [0|0] "NA" MCU
 SG_ LH_First_Measured_VR_End_0 : 384|15@1+ (0.01,0) [0|200] "m" MCU
 SG_ LH_Second_Measured_VR_End_0 : 399|15@1+ (0.01,0) [0|200] "m" MCU
 SG_ Reserved_7_0 : 414|2@1+ (1,0) [0|0] "NA" MCU
 SG_ LH_Line_Second_C0_0 : 416|32@1- (1,0) [-30|30] "m" MCU
 SG_ LH_Line_Second_C1_0 : 448|32@1- (1,0) [-2|2] "rad" MCU
 SG_ LH_Line_Second_C2_0 : 480|32@1- (1,0) [-0.125|0.125] "INV(m)" MCU
 SG_ LH_Line_Second_C3_0 : 512|32@1- (1,0) [-0.004|0.004] "INV(m2)" MCU
 SG_ LH_Second_VR_Start_0 : 544|15@1+ (0.01,0) [0|200] "m" MCU
 SG_ LH_Second_VR_End_0 : 559|15@1+ (0.01,0) [0|200] "m" MCU
 SG_ LH_Buffer_0 : 574|2@1+ (1,0) [0|0] "NA" MCU
 SG_ LH_CRC_1 : 576|32@1+ (1,0) [0|4294967295] "NA" MCU
 SG_ LH_Is_Triggered_SDM_Type_1 : 608|2@1+ (1,0) [0|2] "ENUM" MCU
 SG_ LH_Is_Triggered_SDM_Model_1 : 610|2@1+ (1,0) [0|2] "ENUM" MCU
 SG_ LH_Track_ID_1 : 612|8@1+ (1,0) [0|255] "counter" MCU
 SG_ LH_Age_1 : 620|8@1+ (1,0) [0|255] "frames" MCU
 SG_ LH_Existence_Probability_1 : 628|7@1+ (0.01,0) [0|1] "NA" MCU
 SG_ Reserved_2_1 : 635|5@1+ (1,0) [0|0] "NA" MCU
 SG_ LH_Prediction_Source_1 : 640|6@1+ (1,0) [0|63] "BITWIZE" MCU
 SG_ LH_Prediction_Type_1 : 646|2@1+ (1,0) [0|3] "BITWIZE" MCU
 SG_ LH_Color_1 : 648|2@1+ (1,0) [0|3] "ENUM" MCU
 SG_ LH_Color_Confidence_1 : 650|7@1+ (0.01,0) [0|1] "NA" MCU
 SG_ LH_Lanemark_Type_1 : 657|4@1+ (1,0) [0|6] "ENUM" MCU
 SG_ LH_DLM_Type_1 : 661|3@1+ (1,0) [0|5] "ENUM" MCU
 SG_ LH_DECEL_Type_1 : 664|3@1+ (1,0) [0|5] "ENUM" MCU
 SG_ Reserved_3_1 : 667|5@1+ (1,0) [0|0] "NA" MCU
 SG_ LH_Lanemark_Type_Conf_1 : 672|7@1+ (0.01,0) [0|1] "NA" MCU
 SG_ LH_Side_1 : 679|2@1+ (1,0) [0|2] "ENUM" MCU
 SG_ LH_Crossing_1 : 681|1@1+ (1,0) [0|1] "bool" MCU
 SG_ LH_Marker_Width_1 : 682|8@1+ (0.01,0) [0|0.7] "m" MCU
 SG_ LH_Marker_Width_STD_1 : 690|7@1+ (0.005,0) [0|0.5] "m" MCU
 SG_ Reserved_4_1 : 697|7@1+ (1,0) [0|0] "NA" MCU
 SG_ LH_Dash_Average_Length_1 : 704|8@1+ (0.01,0) [0|2] "m" MCU
 SG_ LH_Dash_Average_Gap_1 : 712|8@1+ (0.01,0) [0|2] "m" MCU
 SG_ LH_Is_Multi_Clothoid_1 : 720|1@1+ (1,0) [0|1] "bool" MCU
 SG_ Reserved_5_1 : 721|15@1+ (1,0) [0|0] "NA" MCU
 SG_ LH_Line_First_C0_1 : 736|32@1- (1,0) [-30|30] "m" MCU
 SG_ LH_Line_First_C1_1 : 768|32@1- (1,0) [-2|2] "rad" MCU
 SG_ LH_Line_First_C2_1 : 800|32@1- (1,0) [-0.125|0.125] "INV(m)" MCU
 SG_ LH_Line_First_C3_1 : 832|32@1- (1,0) [-0.004|0.004] "INV(m2)" MCU
 SG_ LH_First_VR_Start_1 : 864|15@1+ (0.01,0) [0|200] "m" MCU
 SG_ LH_First_VR_End_1 : 879|15@1+ (0.01,0) [0|200] "m" MCU
 SG_ Reserved_6_1 : 894|2@1+ (1,0) [0|0] "NA" MCU
 SG_ LH_First_Measured_VR_End_1 : 896|15@1+ (0.01,0) [0|200] "m" MCU
 SG_ LH_Second_Measured_VR_End_1 : 911|15@1+ (0.01,0) [0|200] "m" MCU
 SG_ Reserved_7_1 : 926|2@1+ (1,0) [0|0] "NA" MCU
 SG_ LH_Line_Second_C0_1 : 928|32@1- (1,0) [-30|30] "m" MCU
 SG_ LH_Line_Second_C1_1 : 960|32@1- (1,0) [-2|2] "rad" MCU
 SG_ LH_Line_Second_C2_1 : 992|32@1- (1,0) [-0.125|0.125] "INV(m)" MCU
 SG_ LH_Line_Second_C3_1 : 1024|32@1- (1,0) [-0.004|0.004] "INV(m2)" MCU
 SG_ LH_Second_VR_Start_1 : 1056|15@1+ (0.01,0) [0|200] "m" MCU
 SG_ LH_Second_VR_End_1 : 1071|15@1+ (0.01,0) [0|200] "m" MCU
 SG_ LH_Buffer_1 : 1086|2@1+ (1,0) [0|0] "NA" MCU

CM_ SG_ 142 LH_Zero_byte "in case set to FF message is not available.";
CM_ SG_ 142 LH_Protocol_Version "Denotes protocol version";
CM_ SG_ 142 LH_Sync_ID "Sync ID to be used to sync between signals in system";
CM_ SG_ 142 LH_Lanes_Count "Maximum number of lines supported by this protocol";
CM_ SG_ 142 LH_Estimated_Width "Multi-frame estimation of host lane width to be used for prediction or another driving cue/ scene cue";
CM_ SG_ 142 LH_CRC_0 "Calculated over all host lane mark information (host only)";
CM_ SG_ 142 LH_Is_Triggered_SDM_Type_0 "If this host lane mark has triggered SDM Type alert for Host lanes this flag is turned on";
CM_ SG_ 142 LH_Is_Triggered_SDM_Model_0 "If this host lane mark has triggered SDM Model alert for Host lanes this flag is turned on";
CM_ SG_ 142 LH_Track_ID_0 "Unique ID for the lane boundary entity that is tracked over time";
CM_ SG_ 142 LH_Age_0 "Number of frames that this lane mark is tracked";
CM_ SG_ 142 LH_Existence_Probability_0 "Existence probability of lane mark ";
CM_ SG_ 142 LH_Prediction_Source_0 "The reason for applying prediction on the lane mark (first segment only)";
CM_ SG_ 142 LH_Prediction_Type_0 "The different predictions currently set on the left/right host lane, if any(first segment only)";
CM_ SG_ 142 LH_Color_0 "ENUM lane mark color (first segment only)";
CM_ SG_ 142 LH_Color_Confidence_0 "color confidence (first segment only)";
CM_ SG_ 142 LH_Lanemark_Type_0 "Lane Mark Type Classification (first segment only)";
CM_ SG_ 142 LH_DLM_Type_0 "In case the lane mark is a double lane mark, the types of the different lane marks. The order is inner-lane-mark-type_outer-lane-mark-type (relative to the host vehicle)";
CM_ SG_ 142 LH_DECEL_Type_0 "For deceleration, what is inner line type (ENUM) (first segment only)";
CM_ SG_ 142 LH_Lanemark_Type_Conf_0 "How confident is the algorithm of the detected lane mark's type (first segment only)";
CM_ SG_ 142 LH_Side_0 "Lane mark side";
CM_ SG_ 142 LH_Crossing_0 "Is lane mark crossed (Lane change) (first segment only)";
CM_ SG_ 142 LH_Marker_Width_0 "Width of lane mark in Meters (first segment only)";
CM_ SG_ 142 LH_Marker_Width_STD_0 "STD of lane mark width (first segment only)";
CM_ SG_ 142 LH_Dash_Average_Length_0 "Average length of each section of dashed line when lane mark is dashed. This is a multi-frame signal. (first segment only)";
CM_ SG_ 142 LH_Dash_Average_Gap_0 "Average gap between of sections of dashed line when lane mark is dashed.  This is a multi-frame signal. (first segment only)";
CM_ SG_ 142 LH_Is_Multi_Clothoid_0 "In case is true both first and seconf LH_Line signals will be reported, otherwise only first LH_Line signals are to be used.";
CM_ SG_ 142 LH_Line_First_C0_0 "Ci is coefficient corresponding to variable with power of 'i'";
CM_ SG_ 142 LH_Line_First_C1_0 "Ci is coefficient corresponding to variable with power of 'i'";
CM_ SG_ 142 LH_Line_First_C2_0 "Ci is coefficient corresponding to variable with power of 'i'";
CM_ SG_ 142 LH_Line_First_C3_0 "Ci is coefficient corresponding to variable with power of 'i'";
CM_ SG_ 142 LH_First_VR_Start_0 "Start of longitudinal view range of lane mark";
CM_ SG_ 142 LH_First_VR_End_0 "End of longitudinal view range of lane mark";
CM_ SG_ 142 LH_First_Measured_VR_End_0 "End of longitudinal measured view range of lane mark  (not relevant for MC)";
CM_ SG_ 142 LH_Second_Measured_VR_End_0 "End of longitudinal measured view range of lane mark  (not relevant for MC)";
CM_ SG_ 142 LH_Line_Second_C0_0 "Ci is coefficient corresponding to variable with power of 'i'";
CM_ SG_ 142 LH_Line_Second_C1_0 "Ci is coefficient corresponding to variable with power of 'i'";
CM_ SG_ 142 LH_Line_Second_C2_0 "Ci is coefficient corresponding to variable with power of 'i'";
CM_ SG_ 142 LH_Line_Second_C3_0 "Ci is coefficient corresponding to variable with power of 'i'";
CM_ SG_ 142 LH_Second_VR_Start_0 "Start of longitudinal view range of lane mark";
CM_ SG_ 142 LH_Second_VR_End_0 "End of longitudinal view range of lane mark";
CM_ SG_ 142 LH_CRC_1 "Calculated over all host lane mark information (host only)";
CM_ SG_ 142 LH_Is_Triggered_SDM_Type_1 "If this host lane mark has triggered SDM Type alert for Host lanes this flag is turned on";
CM_ SG_ 142 LH_Is_Triggered_SDM_Model_1 "If this host lane mark has triggered SDM Model alert for Host lanes this flag is turned on";
CM_ SG_ 142 LH_Track_ID_1 "Unique ID for the lane boundary entity that is tracked over time";
CM_ SG_ 142 LH_Age_1 "Number of frames that this lane mark is tracked";
CM_ SG_ 142 LH_Existence_Probability_1 "Existence probability of lane mark ";
CM_ SG_ 142 LH_Prediction_Source_1 "The reason for applying prediction on the lane mark (first segment only)";
CM_ SG_ 142 LH_Prediction_Type_1 "The different predictions currently set on the left/right host lane, if any(first segment only)";
CM_ SG_ 142 LH_Color_1 "ENUM lane mark color (first segment only)";
CM_ SG_ 142 LH_Color_Confidence_1 "color confidence (first segment only)";
CM_ SG_ 142 LH_Lanemark_Type_1 "Lane Mark Type Classification (first segment only)";
CM_ SG_ 142 LH_DLM_Type_1 "In case the lane mark is a double lane mark, the types of the different lane marks. The order is inner-lane-mark-type_outer-lane-mark-type (relative to the host vehicle)";
CM_ SG_ 142 LH_DECEL_Type_1 "For deceleration, what is inner line type (ENUM) (first segment only)";
CM_ SG_ 142 LH_Lanemark_Type_Conf_1 "How confident is the algorithm of the detected lane mark's type (first segment only)";
CM_ SG_ 142 LH_Side_1 "Lane mark side";
CM_ SG_ 142 LH_Crossing_1 "Is lane mark crossed (Lane change) (first segment only)";
CM_ SG_ 142 LH_Marker_Width_1 "Width of lane mark in Meters (first segment only)";
CM_ SG_ 142 LH_Marker_Width_STD_1 "STD of lane mark width (first segment only)";
CM_ SG_ 142 LH_Dash_Average_Length_1 "Average length of each section of dashed line when lane mark is dashed. This is a multi-frame signal. (first segment only)";
CM_ SG_ 142 LH_Dash_Average_Gap_1 "Average gap between of sections of dashed line when lane mark is dashed.  This is a multi-frame signal. (first segment only)";
CM_ SG_ 142 LH_Is_Multi_Clothoid_1 "In case is true both first and seconf LH_Line signals will be reported, otherwise only first LH_Line signals are to be used.";
CM_ SG_ 142 LH_Line_First_C0_1 "Ci is coefficient corresponding to variable with power of 'i'";
CM_ SG_ 142 LH_Line_First_C1_1 "Ci is coefficient corresponding to variable with power of 'i'";
CM_ SG_ 142 LH_Line_First_C2_1 "Ci is coefficient corresponding to variable with power of 'i'";
CM_ SG_ 142 LH_Line_First_C3_1 "Ci is coefficient corresponding to variable with power of 'i'";
CM_ SG_ 142 LH_First_VR_Start_1 "Start of longitudinal view range of lane mark";
CM_ SG_ 142 LH_First_VR_End_1 "End of longitudinal view range of lane mark";
CM_ SG_ 142 LH_First_Measured_VR_End_1 "End of longitudinal measured view range of lane mark  (not relevant for MC)";
CM_ SG_ 142 LH_Second_Measured_VR_End_1 "End of longitudinal measured view range of lane mark  (not relevant for MC)";
CM_ SG_ 142 LH_Line_Second_C0_1 "Ci is coefficient corresponding to variable with power of 'i'";
CM_ SG_ 142 LH_Line_Second_C1_1 "Ci is coefficient corresponding to variable with power of 'i'";
CM_ SG_ 142 LH_Line_Second_C2_1 "Ci is coefficient corresponding to variable with power of 'i'";
CM_ SG_ 142 LH_Line_Second_C3_1 "Ci is coefficient corresponding to variable with power of 'i'";
CM_ SG_ 142 LH_Second_VR_Start_1 "Start of longitudinal view range of lane mark";
CM_ SG_ 142 LH_Second_VR_End_1 "End of longitudinal view range of lane mark";

BA_DEF_  "BusType" STRING ;
BA_DEF_ SG_  "GenSigStartValue" INT 0 0;
BA_DEF_DEF_  "GenSigStartValue" 0;
BA_DEF_DEF_  "BusType" "Ethernet";

BA_ "GenSigStartValue" SG_ 142 LH_Line_Second_C0_1 30;
BA_ "GenSigStartValue" SG_ 142 LH_Line_Second_C1_1 2;
BA_ "GenSigStartValue" SG_ 142 LH_Line_Second_C2_1 0.125;
BA_ "GenSigStartValue" SG_ 142 LH_Line_Second_C3_1 0.004;
BA_ "GenSigStartValue" SG_ 142 LH_Protocol_Version 4;
BA_ "GenSigStartValue" SG_ 142 LH_Line_Second_C0_0 30;
BA_ "GenSigStartValue" SG_ 142 LH_Line_Second_C1_0 2;

VAL_ 142 LH_Is_Triggered_SDM_Type_0 2 "NOT_TRIGGERED" 1 "TRIGGERED" 0 "NOT_AVAILABLE" ;
VAL_ 142 LH_Is_Triggered_SDM_Model_0 2 "NOT_TRIGGERED" 1 "TRIGGERED" 0 "NOT_AVAILABLE" ;
VAL_ 142 LH_Prediction_Source_0 5 "(BIT_5)MERGE" 4 "(BIT_4)GR_SHADOW" 3 "(BIT_3)DIVERGING" 2 "(BIT_2)OCCLUDED" 1 "(BIT_1)HEADWAY" 0 "(BIT_0)LOSS" ;
VAL_ 142 LH_Prediction_Type_0 1 "(BIT_1)PARTIAL" 0 "(BIT_0)OTHER_SIDE" ;
VAL_ 142 LH_Color_0 3 "BLUE" 2 "YELLOW" 1 "WHITE" 0 "UNDECIDED" ;
VAL_ 142 LH_Lanemark_Type_0 6 "HOV_LANE" 5 "DECELERATION" 4 "BOTTS" 3 "DLM" 2 "DASHED" 1 "SOLID" 0 "UNDECIDED" ;
VAL_ 142 LH_DLM_Type_0 5 "UNDECIDED" 4 "DASHED_DASHED" 3 "SOLID_SOLID" 2 "DASHED_SOLID" 1 "SOLID_DASHED" 0 "NOT_DLM" ;
VAL_ 142 LH_DECEL_Type_0 5 "RESERVED_3" 4 "RESERVED_2" 3 "UNDECIDED" 2 "DASHED" 1 "SOLID" 0 "NO_DECEL" ;
VAL_ 142 LH_Side_0 2 "RIGHT" 1 "LEFT" 0 "UNKNOWN" ;
VAL_ 142 LH_Crossing_0 1 "TRUE" 0 "FALSE" ;
VAL_ 142 LH_Is_Multi_Clothoid_0 1 "TRUE" 0 "FALSE" ;
VAL_ 142 LH_Is_Triggered_SDM_Type_1 2 "NOT_TRIGGERED" 1 "TRIGGERED" 0 "NOT_AVAILABLE" ;
VAL_ 142 LH_Is_Triggered_SDM_Model_1 2 "NOT_TRIGGERED" 1 "TRIGGERED" 0 "NOT_AVAILABLE" ;
VAL_ 142 LH_Prediction_Source_1 5 "(BIT_5)MERGE" 4 "(BIT_4)GR_SHADOW" 3 "(BIT_3)DIVERGING" 2 "(BIT_2)OCCLUDED" 1 "(BIT_1)HEADWAY" 0 "(BIT_0)LOSS" ;
VAL_ 142 LH_Prediction_Type_1 1 "(BIT_1)PARTIAL" 0 "(BIT_0)OTHER_SIDE" ;
VAL_ 142 LH_Color_1 3 "BLUE" 2 "YELLOW" 1 "WHITE" 0 "UNDECIDED" ;
VAL_ 142 LH_Lanemark_Type_1 6 "HOV_LANE" 5 "DECELERATION" 4 "BOTTS" 3 "DLM" 2 "DASHED" 1 "SOLID" 0 "UNDECIDED" ;
VAL_ 142 LH_DLM_Type_1 5 "UNDECIDED" 4 "DASHED_DASHED" 3 "SOLID_SOLID" 2 "DASHED_SOLID" 1 "SOLID_DASHED" 0 "NOT_DLM" ;
VAL_ 142 LH_DECEL_Type_1 5 "RESERVED_3" 4 "RESERVED_2" 3 "UNDECIDED" 2 "DASHED" 1 "SOLID" 0 "NO_DECEL" ;
VAL_ 142 LH_Side_1 2 "RIGHT" 1 "LEFT" 0 "UNKNOWN" ;
VAL_ 142 LH_Crossing_1 1 "TRUE" 0 "FALSE" ;
VAL_ 142 LH_Is_Multi_Clothoid_1 1 "TRUE" 0 "FALSE" ;

SIG_VALTYPE_ 142 LH_Line_First_C0_0 : 1;
SIG_VALTYPE_ 142 LH_Line_First_C1_0 : 1;
SIG_VALTYPE_ 142 LH_Line_First_C2_0 : 1;
SIG_VALTYPE_ 142 LH_Line_First_C3_0 : 1;
SIG_VALTYPE_ 142 LH_Line_Second_C0_0 : 1;
SIG_VALTYPE_ 142 LH_Line_Second_C1_0 : 1;
SIG_VALTYPE_ 142 LH_Line_Second_C2_0 : 1;
SIG_VALTYPE_ 142 LH_Line_Second_C3_0 : 1;
SIG_VALTYPE_ 142 LH_Line_First_C0_1 : 1;
SIG_VALTYPE_ 142 LH_Line_First_C1_1 : 1;
SIG_VALTYPE_ 142 LH_Line_First_C2_1 : 1;
SIG_VALTYPE_ 142 LH_Line_First_C3_1 : 1;
SIG_VALTYPE_ 142 LH_Line_Second_C0_1 : 1;
SIG_VALTYPE_ 142 LH_Line_Second_C1_1 : 1;
SIG_VALTYPE_ 142 LH_Line_Second_C2_1 : 1;
SIG_VALTYPE_ 142 LH_Line_Second_C3_1 : 1;
