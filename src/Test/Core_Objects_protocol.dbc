VERSION "8"

NS_ :

BS_:

BU_: EyeQ4 MCU

BO_ 154 Core_Objects_protocol: 1940 EyeQ4
 SG_ OBJ_Zero_byte : 0|8@1+ (1,0) [0|255] "NA" MCU
 SG_ Reserved_1 : 8|24@1+ (1,0) [0|0] "NA" MCU
 SG_ OBJ_Header_CRC : 32|32@1+ (1,0) [0|4294967295] "NA" MCU
 SG_ OBJ_Protocol_Version : 64|8@1+ (1,0) [8|8] "counter" MCU
 SG_ OBJ_Sync_ID : 72|8@1+ (1,0) [0|255] "counter" MCU
 SG_ OBJ_VRU_Count : 80|5@1+ (1,0) [0|20] "counter" MCU
 SG_ OBJ_VD_Count : 85|5@1+ (1,0) [0|20] "counter" MCU
 SG_ OBJ_General_OBJ_Count : 90|4@1+ (1,0) [0|10] "counter" MCU
 SG_ Reserved_2 : 94|2@1+ (1,0) [0|0] "NA" MCU
 SG_ OBJ_Animal_Count : 96|4@1+ (1,0) [0|10] "counter" MCU
 SG_ OBJ_VD_NIV_Left : 100|8@1+ (1,0) [0|255] "ID" MCU
 SG_ OBJ_VD_NIV_Right : 108|8@1+ (1,0) [0|255] "ID" MCU
 SG_ OBJ_VD_CIPV_ID : 116|8@1+ (1,0) [0|255] "counter" MCU
 SG_ OBJ_VD_CIPV_Lost : 124|2@1+ (1,0) [0|2] "ENUM" MCU
 SG_ OBJ_VD_Allow_Acc : 126|2@1+ (1,0) [0|2] "ENUM" MCU
 SG_ OBJ_Is_Blocked_Left : 128|1@1+ (1,0) [0|1] "bool" MCU
 SG_ OBJ_Is_Blocked_Right : 129|1@1+ (1,0) [0|1] "bool" MCU
 SG_ OBJ_Header_Buffer : 130|30@1+ (1,0) [0|0] "NA" MCU
 SG_ OBJ_CRC_0 : 160|32@1+ (1,0) [0|4294967295] "NA" MCU
 SG_ OBJ_ID_0 : 192|8@1+ (1,0) [0|255] "counter" MCU
 SG_ OBJ_Existence_Probability_0 : 200|8@1+ (0.01,0) [0|1] "NA" MCU
 SG_ OBJ_Fusion_Source_0 : 208|16@1+ (1,0) [0|65535] "BITWIZE" MCU
 SG_ OBJ_Triggered_SDM_0 : 224|2@1+ (1,0) [0|2] "ENUM " MCU
 SG_ OBJ_Motion_Category_0 : 226|4@1+ (1,0) [0|13] "ENUM " MCU
 SG_ OBJ_Buffer_C0_0 : 230|7@1+ (1,0) [0|127] "NA" MCU
 SG_ OBJ_Object_Age_0 : 237|11@1+ (1,0) [0|2047] "Frames" MCU
 SG_ OBJ_Measuring_Status_0 : 248|3@1+ (1,0) [0|7] "BITWIZE" MCU
 SG_ OBJ_Object_Class_0 : 251|4@1+ (1,0) [0|8] "ENUM" MCU
 SG_ Reserved_3_0 : 255|1@1+ (1,0) [0|0] "NA" MCU
 SG_ OBJ_Class_Probability_0 : 256|7@1+ (0.01,0) [0|1] "NA" MCU
 SG_ OBJ_Buffer_C1_0 : 263|7@1+ (1,0) [0|127] "NA" MCU
 SG_ OBJ_Buffer_C2_0 : 270|7@1+ (1,0) [0|127] "NA" MCU
 SG_ OBJ_Buffer_C3_0 : 277|7@1+ (1,0) [0|127] "NA" MCU
 SG_ OBJ_Camera_Source_0 : 284|4@1+ (1,0) [0|15] "ENUM" MCU
 SG_ OBJ_Motion_Status_0 : 288|3@1+ (1,0) [0|5] "ENUM " MCU
 SG_ OBJ_Motion_Orientation_0 : 291|4@1+ (1,0) [0|13] "ENUM " MCU
 SG_ OBJ_Has_Cut_Lane_0 : 295|1@1+ (1,0) [0|1] "bool" MCU
 SG_ OBJ_Has_Cut_Path_0 : 296|1@1+ (1,0) [0|1] "bool" MCU
 SG_ OBJ_Brake_Light_0 : 297|1@1+ (1,0) [0|1] "bool" MCU
 SG_ OBJ_Turn_Indicator_Right_0 : 298|1@1+ (1,0) [0|1] "bool" MCU
 SG_ OBJ_Turn_Indicator_Left_0 : 299|1@1+ (1,0) [0|1] "bool" MCU
 SG_ OBJ_Light_Indicator_Validity_0 : 300|1@1+ (1,0) [0|1] "bool" MCU
 SG_ OBJ_Right_Out_Of_Image_0 : 301|1@1+ (1,0) [0|1] "bool" MCU
 SG_ OBJ_Left_Out_Of_Image_0 : 302|1@1+ (1,0) [0|1] "bool" MCU
 SG_ OBJ_Right_Out_Of_Image_V_0 : 303|1@1+ (1,0) [0|1] "bool" MCU
 SG_ OBJ_Left_Out_Of_Image_V_0 : 304|1@1+ (1,0) [0|1] "bool" MCU
 SG_ OBJ_Top_Out_Of_Image_0 : 305|1@1+ (1,0) [0|1] "bool" MCU
 SG_ OBJ_Bottom_Out_Of_Image_0 : 306|1@1+ (1,0) [0|1] "bool" MCU
 SG_ OBJ_Top_Out_Of_Image_V_0 : 307|1@1+ (1,0) [0|1] "bool" MCU
 SG_ OBJ_Bottom_Out_Of_Image_V_0 : 308|1@1+ (1,0) [0|1] "bool" MCU
 SG_ OBJ_Lane_Assignment_0 : 309|3@1+ (1,0) [0|5] "ENUM" MCU
 SG_ OBJ_Lane_Assignment_V_0 : 312|1@1+ (1,0) [0|1] "bool" MCU
 SG_ OBJ_Age_Seconds_0 : 313|7@1+ (1,0) [0|100] "s" MCU
 SG_ OBJ_Age_Seconds_V_0 : 320|1@1+ (1,0) [0|1] "bool" MCU
 SG_ OBJ_Width_0 : 321|9@1+ (0.01,0) [0.4|2.95] "m" MCU
 SG_ OBJ_Width_V_0 : 330|1@1+ (1,0) [0|1] "bool" MCU
 SG_ OBJ_Width_STD_0 : 331|8@1+ (0.01,0) [0|2] "m" MCU
 SG_ OBJ_Width_STD_V_0 : 339|1@1+ (1,0) [0|1] "bool" MCU
 SG_ OBJ_Length_0 : 340|9@1+ (0.05,0) [1.2|21] "m" MCU
 SG_ OBJ_Length_V_0 : 349|1@1+ (1,0) [0|1] "bool" MCU
 SG_ Reserved_4_0 : 350|2@1+ (1,0) [0|0] "NA" MCU
 SG_ OBJ_Length_STD_0 : 352|8@1+ (0.05,0) [0|10] "m" MCU
 SG_ OBJ_Length_STD_V_0 : 360|1@1+ (1,0) [0|1] "bool" MCU
 SG_ OBJ_Height_0 : 361|9@1+ (0.01,0) [0|2.95] "m" MCU
 SG_ OBJ_Height_V_0 : 370|1@1+ (1,0) [0|1] "bool" MCU
 SG_ OBJ_Height_STD_0 : 371|8@1+ (0.01,0) [0|2] "m" MCU
 SG_ OBJ_Height_STD_V_0 : 379|1@1+ (1,0) [0|1] "bool" MCU
 SG_ Reserved_5_0 : 380|4@1+ (1,0) [0|0] "NA" MCU
 SG_ OBJ_Abs_Long_Velocity_0 : 384|12@1+ (0.05,-30) [-30|100] "MPS" MCU
 SG_ OBJ_Abs_Long_Velocity_V_0 : 396|1@1+ (1,0) [0|1] "bool" MCU
 SG_ OBJ_Abs_Long_Velocity_STD_0 : 397|11@1+ (0.05,0) [0|65] "MPS" MCU
 SG_ OBJ_Abs_Long_Vel_STD_V_0 : 408|1@1+ (1,0) [0|1] "bool" MCU
 SG_ Reserved_6_0 : 409|7@1+ (1,0) [0|0] "NA" MCU
 SG_ OBJ_Abs_Lat_Velocity_0 : 416|11@1+ (0.05,-50) [-50|50] "MPS" MCU
 SG_ OBJ_Abs_Lat_Velocity_V_0 : 427|1@1+ (1,0) [0|1] "bool" MCU
 SG_ OBJ_Abs_Lat_Velocity_STD_0 : 428|10@1+ (0.05,0) [0|50] "MPS" MCU
 SG_ OBJ_Abs_Lat_Vel_STD_V_0 : 438|1@1+ (1,0) [0|1] "bool" MCU
 SG_ OBJ_Abs_Long_Acc_0 : 439|9@1+ (0.05,-10.3) [-10.3|7.3] "MPS2" MCU
 SG_ OBJ_Abs_Long_Acc_V_0 : 448|1@1+ (1,0) [0|1] "bool" MCU
 SG_ OBJ_Abs_Long_Acc_STD_0 : 449|8@1+ (0.05,0) [0|7.3] "MPS2" MCU
 SG_ OBJ_Abs_Long_Acc_STD_V_0 : 457|1@1+ (1,0) [0|1] "bool" MCU
 SG_ OBJ_Abs_Lat_Acc_0 : 458|9@1+ (0.05,-10.3) [-10.3|7.3] "MPS2" MCU
 SG_ OBJ_Abs_Lat_Acc_V_0 : 467|1@1+ (1,0) [0|1] "bool" MCU
 SG_ OBJ_Abs_Lat_Acc_STD_0 : 468|8@1+ (0.05,0) [0|7.3] "MPS2" MCU
 SG_ OBJ_Abs_Lat_Acc_STD_V_0 : 476|1@1+ (1,0) [0|1] "bool" MCU
 SG_ Reserved_7_0 : 477|3@1+ (1,0) [0|0] "NA" MCU
 SG_ OBJ_Abs_Acceleration_0 : 480|9@1+ (0.05,-10.3) [-10.3|7.3] "MPS2" MCU
 SG_ OBJ_Abs_Acceleration_V_0 : 489|1@1+ (1,0) [0|1] "bool" MCU
 SG_ OBJ_Abs_Acc_STD_0 : 490|8@1+ (0.05,0) [0|7.3] "MPS2" MCU
 SG_ OBJ_Abs_Acc_STD_V_0 : 498|1@1+ (1,0) [0|1] "bool" MCU
 SG_ OBJ_Inv_TTC_0 : 499|11@1+ (0.01,-8) [-8|8] "INV(s)" MCU
 SG_ OBJ_Inv_TTC_V_0 : 510|1@1+ (1,0) [0|1] "bool" MCU
 SG_ Reserved_8_0 : 511|1@1+ (1,0) [0|0] "NA" MCU
 SG_ OBJ_Inv_TTC_STD_0 : 512|11@1+ (0.01,0) [0|4] "INV(s)" MCU
 SG_ OBJ_Inv_TTC_STD_V_0 : 523|1@1+ (1,0) [0|1] "bool" MCU
 SG_ OBJ_Relative_Long_Acc_0 : 524|9@1+ (0.05,-10.3) [-10.3|7.3] "MPS2" MCU
 SG_ OBJ_Relative_Long_Acc_V_0 : 533|1@1+ (1,0) [0|1] "bool" MCU
 SG_ OBJ_Relative_Long_Acc_STD_0 : 534|8@1+ (0.05,0) [0|7.3] "MPS2" MCU
 SG_ OBJ_Rel_Long_Acc_STD_V_0 : 542|1@1+ (1,0) [0|1] "bool" MCU
 SG_ Reserved_9_0 : 543|1@1+ (1,0) [0|0] "NA" MCU
 SG_ OBJ_Relative_Long_Velocity_0 : 544|13@1+ (0.05,-120) [-120|130] "MPS" MCU
 SG_ OBJ_Relative_Long_Velocity_V_0 : 557|1@1+ (1,0) [0|1] "bool" MCU
 SG_ OBJ_Relative_Long_Vel_STD_0 : 558|12@1+ (0.05,0) [0|130] "MPS" MCU
 SG_ OBJ_Rel_Long_Vel_STD_V_0 : 570|1@1+ (1,0) [0|1] "bool" MCU
 SG_ Reserved_10_0 : 571|5@1+ (1,0) [0|0] "NA" MCU
 SG_ OBJ_Relative_Lat_Velocity_0 : 576|11@1+ (0.05,-50) [-50|50] "MPS" MCU
 SG_ OBJ_Relative_Lat_Velocity_V_0 : 587|1@1+ (1,0) [0|1] "bool" MCU
 SG_ OBJ_Relative_Lat_Velocity_STD_0 : 588|10@1+ (0.05,0) [0|50] "MPS" MCU
 SG_ OBJ_Rel_Lat_Vel_STD_V_0 : 598|1@1+ (1,0) [0|1] "bool" MCU
 SG_ Reserved_11_0 : 599|9@1+ (1,0) [0|0] "NA" MCU
 SG_ OBJ_Long_Distance_0 : 608|14@1+ (0.05,-200) [-200|250] "m" MCU
 SG_ OBJ_Long_Distance_V_0 : 622|1@1+ (1,0) [0|1] "bool" MCU
 SG_ OBJ_Long_Distance_STD_0 : 623|13@1+ (0.05,0) [0|250] "m" MCU
 SG_ OBJ_Long_Distance_STD_V_0 : 636|1@1+ (1,0) [0|1] "bool" MCU
 SG_ Reserved_12_0 : 637|3@1+ (1,0) [0|0] "NA" MCU
 SG_ OBJ_Lat_Distance_0 : 640|12@1+ (0.05,-100) [-100|100] "m" MCU
 SG_ OBJ_Lat_Distance_V_0 : 652|1@1+ (1,0) [0|1] "bool" MCU
 SG_ OBJ_Lat_Distance_STD_0 : 653|11@1+ (0.05,0) [0|100] "m" MCU
 SG_ OBJ_Lat_Distance_STD_V_0 : 664|1@1+ (1,0) [0|1] "bool" MCU
 SG_ Reserved_13_0 : 665|7@1+ (1,0) [0|0] "NA" MCU
 SG_ OBJ_Absolute_Speed_0 : 672|12@1+ (0.05,-65) [-65|65] "MPS" MCU
 SG_ OBJ_Absolute_Speed_V_0 : 684|1@1+ (1,0) [0|1] "bool" MCU
 SG_ OBJ_Absolute_Speed_STD_0 : 685|11@1+ (0.05,0) [0|65] "MPS" MCU
 SG_ OBJ_Absolute_Speed_STD_V_0 : 696|1@1+ (1,0) [0|1] "bool" MCU
 SG_ Reserved_14_0 : 697|7@1+ (1,0) [0|0] "NA" MCU
 SG_ OBJ_Heading_0 : 704|10@1+ (0.01,-3.14) [-3.14|3.14] "rad" MCU
 SG_ OBJ_Heading_V_0 : 714|1@1+ (1,0) [0|1] "bool" MCU
 SG_ OBJ_Heading_STD_0 : 715|9@1+ (0.01,0) [0|3.14] "rad" MCU
 SG_ OBJ_Heading_STD_V_0 : 724|1@1+ (1,0) [0|1] "bool" MCU
 SG_ OBJ_Angle_Rate_STD_0 : 725|11@1+ (0.002,0) [0|2.2318] "RPS" MCU
 SG_ OBJ_Angle_Rate_STD_V_0 : 736|1@1+ (1,0) [0|1] "bool" MCU
 SG_ OBJ_Angle_Rate_0 : 737|12@1+ (0.002,-2.234) [-2.234|2.2318] "RPS" MCU
 SG_ OBJ_Angle_Rate_V_0 : 749|1@1+ (1,0) [0|1] "bool" MCU
 SG_ OBJ_Angle_Right_0 : 750|14@1+ (0.0002,-1.571) [-1.571|1.571] "rad " MCU
 SG_ OBJ_Angle_Right_V_0 : 764|1@1+ (1,0) [0|1] "bool" MCU
 SG_ Reserved_15_0 : 765|3@1+ (1,0) [0|0] "NA" MCU
 SG_ OBJ_Angle_Right_STD_0 : 768|13@1+ (0.0002,0) [0|1.571] "rad " MCU
 SG_ OBJ_Angle_Right_STD_V_0 : 781|1@1+ (1,0) [0|1] "bool" MCU
 SG_ OBJ_Angle_Left_0 : 782|14@1+ (0.0002,-1.571) [-1.571|1.571] "rad " MCU
 SG_ OBJ_Angle_Left_V_0 : 796|1@1+ (1,0) [0|1] "bool" MCU
 SG_ Reserved_16_0 : 797|3@1+ (1,0) [0|0] "NA" MCU
 SG_ OBJ_Angle_Left_STD_0 : 800|13@1+ (0.0002,0) [0|1.571] "rad" MCU
 SG_ OBJ_Angle_Left_STD_V_0 : 813|1@1+ (1,0) [0|1] "bool" MCU
 SG_ OBJ_Angle_Side_0 : 814|14@1+ (0.0002,-1.571) [-1.571|1.571] "rad" MCU
 SG_ OBJ_Angle_Side_V_0 : 828|1@1+ (1,0) [0|1] "bool" MCU
 SG_ Reserved_17_0 : 829|3@1+ (1,0) [0|0] "NA" MCU
 SG_ OBJ_Angle_Side_STD_0 : 832|13@1+ (0.0002,0) [0|1.571] "rad" MCU
 SG_ OBJ_Angle_Side_STD_V_0 : 845|1@1+ (1,0) [0|1] "bool" MCU
 SG_ OBJ_Angle_Mid_V_0 : 846|1@1+ (1,0) [0|1] "bool" MCU
 SG_ OBJ_Angle_Mid_0 : 847|14@1+ (0.0002,-1.571) [-1.571|1.571] "rad" MCU
 SG_ Reserved_18_0 : 861|3@1+ (1,0) [0|0] "NA" MCU
 SG_ OBJ_Angle_Mid_STD_0 : 864|13@1+ (0.0002,0) [0|1.571] "rad" MCU
 SG_ OBJ_Angle_Mid_STD_V_0 : 877|1@1+ (1,0) [0|1] "bool" MCU
 SG_ OBJ_Angle_Bottom_V_0 : 878|1@1+ (1,0) [0|1] "bool" MCU
 SG_ OBJ_Angle_Bottom_0 : 879|14@1+ (0.0002,-1.571) [-1.571|1.571] "rad" MCU
 SG_ Reserved_19_0 : 893|3@1+ (1,0) [0|0] "NA" MCU
 SG_ OBJ_Angle_Bottom_STD_0 : 896|13@1+ (0.0002,0) [0|1.571] "rad" MCU
 SG_ OBJ_Angle_Bottom_STD_V_0 : 909|1@1+ (1,0) [0|1] "bool" MCU
 SG_ OBJ_Visibility_Side_V_0 : 910|1@1+ (1,0) [0|1] "Bool" MCU
 SG_ OBJ_Visibility_Side_0 : 911|2@1+ (1,0) [0|2] "ENUM" MCU
 SG_ OBJ_Is_In_Drivable_Area_0 : 913|1@1+ (1,0) [0|1] "bool" MCU
 SG_ OBJ_Is_In_Drivable_Area_V_0 : 914|1@1+ (1,0) [0|1] "bool" MCU
 SG_ OBJ_Is_VeryClose_0 : 915|1@1+ (1,0) [0|1] "bool" MCU
 SG_ OBJ_Is_VeryClose_V_0 : 916|1@1+ (1,0) [0|1] "bool" MCU
 SG_ OBJ_Occlusion_RL_0 : 917|2@1+ (1,0) [0|2] "ENUM" MCU
 SG_ OBJ_Occlusion_RR_0 : 919|2@1+ (1,0) [0|2] "ENUM" MCU
 SG_ OBJ_Occlusion_FR_0 : 921|2@1+ (1,0) [0|2] "ENUM" MCU
 SG_ OBJ_Occlusion_FL_0 : 923|2@1+ (1,0) [0|2] "ENUM" MCU
 SG_ OBJ_Buffer_0 : 925|3@1+ (1,0) [0|0] "NA" MCU
 SG_ OBJ_CRC_1 : 928|32@1+ (1,0) [0|4294967295] "NA" MCU
 SG_ OBJ_ID_1 : 960|8@1+ (1,0) [0|255] "counter" MCU
 SG_ OBJ_Existence_Probability_1 : 968|8@1+ (0.01,0) [0|1] "NA" MCU
 SG_ OBJ_Fusion_Source_1 : 976|16@1+ (1,0) [0|65535] "BITWIZE" MCU
 SG_ OBJ_Triggered_SDM_1 : 992|2@1+ (1,0) [0|2] "ENUM " MCU
 SG_ OBJ_Motion_Category_1 : 994|4@1+ (1,0) [0|13] "ENUM " MCU
 SG_ OBJ_Buffer_C0_1 : 998|7@1+ (1,0) [0|127] "NA" MCU
 SG_ OBJ_Object_Age_1 : 1005|11@1+ (1,0) [0|2047] "Frames" MCU
 SG_ OBJ_Measuring_Status_1 : 1016|3@1+ (1,0) [0|7] "BITWIZE" MCU
 SG_ OBJ_Object_Class_1 : 1019|4@1+ (1,0) [0|8] "ENUM" MCU
 SG_ Reserved_3_1 : 1023|1@1+ (1,0) [0|0] "NA" MCU
 SG_ OBJ_Class_Probability_1 : 1024|7@1+ (0.01,0) [0|1] "NA" MCU
 SG_ OBJ_Buffer_C1_1 : 1031|7@1+ (1,0) [0|127] "NA" MCU
 SG_ OBJ_Buffer_C2_1 : 1038|7@1+ (1,0) [0|127] "NA" MCU
 SG_ OBJ_Buffer_C3_1 : 1045|7@1+ (1,0) [0|127] "NA" MCU
 SG_ OBJ_Camera_Source_1 : 1052|4@1+ (1,0) [0|15] "ENUM" MCU
 SG_ OBJ_Motion_Status_1 : 1056|3@1+ (1,0) [0|5] "ENUM " MCU
 SG_ OBJ_Motion_Orientation_1 : 1059|4@1+ (1,0) [0|13] "ENUM " MCU
 SG_ OBJ_Has_Cut_Lane_1 : 1063|1@1+ (1,0) [0|1] "bool" MCU
 SG_ OBJ_Has_Cut_Path_1 : 1064|1@1+ (1,0) [0|1] "bool" MCU
 SG_ OBJ_Brake_Light_1 : 1065|1@1+ (1,0) [0|1] "bool" MCU
 SG_ OBJ_Turn_Indicator_Right_1 : 1066|1@1+ (1,0) [0|1] "bool" MCU
 SG_ OBJ_Turn_Indicator_Left_1 : 1067|1@1+ (1,0) [0|1] "bool" MCU
 SG_ OBJ_Light_Indicator_Validity_1 : 1068|1@1+ (1,0) [0|1] "bool" MCU
 SG_ OBJ_Right_Out_Of_Image_1 : 1069|1@1+ (1,0) [0|1] "bool" MCU
 SG_ OBJ_Left_Out_Of_Image_1 : 1070|1@1+ (1,0) [0|1] "bool" MCU
 SG_ OBJ_Right_Out_Of_Image_V_1 : 1071|1@1+ (1,0) [0|1] "bool" MCU
 SG_ OBJ_Left_Out_Of_Image_V_1 : 1072|1@1+ (1,0) [0|1] "bool" MCU
 SG_ OBJ_Top_Out_Of_Image_1 : 1073|1@1+ (1,0) [0|1] "bool" MCU
 SG_ OBJ_Bottom_Out_Of_Image_1 : 1074|1@1+ (1,0) [0|1] "bool" MCU
 SG_ OBJ_Top_Out_Of_Image_V_1 : 1075|1@1+ (1,0) [0|1] "bool" MCU
 SG_ OBJ_Bottom_Out_Of_Image_V_1 : 1076|1@1+ (1,0) [0|1] "bool" MCU
 SG_ OBJ_Lane_Assignment_1 : 1077|3@1+ (1,0) [0|5] "ENUM" MCU
 SG_ OBJ_Lane_Assignment_V_1 : 1080|1@1+ (1,0) [0|1] "bool" MCU
 SG_ OBJ_Age_Seconds_1 : 1081|7@1+ (1,0) [0|100] "s" MCU
 SG_ OBJ_Age_Seconds_V_1 : 1088|1@1+ (1,0) [0|1] "bool" MCU
 SG_ OBJ_Width_1 : 1089|9@1+ (0.01,0) [0.4|2.95] "m" MCU
 SG_ OBJ_Width_V_1 : 1098|1@1+ (1,0) [0|1] "bool" MCU
 SG_ OBJ_Width_STD_1 : 1099|8@1+ (0.01,0) [0|2] "m" MCU
 SG_ OBJ_Width_STD_V_1 : 1107|1@1+ (1,0) [0|1] "bool" MCU
 SG_ OBJ_Length_1 : 1108|9@1+ (0.05,0) [1.2|21] "m" MCU
 SG_ OBJ_Length_V_1 : 1117|1@1+ (1,0) [0|1] "bool" MCU
 SG_ Reserved_4_1 : 1118|2@1+ (1,0) [0|0] "NA" MCU
 SG_ OBJ_Length_STD_1 : 1120|8@1+ (0.05,0) [0|10] "m" MCU
 SG_ OBJ_Length_STD_V_1 : 1128|1@1+ (1,0) [0|1] "bool" MCU
 SG_ OBJ_Height_1 : 1129|9@1+ (0.01,0) [0|2.95] "m" MCU
 SG_ OBJ_Height_V_1 : 1138|1@1+ (1,0) [0|1] "bool" MCU
 SG_ OBJ_Height_STD_1 : 1139|8@1+ (0.01,0) [0|2] "m" MCU
 SG_ OBJ_Height_STD_V_1 : 1147|1@1+ (1,0) [0|1] "bool" MCU
 SG_ Reserved_5_1 : 1148|4@1+ (1,0) [0|0] "NA" MCU
 SG_ OBJ_Abs_Long_Velocity_1 : 1152|12@1+ (0.05,-30) [-30|100] "MPS" MCU
 SG_ OBJ_Abs_Long_Velocity_V_1 : 1164|1@1+ (1,0) [0|1] "bool" MCU
 SG_ OBJ_Abs_Long_Velocity_STD_1 : 1165|11@1+ (0.05,0) [0|65] "MPS" MCU
 SG_ OBJ_Abs_Long_Vel_STD_V_1 : 1176|1@1+ (1,0) [0|1] "bool" MCU
 SG_ Reserved_6_1 : 1177|7@1+ (1,0) [0|0] "NA" MCU
 SG_ OBJ_Abs_Lat_Velocity_1 : 1184|11@1+ (0.05,-50) [-50|50] "MPS" MCU
 SG_ OBJ_Abs_Lat_Velocity_V_1 : 1195|1@1+ (1,0) [0|1] "bool" MCU
 SG_ OBJ_Abs_Lat_Velocity_STD_1 : 1196|10@1+ (0.05,0) [0|50] "MPS" MCU
 SG_ OBJ_Abs_Lat_Vel_STD_V_1 : 1206|1@1+ (1,0) [0|1] "bool" MCU
 SG_ OBJ_Abs_Long_Acc_1 : 1207|9@1+ (0.05,-10.3) [-10.3|7.3] "MPS2" MCU
 SG_ OBJ_Abs_Long_Acc_V_1 : 1216|1@1+ (1,0) [0|1] "bool" MCU
 SG_ OBJ_Abs_Long_Acc_STD_1 : 1217|8@1+ (0.05,0) [0|7.3] "MPS2" MCU
 SG_ OBJ_Abs_Long_Acc_STD_V_1 : 1225|1@1+ (1,0) [0|1] "bool" MCU
 SG_ OBJ_Abs_Lat_Acc_1 : 1226|9@1+ (0.05,-10.3) [-10.3|7.3] "MPS2" MCU
 SG_ OBJ_Abs_Lat_Acc_V_1 : 1235|1@1+ (1,0) [0|1] "bool" MCU
 SG_ OBJ_Abs_Lat_Acc_STD_1 : 1236|8@1+ (0.05,0) [0|7.3] "MPS2" MCU
 SG_ OBJ_Abs_Lat_Acc_STD_V_1 : 1244|1@1+ (1,0) [0|1] "bool" MCU
 SG_ Reserved_7_1 : 1245|3@1+ (1,0) [0|0] "NA" MCU
 SG_ OBJ_Abs_Acceleration_1 : 1248|9@1+ (0.05,-10.3) [-10.3|7.3] "MPS2" MCU
 SG_ OBJ_Abs_Acceleration_V_1 : 1257|1@1+ (1,0) [0|1] "bool" MCU
 SG_ OBJ_Abs_Acc_STD_1 : 1258|8@1+ (0.05,0) [0|7.3] "MPS2" MCU
 SG_ OBJ_Abs_Acc_STD_V_1 : 1266|1@1+ (1,0) [0|1] "bool" MCU
 SG_ OBJ_Inv_TTC_1 : 1267|11@1+ (0.01,-8) [-8|8] "INV(s)" MCU
 SG_ OBJ_Inv_TTC_V_1 : 1278|1@1+ (1,0) [0|1] "bool" MCU
 SG_ Reserved_8_1 : 1279|1@1+ (1,0) [0|0] "NA" MCU
 SG_ OBJ_Inv_TTC_STD_1 : 1280|11@1+ (0.01,0) [0|4] "INV(s)" MCU
 SG_ OBJ_Inv_TTC_STD_V_1 : 1291|1@1+ (1,0) [0|1] "bool" MCU
 SG_ OBJ_Relative_Long_Acc_1 : 1292|9@1+ (0.05,-10.3) [-10.3|7.3] "MPS2" MCU
 SG_ OBJ_Relative_Long_Acc_V_1 : 1301|1@1+ (1,0) [0|1] "bool" MCU
 SG_ OBJ_Relative_Long_Acc_STD_1 : 1302|8@1+ (0.05,0) [0|7.3] "MPS2" MCU
 SG_ OBJ_Rel_Long_Acc_STD_V_1 : 1310|1@1+ (1,0) [0|1] "bool" MCU
 SG_ Reserved_9_1 : 1311|1@1+ (1,0) [0|0] "NA" MCU
 SG_ OBJ_Relative_Long_Velocity_1 : 1312|13@1+ (0.05,-120) [-120|130] "MPS" MCU
 SG_ OBJ_Relative_Long_Velocity_V_1 : 1325|1@1+ (1,0) [0|1] "bool" MCU
 SG_ OBJ_Relative_Long_Vel_STD_1 : 1326|12@1+ (0.05,0) [0|130] "MPS" MCU
 SG_ OBJ_Rel_Long_Vel_STD_V_1 : 1338|1@1+ (1,0) [0|1] "bool" MCU
 SG_ Reserved_10_1 : 1339|5@1+ (1,0) [0|0] "NA" MCU
 SG_ OBJ_Relative_Lat_Velocity_1 : 1344|11@1+ (0.05,-50) [-50|50] "MPS" MCU
 SG_ OBJ_Relative_Lat_Velocity_V_1 : 1355|1@1+ (1,0) [0|1] "bool" MCU
 SG_ OBJ_Relative_Lat_Velocity_STD_1 : 1356|10@1+ (0.05,0) [0|50] "MPS" MCU
 SG_ OBJ_Rel_Lat_Vel_STD_V_1 : 1366|1@1+ (1,0) [0|1] "bool" MCU
 SG_ Reserved_11_1 : 1367|9@1+ (1,0) [0|0] "NA" MCU
 SG_ OBJ_Long_Distance_1 : 1376|14@1+ (0.05,-200) [-200|250] "m" MCU
 SG_ OBJ_Long_Distance_V_1 : 1390|1@1+ (1,0) [0|1] "bool" MCU
 SG_ OBJ_Long_Distance_STD_1 : 1391|13@1+ (0.05,0) [0|250] "m" MCU
 SG_ OBJ_Long_Distance_STD_V_1 : 1404|1@1+ (1,0) [0|1] "bool" MCU
 SG_ Reserved_12_1 : 1405|3@1+ (1,0) [0|0] "NA" MCU
 SG_ OBJ_Lat_Distance_1 : 1408|12@1+ (0.05,-100) [-100|100] "m" MCU
 SG_ OBJ_Lat_Distance_V_1 : 1420|1@1+ (1,0) [0|1] "bool" MCU
 SG_ OBJ_Lat_Distance_STD_1 : 1421|11@1+ (0.05,0) [0|100] "m" MCU
 SG_ OBJ_Lat_Distance_STD_V_1 : 1432|1@1+ (1,0) [0|1] "bool" MCU
 SG_ Reserved_13_1 : 1433|7@1+ (1,0) [0|0] "NA" MCU
 SG_ OBJ_Absolute_Speed_1 : 1440|12@1+ (0.05,-65) [-65|65] "MPS" MCU
 SG_ OBJ_Absolute_Speed_V_1 : 1452|1@1+ (1,0) [0|1] "bool" MCU
 SG_ OBJ_Absolute_Speed_STD_1 : 1453|11@1+ (0.05,0) [0|65] "MPS" MCU
 SG_ OBJ_Absolute_Speed_STD_V_1 : 1464|1@1+ (1,0) [0|1] "bool" MCU
 SG_ Reserved_14_1 : 1465|7@1+ (1,0) [0|0] "NA" MCU
 SG_ OBJ_Heading_1 : 1472|10@1+ (0.01,-3.14) [-3.14|3.14] "rad" MCU
 SG_ OBJ_Heading_V_1 : 1482|1@1+ (1,0) [0|1] "bool" MCU
 SG_ OBJ_Heading_STD_1 : 1483|9@1+ (0.01,0) [0|3.14] "rad" MCU
 SG_ OBJ_Heading_STD_V_1 : 1492|1@1+ (1,0) [0|1] "bool" MCU
 SG_ OBJ_Angle_Rate_STD_1 : 1493|11@1+ (0.002,0) [0|2.2318] "RPS" MCU
 SG_ OBJ_Angle_Rate_STD_V_1 : 1504|1@1+ (1,0) [0|1] "bool" MCU
 SG_ OBJ_Angle_Rate_1 : 1505|12@1+ (0.002,-2.234) [-2.234|2.2318] "RPS" MCU
 SG_ OBJ_Angle_Rate_V_1 : 1517|1@1+ (1,0) [0|1] "bool" MCU
 SG_ OBJ_Angle_Right_1 : 1518|14@1+ (0.0002,-1.571) [-1.571|1.571] "rad " MCU
 SG_ OBJ_Angle_Right_V_1 : 1532|1@1+ (1,0) [0|1] "bool" MCU
 SG_ Reserved_15_1 : 1533|3@1+ (1,0) [0|0] "NA" MCU
 SG_ OBJ_Angle_Right_STD_1 : 1536|13@1+ (0.0002,0) [0|1.571] "rad " MCU
 SG_ OBJ_Angle_Right_STD_V_1 : 1549|1@1+ (1,0) [0|1] "bool" MCU
 SG_ OBJ_Angle_Left_1 : 1550|14@1+ (0.0002,-1.571) [-1.571|1.571] "rad " MCU
 SG_ OBJ_Angle_Left_V_1 : 1564|1@1+ (1,0) [0|1] "bool" MCU
 SG_ Reserved_16_1 : 1565|3@1+ (1,0) [0|0] "NA" MCU
 SG_ OBJ_Angle_Left_STD_1 : 1568|13@1+ (0.0002,0) [0|1.571] "rad" MCU
 SG_ OBJ_Angle_Left_STD_V_1 : 1581|1@1+ (1,0) [0|1] "bool" MCU
 SG_ OBJ_Angle_Side_1 : 1582|14@1+ (0.0002,-1.571) [-1.571|1.571] "rad" MCU
 SG_ OBJ_Angle_Side_V_1 : 1596|1@1+ (1,0) [0|1] "bool" MCU
 SG_ Reserved_17_1 : 1597|3@1+ (1,0) [0|0] "NA" MCU
 SG_ OBJ_Angle_Side_STD_1 : 1600|13@1+ (0.0002,0) [0|1.571] "rad" MCU
 SG_ OBJ_Angle_Side_STD_V_1 : 1613|1@1+ (1,0) [0|1] "bool" MCU
 SG_ OBJ_Angle_Mid_V_1 : 1614|1@1+ (1,0) [0|1] "bool" MCU
 SG_ OBJ_Angle_Mid_1 : 1615|14@1+ (0.0002,-1.571) [-1.571|1.571] "rad" MCU
 SG_ Reserved_18_1 : 1629|3@1+ (1,0) [0|0] "NA" MCU
 SG_ OBJ_Angle_Mid_STD_1 : 1632|13@1+ (0.0002,0) [0|1.571] "rad" MCU
 SG_ OBJ_Angle_Mid_STD_V_1 : 1645|1@1+ (1,0) [0|1] "bool" MCU
 SG_ OBJ_Angle_Bottom_V_1 : 1646|1@1+ (1,0) [0|1] "bool" MCU
 SG_ OBJ_Angle_Bottom_1 : 1647|14@1+ (0.0002,-1.571) [-1.571|1.571] "rad" MCU
 SG_ Reserved_19_1 : 1661|3@1+ (1,0) [0|0] "NA" MCU
 SG_ OBJ_Angle_Bottom_STD_1 : 1664|13@1+ (0.0002,0) [0|1.571] "rad" MCU
 SG_ OBJ_Angle_Bottom_STD_V_1 : 1677|1@1+ (1,0) [0|1] "bool" MCU
 SG_ OBJ_Visibility_Side_V_1 : 1678|1@1+ (1,0) [0|1] "Bool" MCU
 SG_ OBJ_Visibility_Side_1 : 1679|2@1+ (1,0) [0|2] "ENUM" MCU
 SG_ OBJ_Is_In_Drivable_Area_1 : 1681|1@1+ (1,0) [0|1] "bool" MCU
 SG_ OBJ_Is_In_Drivable_Area_V_1 : 1682|1@1+ (1,0) [0|1] "bool" MCU
 SG_ OBJ_Is_VeryClose_1 : 1683|1@1+ (1,0) [0|1] "bool" MCU
 SG_ OBJ_Is_VeryClose_V_1 : 1684|1@1+ (1,0) [0|1] "bool" MCU
 SG_ OBJ_Occlusion_RL_1 : 1685|2@1+ (1,0) [0|2] "ENUM" MCU
 SG_ OBJ_Occlusion_RR_1 : 1687|2@1+ (1,0) [0|2] "ENUM" MCU
 SG_ OBJ_Occlusion_FR_1 : 1689|2@1+ (1,0) [0|2] "ENUM" MCU
 SG_ OBJ_Occlusion_FL_1 : 1691|2@1+ (1,0) [0|2] "ENUM" MCU
 SG_ OBJ_Buffer_1 : 1693|3@1+ (1,0) [0|0] "NA" MCU
 SG_ OBJ_CRC_2 : 1696|32@1+ (1,0) [0|4294967295] "NA" MCU
 SG_ OBJ_ID_2 : 1728|8@1+ (1,0) [0|255] "counter" MCU
 SG_ OBJ_Existence_Probability_2 : 1736|8@1+ (0.01,0) [0|1] "NA" MCU
 SG_ OBJ_Fusion_Source_2 : 1744|16@1+ (1,0) [0|65535] "BITWIZE" MCU
 SG_ OBJ_Triggered_SDM_2 : 1760|2@1+ (1,0) [0|2] "ENUM " MCU
 SG_ OBJ_Motion_Category_2 : 1762|4@1+ (1,0) [0|13] "ENUM " MCU
 SG_ OBJ_Buffer_C0_2 : 1766|7@1+ (1,0) [0|127] "NA" MCU
 SG_ OBJ_Object_Age_2 : 1773|11@1+ (1,0) [0|2047] "Frames" MCU
 SG_ OBJ_Measuring_Status_2 : 1784|3@1+ (1,0) [0|7] "BITWIZE" MCU
 SG_ OBJ_Object_Class_2 : 1787|4@1+ (1,0) [0|8] "ENUM" MCU
 SG_ Reserved_3_2 : 1791|1@1+ (1,0) [0|0] "NA" MCU
 SG_ OBJ_Class_Probability_2 : 1792|7@1+ (0.01,0) [0|1] "NA" MCU
 SG_ OBJ_Buffer_C1_2 : 1799|7@1+ (1,0) [0|127] "NA" MCU
 SG_ OBJ_Buffer_C2_2 : 1806|7@1+ (1,0) [0|127] "NA" MCU
 SG_ OBJ_Buffer_C3_2 : 1813|7@1+ (1,0) [0|127] "NA" MCU
 SG_ OBJ_Camera_Source_2 : 1820|4@1+ (1,0) [0|15] "ENUM" MCU
 SG_ OBJ_Motion_Status_2 : 1824|3@1+ (1,0) [0|5] "ENUM " MCU
 SG_ OBJ_Motion_Orientation_2 : 1827|4@1+ (1,0) [0|13] "ENUM " MCU
 SG_ OBJ_Has_Cut_Lane_2 : 1831|1@1+ (1,0) [0|1] "bool" MCU
 SG_ OBJ_Has_Cut_Path_2 : 1832|1@1+ (1,0) [0|1] "bool" MCU
 SG_ OBJ_Brake_Light_2 : 1833|1@1+ (1,0) [0|1] "bool" MCU
 SG_ OBJ_Turn_Indicator_Right_2 : 1834|1@1+ (1,0) [0|1] "bool" MCU
 SG_ OBJ_Turn_Indicator_Left_2 : 1835|1@1+ (1,0) [0|1] "bool" MCU
 SG_ OBJ_Light_Indicator_Validity_2 : 1836|1@1+ (1,0) [0|1] "bool" MCU
 SG_ OBJ_Right_Out_Of_Image_2 : 1837|1@1+ (1,0) [0|1] "bool" MCU
 SG_ OBJ_Left_Out_Of_Image_2 : 1838|1@1+ (1,0) [0|1] "bool" MCU
 SG_ OBJ_Right_Out_Of_Image_V_2 : 1839|1@1+ (1,0) [0|1] "bool" MCU
 SG_ OBJ_Left_Out_Of_Image_V_2 : 1840|1@1+ (1,0) [0|1] "bool" MCU
 SG_ OBJ_Top_Out_Of_Image_2 : 1841|1@1+ (1,0) [0|1] "bool" MCU
 SG_ OBJ_Bottom_Out_Of_Image_2 : 1842|1@1+ (1,0) [0|1] "bool" MCU
 SG_ OBJ_Top_Out_Of_Image_V_2 : 1843|1@1+ (1,0) [0|1] "bool" MCU
 SG_ OBJ_Bottom_Out_Of_Image_V_2 : 1844|1@1+ (1,0) [0|1] "bool" MCU
 SG_ OBJ_Lane_Assignment_2 : 1845|3@1+ (1,0) [0|5] "ENUM" MCU
 SG_ OBJ_Lane_Assignment_V_2 : 1848|1@1+ (1,0) [0|1] "bool" MCU
 SG_ OBJ_Age_Seconds_2 : 1849|7@1+ (1,0) [0|100] "s" MCU
 SG_ OBJ_Age_Seconds_V_2 : 1856|1@1+ (1,0) [0|1] "bool" MCU
 SG_ OBJ_Width_2 : 1857|9@1+ (0.01,0) [0.4|2.95] "m" MCU
 SG_ OBJ_Width_V_2 : 1866|1@1+ (1,0) [0|1] "bool" MCU
 SG_ OBJ_Width_STD_2 : 1867|8@1+ (0.01,0) [0|2] "m" MCU
 SG_ OBJ_Width_STD_V_2 : 1875|1@1+ (1,0) [0|1] "bool" MCU
 SG_ OBJ_Length_2 : 1876|9@1+ (0.05,0) [1.2|21] "m" MCU
 SG_ OBJ_Length_V_2 : 1885|1@1+ (1,0) [0|1] "bool" MCU
 SG_ Reserved_4_2 : 1886|2@1+ (1,0) [0|0] "NA" MCU
 SG_ OBJ_Length_STD_2 : 1888|8@1+ (0.05,0) [0|10] "m" MCU
 SG_ OBJ_Length_STD_V_2 : 1896|1@1+ (1,0) [0|1] "bool" MCU
 SG_ OBJ_Height_2 : 1897|9@1+ (0.01,0) [0|2.95] "m" MCU
 SG_ OBJ_Height_V_2 : 1906|1@1+ (1,0) [0|1] "bool" MCU
 SG_ OBJ_Height_STD_2 : 1907|8@1+ (0.01,0) [0|2] "m" MCU
 SG_ OBJ_Height_STD_V_2 : 1915|1@1+ (1,0) [0|1] "bool" MCU
 SG_ Reserved_5_2 : 1916|4@1+ (1,0) [0|0] "NA" MCU
 SG_ OBJ_Abs_Long_Velocity_2 : 1920|12@1+ (0.05,-30) [-30|100] "MPS" MCU
 SG_ OBJ_Abs_Long_Velocity_V_2 : 1932|1@1+ (1,0) [0|1] "bool" MCU
 SG_ OBJ_Abs_Long_Velocity_STD_2 : 1933|11@1+ (0.05,0) [0|65] "MPS" MCU
 SG_ OBJ_Abs_Long_Vel_STD_V_2 : 1944|1@1+ (1,0) [0|1] "bool" MCU
 SG_ Reserved_6_2 : 1945|7@1+ (1,0) [0|0] "NA" MCU
 SG_ OBJ_Abs_Lat_Velocity_2 : 1952|11@1+ (0.05,-50) [-50|50] "MPS" MCU
 SG_ OBJ_Abs_Lat_Velocity_V_2 : 1963|1@1+ (1,0) [0|1] "bool" MCU
 SG_ OBJ_Abs_Lat_Velocity_STD_2 : 1964|10@1+ (0.05,0) [0|50] "MPS" MCU
 SG_ OBJ_Abs_Lat_Vel_STD_V_2 : 1974|1@1+ (1,0) [0|1] "bool" MCU
 SG_ OBJ_Abs_Long_Acc_2 : 1975|9@1+ (0.05,-10.3) [-10.3|7.3] "MPS2" MCU
 SG_ OBJ_Abs_Long_Acc_V_2 : 1984|1@1+ (1,0) [0|1] "bool" MCU
 SG_ OBJ_Abs_Long_Acc_STD_2 : 1985|8@1+ (0.05,0) [0|7.3] "MPS2" MCU
 SG_ OBJ_Abs_Long_Acc_STD_V_2 : 1993|1@1+ (1,0) [0|1] "bool" MCU
 SG_ OBJ_Abs_Lat_Acc_2 : 1994|9@1+ (0.05,-10.3) [-10.3|7.3] "MPS2" MCU
 SG_ OBJ_Abs_Lat_Acc_V_2 : 2003|1@1+ (1,0) [0|1] "bool" MCU
 SG_ OBJ_Abs_Lat_Acc_STD_2 : 2004|8@1+ (0.05,0) [0|7.3] "MPS2" MCU
 SG_ OBJ_Abs_Lat_Acc_STD_V_2 : 2012|1@1+ (1,0) [0|1] "bool" MCU
 SG_ Reserved_7_2 : 2013|3@1+ (1,0) [0|0] "NA" MCU
 SG_ OBJ_Abs_Acceleration_2 : 2016|9@1+ (0.05,-10.3) [-10.3|7.3] "MPS2" MCU
 SG_ OBJ_Abs_Acceleration_V_2 : 2025|1@1+ (1,0) [0|1] "bool" MCU
 SG_ OBJ_Abs_Acc_STD_2 : 2026|8@1+ (0.05,0) [0|7.3] "MPS2" MCU
 SG_ OBJ_Abs_Acc_STD_V_2 : 2034|1@1+ (1,0) [0|1] "bool" MCU
 SG_ OBJ_Inv_TTC_2 : 2035|11@1+ (0.01,-8) [-8|8] "INV(s)" MCU
 SG_ OBJ_Inv_TTC_V_2 : 2046|1@1+ (1,0) [0|1] "bool" MCU
 SG_ Reserved_8_2 : 2047|1@1+ (1,0) [0|0] "NA" MCU
 SG_ OBJ_Inv_TTC_STD_2 : 2048|11@1+ (0.01,0) [0|4] "INV(s)" MCU
 SG_ OBJ_Inv_TTC_STD_V_2 : 2059|1@1+ (1,0) [0|1] "bool" MCU
 SG_ OBJ_Relative_Long_Acc_2 : 2060|9@1+ (0.05,-10.3) [-10.3|7.3] "MPS2" MCU
 SG_ OBJ_Relative_Long_Acc_V_2 : 2069|1@1+ (1,0) [0|1] "bool" MCU
 SG_ OBJ_Relative_Long_Acc_STD_2 : 2070|8@1+ (0.05,0) [0|7.3] "MPS2" MCU
 SG_ OBJ_Rel_Long_Acc_STD_V_2 : 2078|1@1+ (1,0) [0|1] "bool" MCU
 SG_ Reserved_9_2 : 2079|1@1+ (1,0) [0|0] "NA" MCU
 SG_ OBJ_Relative_Long_Velocity_2 : 2080|13@1+ (0.05,-120) [-120|130] "MPS" MCU
 SG_ OBJ_Relative_Long_Velocity_V_2 : 2093|1@1+ (1,0) [0|1] "bool" MCU
 SG_ OBJ_Relative_Long_Vel_STD_2 : 2094|12@1+ (0.05,0) [0|130] "MPS" MCU
 SG_ OBJ_Rel_Long_Vel_STD_V_2 : 2106|1@1+ (1,0) [0|1] "bool" MCU
 SG_ Reserved_10_2 : 2107|5@1+ (1,0) [0|0] "NA" MCU
 SG_ OBJ_Relative_Lat_Velocity_2 : 2112|11@1+ (0.05,-50) [-50|50] "MPS" MCU
 SG_ OBJ_Relative_Lat_Velocity_V_2 : 2123|1@1+ (1,0) [0|1] "bool" MCU
 SG_ OBJ_Relative_Lat_Velocity_STD_2 : 2124|10@1+ (0.05,0) [0|50] "MPS" MCU
 SG_ OBJ_Rel_Lat_Vel_STD_V_2 : 2134|1@1+ (1,0) [0|1] "bool" MCU
 SG_ Reserved_11_2 : 2135|9@1+ (1,0) [0|0] "NA" MCU
 SG_ OBJ_Long_Distance_2 : 2144|14@1+ (0.05,-200) [-200|250] "m" MCU
 SG_ OBJ_Long_Distance_V_2 : 2158|1@1+ (1,0) [0|1] "bool" MCU
 SG_ OBJ_Long_Distance_STD_2 : 2159|13@1+ (0.05,0) [0|250] "m" MCU
 SG_ OBJ_Long_Distance_STD_V_2 : 2172|1@1+ (1,0) [0|1] "bool" MCU
 SG_ Reserved_12_2 : 2173|3@1+ (1,0) [0|0] "NA" MCU
 SG_ OBJ_Lat_Distance_2 : 2176|12@1+ (0.05,-100) [-100|100] "m" MCU
 SG_ OBJ_Lat_Distance_V_2 : 2188|1@1+ (1,0) [0|1] "bool" MCU
 SG_ OBJ_Lat_Distance_STD_2 : 2189|11@1+ (0.05,0) [0|100] "m" MCU
 SG_ OBJ_Lat_Distance_STD_V_2 : 2200|1@1+ (1,0) [0|1] "bool" MCU
 SG_ Reserved_13_2 : 2201|7@1+ (1,0) [0|0] "NA" MCU
 SG_ OBJ_Absolute_Speed_2 : 2208|12@1+ (0.05,-65) [-65|65] "MPS" MCU
 SG_ OBJ_Absolute_Speed_V_2 : 2220|1@1+ (1,0) [0|1] "bool" MCU
 SG_ OBJ_Absolute_Speed_STD_2 : 2221|11@1+ (0.05,0) [0|65] "MPS" MCU
 SG_ OBJ_Absolute_Speed_STD_V_2 : 2232|1@1+ (1,0) [0|1] "bool" MCU
 SG_ Reserved_14_2 : 2233|7@1+ (1,0) [0|0] "NA" MCU
 SG_ OBJ_Heading_2 : 2240|10@1+ (0.01,-3.14) [-3.14|3.14] "rad" MCU
 SG_ OBJ_Heading_V_2 : 2250|1@1+ (1,0) [0|1] "bool" MCU
 SG_ OBJ_Heading_STD_2 : 2251|9@1+ (0.01,0) [0|3.14] "rad" MCU
 SG_ OBJ_Heading_STD_V_2 : 2260|1@1+ (1,0) [0|1] "bool" MCU
 SG_ OBJ_Angle_Rate_STD_2 : 2261|11@1+ (0.002,0) [0|2.2318] "RPS" MCU
 SG_ OBJ_Angle_Rate_STD_V_2 : 2272|1@1+ (1,0) [0|1] "bool" MCU
 SG_ OBJ_Angle_Rate_2 : 2273|12@1+ (0.002,-2.234) [-2.234|2.2318] "RPS" MCU
 SG_ OBJ_Angle_Rate_V_2 : 2285|1@1+ (1,0) [0|1] "bool" MCU
 SG_ OBJ_Angle_Right_2 : 2286|14@1+ (0.0002,-1.571) [-1.571|1.571] "rad " MCU
 SG_ OBJ_Angle_Right_V_2 : 2300|1@1+ (1,0) [0|1] "bool" MCU
 SG_ Reserved_15_2 : 2301|3@1+ (1,0) [0|0] "NA" MCU
 SG_ OBJ_Angle_Right_STD_2 : 2304|13@1+ (0.0002,0) [0|1.571] "rad " MCU
 SG_ OBJ_Angle_Right_STD_V_2 : 2317|1@1+ (1,0) [0|1] "bool" MCU
 SG_ OBJ_Angle_Left_2 : 2318|14@1+ (0.0002,-1.571) [-1.571|1.571] "rad " MCU
 SG_ OBJ_Angle_Left_V_2 : 2332|1@1+ (1,0) [0|1] "bool" MCU
 SG_ Reserved_16_2 : 2333|3@1+ (1,0) [0|0] "NA" MCU
 SG_ OBJ_Angle_Left_STD_2 : 2336|13@1+ (0.0002,0) [0|1.571] "rad" MCU
 SG_ OBJ_Angle_Left_STD_V_2 : 2349|1@1+ (1,0) [0|1] "bool" MCU
 SG_ OBJ_Angle_Side_2 : 2350|14@1+ (0.0002,-1.571) [-1.571|1.571] "rad" MCU
 SG_ OBJ_Angle_Side_V_2 : 2364|1@1+ (1,0) [0|1] "bool" MCU
 SG_ Reserved_17_2 : 2365|3@1+ (1,0) [0|0] "NA" MCU
 SG_ OBJ_Angle_Side_STD_2 : 2368|13@1+ (0.0002,0) [0|1.571] "rad" MCU
 SG_ OBJ_Angle_Side_STD_V_2 : 2381|1@1+ (1,0) [0|1] "bool" MCU
 SG_ OBJ_Angle_Mid_V_2 : 2382|1@1+ (1,0) [0|1] "bool" MCU
 SG_ OBJ_Angle_Mid_2 : 2383|14@1+ (0.0002,-1.571) [-1.571|1.571] "rad" MCU
 SG_ Reserved_18_2 : 2397|3@1+ (1,0) [0|0] "NA" MCU
 SG_ OBJ_Angle_Mid_STD_2 : 2400|13@1+ (0.0002,0) [0|1.571] "rad" MCU
 SG_ OBJ_Angle_Mid_STD_V_2 : 2413|1@1+ (1,0) [0|1] "bool" MCU
 SG_ OBJ_Angle_Bottom_V_2 : 2414|1@1+ (1,0) [0|1] "bool" MCU
 SG_ OBJ_Angle_Bottom_2 : 2415|14@1+ (0.0002,-1.571) [-1.571|1.571] "rad" MCU
 SG_ Reserved_19_2 : 2429|3@1+ (1,0) [0|0] "NA" MCU
 SG_ OBJ_Angle_Bottom_STD_2 : 2432|13@1+ (0.0002,0) [0|1.571] "rad" MCU
 SG_ OBJ_Angle_Bottom_STD_V_2 : 2445|1@1+ (1,0) [0|1] "bool" MCU
 SG_ OBJ_Visibility_Side_V_2 : 2446|1@1+ (1,0) [0|1] "Bool" MCU
 SG_ OBJ_Visibility_Side_2 : 2447|2@1+ (1,0) [0|2] "ENUM" MCU
 SG_ OBJ_Is_In_Drivable_Area_2 : 2449|1@1+ (1,0) [0|1] "bool" MCU
 SG_ OBJ_Is_In_Drivable_Area_V_2 : 2450|1@1+ (1,0) [0|1] "bool" MCU
 SG_ OBJ_Is_VeryClose_2 : 2451|1@1+ (1,0) [0|1] "bool" MCU
 SG_ OBJ_Is_VeryClose_V_2 : 2452|1@1+ (1,0) [0|1] "bool" MCU
 SG_ OBJ_Occlusion_RL_2 : 2453|2@1+ (1,0) [0|2] "ENUM" MCU
 SG_ OBJ_Occlusion_RR_2 : 2455|2@1+ (1,0) [0|2] "ENUM" MCU
 SG_ OBJ_Occlusion_FR_2 : 2457|2@1+ (1,0) [0|2] "ENUM" MCU
 SG_ OBJ_Occlusion_FL_2 : 2459|2@1+ (1,0) [0|2] "ENUM" MCU
 SG_ OBJ_Buffer_2 : 2461|3@1+ (1,0) [0|0] "NA" MCU
 SG_ OBJ_CRC_3 : 2464|32@1+ (1,0) [0|4294967295] "NA" MCU
 SG_ OBJ_ID_3 : 2496|8@1+ (1,0) [0|255] "counter" MCU
 SG_ OBJ_Existence_Probability_3 : 2504|8@1+ (0.01,0) [0|1] "NA" MCU
 SG_ OBJ_Fusion_Source_3 : 2512|16@1+ (1,0) [0|65535] "BITWIZE" MCU
 SG_ OBJ_Triggered_SDM_3 : 2528|2@1+ (1,0) [0|2] "ENUM " MCU
 SG_ OBJ_Motion_Category_3 : 2530|4@1+ (1,0) [0|13] "ENUM " MCU
 SG_ OBJ_Buffer_C0_3 : 2534|7@1+ (1,0) [0|127] "NA" MCU
 SG_ OBJ_Object_Age_3 : 2541|11@1+ (1,0) [0|2047] "Frames" MCU
 SG_ OBJ_Measuring_Status_3 : 2552|3@1+ (1,0) [0|7] "BITWIZE" MCU
 SG_ OBJ_Object_Class_3 : 2555|4@1+ (1,0) [0|8] "ENUM" MCU
 SG_ Reserved_3_3 : 2559|1@1+ (1,0) [0|0] "NA" MCU
 SG_ OBJ_Class_Probability_3 : 2560|7@1+ (0.01,0) [0|1] "NA" MCU
 SG_ OBJ_Buffer_C1_3 : 2567|7@1+ (1,0) [0|127] "NA" MCU
 SG_ OBJ_Buffer_C2_3 : 2574|7@1+ (1,0) [0|127] "NA" MCU
 SG_ OBJ_Buffer_C3_3 : 2581|7@1+ (1,0) [0|127] "NA" MCU
 SG_ OBJ_Camera_Source_3 : 2588|4@1+ (1,0) [0|15] "ENUM" MCU
 SG_ OBJ_Motion_Status_3 : 2592|3@1+ (1,0) [0|5] "ENUM " MCU
 SG_ OBJ_Motion_Orientation_3 : 2595|4@1+ (1,0) [0|13] "ENUM " MCU
 SG_ OBJ_Has_Cut_Lane_3 : 2599|1@1+ (1,0) [0|1] "bool" MCU
 SG_ OBJ_Has_Cut_Path_3 : 2600|1@1+ (1,0) [0|1] "bool" MCU
 SG_ OBJ_Brake_Light_3 : 2601|1@1+ (1,0) [0|1] "bool" MCU
 SG_ OBJ_Turn_Indicator_Right_3 : 2602|1@1+ (1,0) [0|1] "bool" MCU
 SG_ OBJ_Turn_Indicator_Left_3 : 2603|1@1+ (1,0) [0|1] "bool" MCU
 SG_ OBJ_Light_Indicator_Validity_3 : 2604|1@1+ (1,0) [0|1] "bool" MCU
 SG_ OBJ_Right_Out_Of_Image_3 : 2605|1@1+ (1,0) [0|1] "bool" MCU
 SG_ OBJ_Left_Out_Of_Image_3 : 2606|1@1+ (1,0) [0|1] "bool" MCU
 SG_ OBJ_Right_Out_Of_Image_V_3 : 2607|1@1+ (1,0) [0|1] "bool" MCU
 SG_ OBJ_Left_Out_Of_Image_V_3 : 2608|1@1+ (1,0) [0|1] "bool" MCU
 SG_ OBJ_Top_Out_Of_Image_3 : 2609|1@1+ (1,0) [0|1] "bool" MCU
 SG_ OBJ_Bottom_Out_Of_Image_3 : 2610|1@1+ (1,0) [0|1] "bool" MCU
 SG_ OBJ_Top_Out_Of_Image_V_3 : 2611|1@1+ (1,0) [0|1] "bool" MCU
 SG_ OBJ_Bottom_Out_Of_Image_V_3 : 2612|1@1+ (1,0) [0|1] "bool" MCU
 SG_ OBJ_Lane_Assignment_3 : 2613|3@1+ (1,0) [0|5] "ENUM" MCU
 SG_ OBJ_Lane_Assignment_V_3 : 2616|1@1+ (1,0) [0|1] "bool" MCU
 SG_ OBJ_Age_Seconds_3 : 2617|7@1+ (1,0) [0|100] "s" MCU
 SG_ OBJ_Age_Seconds_V_3 : 2624|1@1+ (1,0) [0|1] "bool" MCU
 SG_ OBJ_Width_3 : 2625|9@1+ (0.01,0) [0.4|2.95] "m" MCU
 SG_ OBJ_Width_V_3 : 2634|1@1+ (1,0) [0|1] "bool" MCU
 SG_ OBJ_Width_STD_3 : 2635|8@1+ (0.01,0) [0|2] "m" MCU
 SG_ OBJ_Width_STD_V_3 : 2643|1@1+ (1,0) [0|1] "bool" MCU
 SG_ OBJ_Length_3 : 2644|9@1+ (0.05,0) [1.2|21] "m" MCU
 SG_ OBJ_Length_V_3 : 2653|1@1+ (1,0) [0|1] "bool" MCU
 SG_ Reserved_4_3 : 2654|2@1+ (1,0) [0|0] "NA" MCU
 SG_ OBJ_Length_STD_3 : 2656|8@1+ (0.05,0) [0|10] "m" MCU
 SG_ OBJ_Length_STD_V_3 : 2664|1@1+ (1,0) [0|1] "bool" MCU
 SG_ OBJ_Height_3 : 2665|9@1+ (0.01,0) [0|2.95] "m" MCU
 SG_ OBJ_Height_V_3 : 2674|1@1+ (1,0) [0|1] "bool" MCU
 SG_ OBJ_Height_STD_3 : 2675|8@1+ (0.01,0) [0|2] "m" MCU
 SG_ OBJ_Height_STD_V_3 : 2683|1@1+ (1,0) [0|1] "bool" MCU
 SG_ Reserved_5_3 : 2684|4@1+ (1,0) [0|0] "NA" MCU
 SG_ OBJ_Abs_Long_Velocity_3 : 2688|12@1+ (0.05,-30) [-30|100] "MPS" MCU
 SG_ OBJ_Abs_Long_Velocity_V_3 : 2700|1@1+ (1,0) [0|1] "bool" MCU
 SG_ OBJ_Abs_Long_Velocity_STD_3 : 2701|11@1+ (0.05,0) [0|65] "MPS" MCU
 SG_ OBJ_Abs_Long_Vel_STD_V_3 : 2712|1@1+ (1,0) [0|1] "bool" MCU
 SG_ Reserved_6_3 : 2713|7@1+ (1,0) [0|0] "NA" MCU
 SG_ OBJ_Abs_Lat_Velocity_3 : 2720|11@1+ (0.05,-50) [-50|50] "MPS" MCU
 SG_ OBJ_Abs_Lat_Velocity_V_3 : 2731|1@1+ (1,0) [0|1] "bool" MCU
 SG_ OBJ_Abs_Lat_Velocity_STD_3 : 2732|10@1+ (0.05,0) [0|50] "MPS" MCU
 SG_ OBJ_Abs_Lat_Vel_STD_V_3 : 2742|1@1+ (1,0) [0|1] "bool" MCU
 SG_ OBJ_Abs_Long_Acc_3 : 2743|9@1+ (0.05,-10.3) [-10.3|7.3] "MPS2" MCU
 SG_ OBJ_Abs_Long_Acc_V_3 : 2752|1@1+ (1,0) [0|1] "bool" MCU
 SG_ OBJ_Abs_Long_Acc_STD_3 : 2753|8@1+ (0.05,0) [0|7.3] "MPS2" MCU
 SG_ OBJ_Abs_Long_Acc_STD_V_3 : 2761|1@1+ (1,0) [0|1] "bool" MCU
 SG_ OBJ_Abs_Lat_Acc_3 : 2762|9@1+ (0.05,-10.3) [-10.3|7.3] "MPS2" MCU
 SG_ OBJ_Abs_Lat_Acc_V_3 : 2771|1@1+ (1,0) [0|1] "bool" MCU
 SG_ OBJ_Abs_Lat_Acc_STD_3 : 2772|8@1+ (0.05,0) [0|7.3] "MPS2" MCU
 SG_ OBJ_Abs_Lat_Acc_STD_V_3 : 2780|1@1+ (1,0) [0|1] "bool" MCU
 SG_ Reserved_7_3 : 2781|3@1+ (1,0) [0|0] "NA" MCU
 SG_ OBJ_Abs_Acceleration_3 : 2784|9@1+ (0.05,-10.3) [-10.3|7.3] "MPS2" MCU
 SG_ OBJ_Abs_Acceleration_V_3 : 2793|1@1+ (1,0) [0|1] "bool" MCU
 SG_ OBJ_Abs_Acc_STD_3 : 2794|8@1+ (0.05,0) [0|7.3] "MPS2" MCU
 SG_ OBJ_Abs_Acc_STD_V_3 : 2802|1@1+ (1,0) [0|1] "bool" MCU
 SG_ OBJ_Inv_TTC_3 : 2803|11@1+ (0.01,-8) [-8|8] "INV(s)" MCU
 SG_ OBJ_Inv_TTC_V_3 : 2814|1@1+ (1,0) [0|1] "bool" MCU
 SG_ Reserved_8_3 : 2815|1@1+ (1,0) [0|0] "NA" MCU
 SG_ OBJ_Inv_TTC_STD_3 : 2816|11@1+ (0.01,0) [0|4] "INV(s)" MCU
 SG_ OBJ_Inv_TTC_STD_V_3 : 2827|1@1+ (1,0) [0|1] "bool" MCU
 SG_ OBJ_Relative_Long_Acc_3 : 2828|9@1+ (0.05,-10.3) [-10.3|7.3] "MPS2" MCU
 SG_ OBJ_Relative_Long_Acc_V_3 : 2837|1@1+ (1,0) [0|1] "bool" MCU
 SG_ OBJ_Relative_Long_Acc_STD_3 : 2838|8@1+ (0.05,0) [0|7.3] "MPS2" MCU
 SG_ OBJ_Rel_Long_Acc_STD_V_3 : 2846|1@1+ (1,0) [0|1] "bool" MCU
 SG_ Reserved_9_3 : 2847|1@1+ (1,0) [0|0] "NA" MCU
 SG_ OBJ_Relative_Long_Velocity_3 : 2848|13@1+ (0.05,-120) [-120|130] "MPS" MCU
 SG_ OBJ_Relative_Long_Velocity_V_3 : 2861|1@1+ (1,0) [0|1] "bool" MCU
 SG_ OBJ_Relative_Long_Vel_STD_3 : 2862|12@1+ (0.05,0) [0|130] "MPS" MCU
 SG_ OBJ_Rel_Long_Vel_STD_V_3 : 2874|1@1+ (1,0) [0|1] "bool" MCU
 SG_ Reserved_10_3 : 2875|5@1+ (1,0) [0|0] "NA" MCU
 SG_ OBJ_Relative_Lat_Velocity_3 : 2880|11@1+ (0.05,-50) [-50|50] "MPS" MCU
 SG_ OBJ_Relative_Lat_Velocity_V_3 : 2891|1@1+ (1,0) [0|1] "bool" MCU
 SG_ OBJ_Relative_Lat_Velocity_STD_3 : 2892|10@1+ (0.05,0) [0|50] "MPS" MCU
 SG_ OBJ_Rel_Lat_Vel_STD_V_3 : 2902|1@1+ (1,0) [0|1] "bool" MCU
 SG_ Reserved_11_3 : 2903|9@1+ (1,0) [0|0] "NA" MCU
 SG_ OBJ_Long_Distance_3 : 2912|14@1+ (0.05,-200) [-200|250] "m" MCU
 SG_ OBJ_Long_Distance_V_3 : 2926|1@1+ (1,0) [0|1] "bool" MCU
 SG_ OBJ_Long_Distance_STD_3 : 2927|13@1+ (0.05,0) [0|250] "m" MCU
 SG_ OBJ_Long_Distance_STD_V_3 : 2940|1@1+ (1,0) [0|1] "bool" MCU
 SG_ Reserved_12_3 : 2941|3@1+ (1,0) [0|0] "NA" MCU
 SG_ OBJ_Lat_Distance_3 : 2944|12@1+ (0.05,-100) [-100|100] "m" MCU
 SG_ OBJ_Lat_Distance_V_3 : 2956|1@1+ (1,0) [0|1] "bool" MCU
 SG_ OBJ_Lat_Distance_STD_3 : 2957|11@1+ (0.05,0) [0|100] "m" MCU
 SG_ OBJ_Lat_Distance_STD_V_3 : 2968|1@1+ (1,0) [0|1] "bool" MCU
 SG_ Reserved_13_3 : 2969|7@1+ (1,0) [0|0] "NA" MCU
 SG_ OBJ_Absolute_Speed_3 : 2976|12@1+ (0.05,-65) [-65|65] "MPS" MCU
 SG_ OBJ_Absolute_Speed_V_3 : 2988|1@1+ (1,0) [0|1] "bool" MCU
 SG_ OBJ_Absolute_Speed_STD_3 : 2989|11@1+ (0.05,0) [0|65] "MPS" MCU
 SG_ OBJ_Absolute_Speed_STD_V_3 : 3000|1@1+ (1,0) [0|1] "bool" MCU
 SG_ Reserved_14_3 : 3001|7@1+ (1,0) [0|0] "NA" MCU
 SG_ OBJ_Heading_3 : 3008|10@1+ (0.01,-3.14) [-3.14|3.14] "rad" MCU
 SG_ OBJ_Heading_V_3 : 3018|1@1+ (1,0) [0|1] "bool" MCU
 SG_ OBJ_Heading_STD_3 : 3019|9@1+ (0.01,0) [0|3.14] "rad" MCU
 SG_ OBJ_Heading_STD_V_3 : 3028|1@1+ (1,0) [0|1] "bool" MCU
 SG_ OBJ_Angle_Rate_STD_3 : 3029|11@1+ (0.002,0) [0|2.2318] "RPS" MCU
 SG_ OBJ_Angle_Rate_STD_V_3 : 3040|1@1+ (1,0) [0|1] "bool" MCU
 SG_ OBJ_Angle_Rate_3 : 3041|12@1+ (0.002,-2.234) [-2.234|2.2318] "RPS" MCU
 SG_ OBJ_Angle_Rate_V_3 : 3053|1@1+ (1,0) [0|1] "bool" MCU
 SG_ OBJ_Angle_Right_3 : 3054|14@1+ (0.0002,-1.571) [-1.571|1.571] "rad " MCU
 SG_ OBJ_Angle_Right_V_3 : 3068|1@1+ (1,0) [0|1] "bool" MCU
 SG_ Reserved_15_3 : 3069|3@1+ (1,0) [0|0] "NA" MCU
 SG_ OBJ_Angle_Right_STD_3 : 3072|13@1+ (0.0002,0) [0|1.571] "rad " MCU
 SG_ OBJ_Angle_Right_STD_V_3 : 3085|1@1+ (1,0) [0|1] "bool" MCU
 SG_ OBJ_Angle_Left_3 : 3086|14@1+ (0.0002,-1.571) [-1.571|1.571] "rad " MCU
 SG_ OBJ_Angle_Left_V_3 : 3100|1@1+ (1,0) [0|1] "bool" MCU
 SG_ Reserved_16_3 : 3101|3@1+ (1,0) [0|0] "NA" MCU
 SG_ OBJ_Angle_Left_STD_3 : 3104|13@1+ (0.0002,0) [0|1.571] "rad" MCU
 SG_ OBJ_Angle_Left_STD_V_3 : 3117|1@1+ (1,0) [0|1] "bool" MCU
 SG_ OBJ_Angle_Side_3 : 3118|14@1+ (0.0002,-1.571) [-1.571|1.571] "rad" MCU
 SG_ OBJ_Angle_Side_V_3 : 3132|1@1+ (1,0) [0|1] "bool" MCU
 SG_ Reserved_17_3 : 3133|3@1+ (1,0) [0|0] "NA" MCU
 SG_ OBJ_Angle_Side_STD_3 : 3136|13@1+ (0.0002,0) [0|1.571] "rad" MCU
 SG_ OBJ_Angle_Side_STD_V_3 : 3149|1@1+ (1,0) [0|1] "bool" MCU
 SG_ OBJ_Angle_Mid_V_3 : 3150|1@1+ (1,0) [0|1] "bool" MCU
 SG_ OBJ_Angle_Mid_3 : 3151|14@1+ (0.0002,-1.571) [-1.571|1.571] "rad" MCU
 SG_ Reserved_18_3 : 3165|3@1+ (1,0) [0|0] "NA" MCU
 SG_ OBJ_Angle_Mid_STD_3 : 3168|13@1+ (0.0002,0) [0|1.571] "rad" MCU
 SG_ OBJ_Angle_Mid_STD_V_3 : 3181|1@1+ (1,0) [0|1] "bool" MCU
 SG_ OBJ_Angle_Bottom_V_3 : 3182|1@1+ (1,0) [0|1] "bool" MCU
 SG_ OBJ_Angle_Bottom_3 : 3183|14@1+ (0.0002,-1.571) [-1.571|1.571] "rad" MCU
 SG_ Reserved_19_3 : 3197|3@1+ (1,0) [0|0] "NA" MCU
 SG_ OBJ_Angle_Bottom_STD_3 : 3200|13@1+ (0.0002,0) [0|1.571] "rad" MCU
 SG_ OBJ_Angle_Bottom_STD_V_3 : 3213|1@1+ (1,0) [0|1] "bool" MCU
 SG_ OBJ_Visibility_Side_V_3 : 3214|1@1+ (1,0) [0|1] "Bool" MCU
 SG_ OBJ_Visibility_Side_3 : 3215|2@1+ (1,0) [0|2] "ENUM" MCU
 SG_ OBJ_Is_In_Drivable_Area_3 : 3217|1@1+ (1,0) [0|1] "bool" MCU
 SG_ OBJ_Is_In_Drivable_Area_V_3 : 3218|1@1+ (1,0) [0|1] "bool" MCU
 SG_ OBJ_Is_VeryClose_3 : 3219|1@1+ (1,0) [0|1] "bool" MCU
 SG_ OBJ_Is_VeryClose_V_3 : 3220|1@1+ (1,0) [0|1] "bool" MCU
 SG_ OBJ_Occlusion_RL_3 : 3221|2@1+ (1,0) [0|2] "ENUM" MCU
 SG_ OBJ_Occlusion_RR_3 : 3223|2@1+ (1,0) [0|2] "ENUM" MCU
 SG_ OBJ_Occlusion_FR_3 : 3225|2@1+ (1,0) [0|2] "ENUM" MCU
 SG_ OBJ_Occlusion_FL_3 : 3227|2@1+ (1,0) [0|2] "ENUM" MCU
 SG_ OBJ_Buffer_3 : 3229|3@1+ (1,0) [0|0] "NA" MCU
 SG_ OBJ_CRC_4 : 3232|32@1+ (1,0) [0|4294967295] "NA" MCU
 SG_ OBJ_ID_4 : 3264|8@1+ (1,0) [0|255] "counter" MCU
 SG_ OBJ_Existence_Probability_4 : 3272|8@1+ (0.01,0) [0|1] "NA" MCU
 SG_ OBJ_Fusion_Source_4 : 3280|16@1+ (1,0) [0|65535] "BITWIZE" MCU
 SG_ OBJ_Triggered_SDM_4 : 3296|2@1+ (1,0) [0|2] "ENUM " MCU
 SG_ OBJ_Motion_Category_4 : 3298|4@1+ (1,0) [0|13] "ENUM " MCU
 SG_ OBJ_Buffer_C0_4 : 3302|7@1+ (1,0) [0|127] "NA" MCU
 SG_ OBJ_Object_Age_4 : 3309|11@1+ (1,0) [0|2047] "Frames" MCU
 SG_ OBJ_Measuring_Status_4 : 3320|3@1+ (1,0) [0|7] "BITWIZE" MCU
 SG_ OBJ_Object_Class_4 : 3323|4@1+ (1,0) [0|8] "ENUM" MCU
 SG_ Reserved_3_4 : 3327|1@1+ (1,0) [0|0] "NA" MCU
 SG_ OBJ_Class_Probability_4 : 3328|7@1+ (0.01,0) [0|1] "NA" MCU
 SG_ OBJ_Buffer_C1_4 : 3335|7@1+ (1,0) [0|127] "NA" MCU
 SG_ OBJ_Buffer_C2_4 : 3342|7@1+ (1,0) [0|127] "NA" MCU
 SG_ OBJ_Buffer_C3_4 : 3349|7@1+ (1,0) [0|127] "NA" MCU
 SG_ OBJ_Camera_Source_4 : 3356|4@1+ (1,0) [0|15] "ENUM" MCU
 SG_ OBJ_Motion_Status_4 : 3360|3@1+ (1,0) [0|5] "ENUM " MCU
 SG_ OBJ_Motion_Orientation_4 : 3363|4@1+ (1,0) [0|13] "ENUM " MCU
 SG_ OBJ_Has_Cut_Lane_4 : 3367|1@1+ (1,0) [0|1] "bool" MCU
 SG_ OBJ_Has_Cut_Path_4 : 3368|1@1+ (1,0) [0|1] "bool" MCU
 SG_ OBJ_Brake_Light_4 : 3369|1@1+ (1,0) [0|1] "bool" MCU
 SG_ OBJ_Turn_Indicator_Right_4 : 3370|1@1+ (1,0) [0|1] "bool" MCU
 SG_ OBJ_Turn_Indicator_Left_4 : 3371|1@1+ (1,0) [0|1] "bool" MCU
 SG_ OBJ_Light_Indicator_Validity_4 : 3372|1@1+ (1,0) [0|1] "bool" MCU
 SG_ OBJ_Right_Out_Of_Image_4 : 3373|1@1+ (1,0) [0|1] "bool" MCU
 SG_ OBJ_Left_Out_Of_Image_4 : 3374|1@1+ (1,0) [0|1] "bool" MCU
 SG_ OBJ_Right_Out_Of_Image_V_4 : 3375|1@1+ (1,0) [0|1] "bool" MCU
 SG_ OBJ_Left_Out_Of_Image_V_4 : 3376|1@1+ (1,0) [0|1] "bool" MCU
 SG_ OBJ_Top_Out_Of_Image_4 : 3377|1@1+ (1,0) [0|1] "bool" MCU
 SG_ OBJ_Bottom_Out_Of_Image_4 : 3378|1@1+ (1,0) [0|1] "bool" MCU
 SG_ OBJ_Top_Out_Of_Image_V_4 : 3379|1@1+ (1,0) [0|1] "bool" MCU
 SG_ OBJ_Bottom_Out_Of_Image_V_4 : 3380|1@1+ (1,0) [0|1] "bool" MCU
 SG_ OBJ_Lane_Assignment_4 : 3381|3@1+ (1,0) [0|5] "ENUM" MCU
 SG_ OBJ_Lane_Assignment_V_4 : 3384|1@1+ (1,0) [0|1] "bool" MCU
 SG_ OBJ_Age_Seconds_4 : 3385|7@1+ (1,0) [0|100] "s" MCU
 SG_ OBJ_Age_Seconds_V_4 : 3392|1@1+ (1,0) [0|1] "bool" MCU
 SG_ OBJ_Width_4 : 3393|9@1+ (0.01,0) [0.4|2.95] "m" MCU
 SG_ OBJ_Width_V_4 : 3402|1@1+ (1,0) [0|1] "bool" MCU
 SG_ OBJ_Width_STD_4 : 3403|8@1+ (0.01,0) [0|2] "m" MCU
 SG_ OBJ_Width_STD_V_4 : 3411|1@1+ (1,0) [0|1] "bool" MCU
 SG_ OBJ_Length_4 : 3412|9@1+ (0.05,0) [1.2|21] "m" MCU
 SG_ OBJ_Length_V_4 : 3421|1@1+ (1,0) [0|1] "bool" MCU
 SG_ Reserved_4_4 : 3422|2@1+ (1,0) [0|0] "NA" MCU
 SG_ OBJ_Length_STD_4 : 3424|8@1+ (0.05,0) [0|10] "m" MCU
 SG_ OBJ_Length_STD_V_4 : 3432|1@1+ (1,0) [0|1] "bool" MCU
 SG_ OBJ_Height_4 : 3433|9@1+ (0.01,0) [0|2.95] "m" MCU
 SG_ OBJ_Height_V_4 : 3442|1@1+ (1,0) [0|1] "bool" MCU
 SG_ OBJ_Height_STD_4 : 3443|8@1+ (0.01,0) [0|2] "m" MCU
 SG_ OBJ_Height_STD_V_4 : 3451|1@1+ (1,0) [0|1] "bool" MCU
 SG_ Reserved_5_4 : 3452|4@1+ (1,0) [0|0] "NA" MCU
 SG_ OBJ_Abs_Long_Velocity_4 : 3456|12@1+ (0.05,-30) [-30|100] "MPS" MCU
 SG_ OBJ_Abs_Long_Velocity_V_4 : 3468|1@1+ (1,0) [0|1] "bool" MCU
 SG_ OBJ_Abs_Long_Velocity_STD_4 : 3469|11@1+ (0.05,0) [0|65] "MPS" MCU
 SG_ OBJ_Abs_Long_Vel_STD_V_4 : 3480|1@1+ (1,0) [0|1] "bool" MCU
 SG_ Reserved_6_4 : 3481|7@1+ (1,0) [0|0] "NA" MCU
 SG_ OBJ_Abs_Lat_Velocity_4 : 3488|11@1+ (0.05,-50) [-50|50] "MPS" MCU
 SG_ OBJ_Abs_Lat_Velocity_V_4 : 3499|1@1+ (1,0) [0|1] "bool" MCU
 SG_ OBJ_Abs_Lat_Velocity_STD_4 : 3500|10@1+ (0.05,0) [0|50] "MPS" MCU
 SG_ OBJ_Abs_Lat_Vel_STD_V_4 : 3510|1@1+ (1,0) [0|1] "bool" MCU
 SG_ OBJ_Abs_Long_Acc_4 : 3511|9@1+ (0.05,-10.3) [-10.3|7.3] "MPS2" MCU
 SG_ OBJ_Abs_Long_Acc_V_4 : 3520|1@1+ (1,0) [0|1] "bool" MCU
 SG_ OBJ_Abs_Long_Acc_STD_4 : 3521|8@1+ (0.05,0) [0|7.3] "MPS2" MCU
 SG_ OBJ_Abs_Long_Acc_STD_V_4 : 3529|1@1+ (1,0) [0|1] "bool" MCU
 SG_ OBJ_Abs_Lat_Acc_4 : 3530|9@1+ (0.05,-10.3) [-10.3|7.3] "MPS2" MCU
 SG_ OBJ_Abs_Lat_Acc_V_4 : 3539|1@1+ (1,0) [0|1] "bool" MCU
 SG_ OBJ_Abs_Lat_Acc_STD_4 : 3540|8@1+ (0.05,0) [0|7.3] "MPS2" MCU
 SG_ OBJ_Abs_Lat_Acc_STD_V_4 : 3548|1@1+ (1,0) [0|1] "bool" MCU
 SG_ Reserved_7_4 : 3549|3@1+ (1,0) [0|0] "NA" MCU
 SG_ OBJ_Abs_Acceleration_4 : 3552|9@1+ (0.05,-10.3) [-10.3|7.3] "MPS2" MCU
 SG_ OBJ_Abs_Acceleration_V_4 : 3561|1@1+ (1,0) [0|1] "bool" MCU
 SG_ OBJ_Abs_Acc_STD_4 : 3562|8@1+ (0.05,0) [0|7.3] "MPS2" MCU
 SG_ OBJ_Abs_Acc_STD_V_4 : 3570|1@1+ (1,0) [0|1] "bool" MCU
 SG_ OBJ_Inv_TTC_4 : 3571|11@1+ (0.01,-8) [-8|8] "INV(s)" MCU
 SG_ OBJ_Inv_TTC_V_4 : 3582|1@1+ (1,0) [0|1] "bool" MCU
 SG_ Reserved_8_4 : 3583|1@1+ (1,0) [0|0] "NA" MCU
 SG_ OBJ_Inv_TTC_STD_4 : 3584|11@1+ (0.01,0) [0|4] "INV(s)" MCU
 SG_ OBJ_Inv_TTC_STD_V_4 : 3595|1@1+ (1,0) [0|1] "bool" MCU
 SG_ OBJ_Relative_Long_Acc_4 : 3596|9@1+ (0.05,-10.3) [-10.3|7.3] "MPS2" MCU
 SG_ OBJ_Relative_Long_Acc_V_4 : 3605|1@1+ (1,0) [0|1] "bool" MCU
 SG_ OBJ_Relative_Long_Acc_STD_4 : 3606|8@1+ (0.05,0) [0|7.3] "MPS2" MCU
 SG_ OBJ_Rel_Long_Acc_STD_V_4 : 3614|1@1+ (1,0) [0|1] "bool" MCU
 SG_ Reserved_9_4 : 3615|1@1+ (1,0) [0|0] "NA" MCU
 SG_ OBJ_Relative_Long_Velocity_4 : 3616|13@1+ (0.05,-120) [-120|130] "MPS" MCU
 SG_ OBJ_Relative_Long_Velocity_V_4 : 3629|1@1+ (1,0) [0|1] "bool" MCU
 SG_ OBJ_Relative_Long_Vel_STD_4 : 3630|12@1+ (0.05,0) [0|130] "MPS" MCU
 SG_ OBJ_Rel_Long_Vel_STD_V_4 : 3642|1@1+ (1,0) [0|1] "bool" MCU
 SG_ Reserved_10_4 : 3643|5@1+ (1,0) [0|0] "NA" MCU
 SG_ OBJ_Relative_Lat_Velocity_4 : 3648|11@1+ (0.05,-50) [-50|50] "MPS" MCU
 SG_ OBJ_Relative_Lat_Velocity_V_4 : 3659|1@1+ (1,0) [0|1] "bool" MCU
 SG_ OBJ_Relative_Lat_Velocity_STD_4 : 3660|10@1+ (0.05,0) [0|50] "MPS" MCU
 SG_ OBJ_Rel_Lat_Vel_STD_V_4 : 3670|1@1+ (1,0) [0|1] "bool" MCU
 SG_ Reserved_11_4 : 3671|9@1+ (1,0) [0|0] "NA" MCU
 SG_ OBJ_Long_Distance_4 : 3680|14@1+ (0.05,-200) [-200|250] "m" MCU
 SG_ OBJ_Long_Distance_V_4 : 3694|1@1+ (1,0) [0|1] "bool" MCU
 SG_ OBJ_Long_Distance_STD_4 : 3695|13@1+ (0.05,0) [0|250] "m" MCU
 SG_ OBJ_Long_Distance_STD_V_4 : 3708|1@1+ (1,0) [0|1] "bool" MCU
 SG_ Reserved_12_4 : 3709|3@1+ (1,0) [0|0] "NA" MCU
 SG_ OBJ_Lat_Distance_4 : 3712|12@1+ (0.05,-100) [-100|100] "m" MCU
 SG_ OBJ_Lat_Distance_V_4 : 3724|1@1+ (1,0) [0|1] "bool" MCU
 SG_ OBJ_Lat_Distance_STD_4 : 3725|11@1+ (0.05,0) [0|100] "m" MCU
 SG_ OBJ_Lat_Distance_STD_V_4 : 3736|1@1+ (1,0) [0|1] "bool" MCU
 SG_ Reserved_13_4 : 3737|7@1+ (1,0) [0|0] "NA" MCU
 SG_ OBJ_Absolute_Speed_4 : 3744|12@1+ (0.05,-65) [-65|65] "MPS" MCU
 SG_ OBJ_Absolute_Speed_V_4 : 3756|1@1+ (1,0) [0|1] "bool" MCU
 SG_ OBJ_Absolute_Speed_STD_4 : 3757|11@1+ (0.05,0) [0|65] "MPS" MCU
 SG_ OBJ_Absolute_Speed_STD_V_4 : 3768|1@1+ (1,0) [0|1] "bool" MCU
 SG_ Reserved_14_4 : 3769|7@1+ (1,0) [0|0] "NA" MCU
 SG_ OBJ_Heading_4 : 3776|10@1+ (0.01,-3.14) [-3.14|3.14] "rad" MCU
 SG_ OBJ_Heading_V_4 : 3786|1@1+ (1,0) [0|1] "bool" MCU
 SG_ OBJ_Heading_STD_4 : 3787|9@1+ (0.01,0) [0|3.14] "rad" MCU
 SG_ OBJ_Heading_STD_V_4 : 3796|1@1+ (1,0) [0|1] "bool" MCU
 SG_ OBJ_Angle_Rate_STD_4 : 3797|11@1+ (0.002,0) [0|2.2318] "RPS" MCU
 SG_ OBJ_Angle_Rate_STD_V_4 : 3808|1@1+ (1,0) [0|1] "bool" MCU
 SG_ OBJ_Angle_Rate_4 : 3809|12@1+ (0.002,-2.234) [-2.234|2.2318] "RPS" MCU
 SG_ OBJ_Angle_Rate_V_4 : 3821|1@1+ (1,0) [0|1] "bool" MCU
 SG_ OBJ_Angle_Right_4 : 3822|14@1+ (0.0002,-1.571) [-1.571|1.571] "rad " MCU
 SG_ OBJ_Angle_Right_V_4 : 3836|1@1+ (1,0) [0|1] "bool" MCU
 SG_ Reserved_15_4 : 3837|3@1+ (1,0) [0|0] "NA" MCU
 SG_ OBJ_Angle_Right_STD_4 : 3840|13@1+ (0.0002,0) [0|1.571] "rad " MCU
 SG_ OBJ_Angle_Right_STD_V_4 : 3853|1@1+ (1,0) [0|1] "bool" MCU
 SG_ OBJ_Angle_Left_4 : 3854|14@1+ (0.0002,-1.571) [-1.571|1.571] "rad " MCU
 SG_ OBJ_Angle_Left_V_4 : 3868|1@1+ (1,0) [0|1] "bool" MCU
 SG_ Reserved_16_4 : 3869|3@1+ (1,0) [0|0] "NA" MCU
 SG_ OBJ_Angle_Left_STD_4 : 3872|13@1+ (0.0002,0) [0|1.571] "rad" MCU
 SG_ OBJ_Angle_Left_STD_V_4 : 3885|1@1+ (1,0) [0|1] "bool" MCU
 SG_ OBJ_Angle_Side_4 : 3886|14@1+ (0.0002,-1.571) [-1.571|1.571] "rad" MCU
 SG_ OBJ_Angle_Side_V_4 : 3900|1@1+ (1,0) [0|1] "bool" MCU
 SG_ Reserved_17_4 : 3901|3@1+ (1,0) [0|0] "NA" MCU
 SG_ OBJ_Angle_Side_STD_4 : 3904|13@1+ (0.0002,0) [0|1.571] "rad" MCU
 SG_ OBJ_Angle_Side_STD_V_4 : 3917|1@1+ (1,0) [0|1] "bool" MCU
 SG_ OBJ_Angle_Mid_V_4 : 3918|1@1+ (1,0) [0|1] "bool" MCU
 SG_ OBJ_Angle_Mid_4 : 3919|14@1+ (0.0002,-1.571) [-1.571|1.571] "rad" MCU
 SG_ Reserved_18_4 : 3933|3@1+ (1,0) [0|0] "NA" MCU
 SG_ OBJ_Angle_Mid_STD_4 : 3936|13@1+ (0.0002,0) [0|1.571] "rad" MCU
 SG_ OBJ_Angle_Mid_STD_V_4 : 3949|1@1+ (1,0) [0|1] "bool" MCU
 SG_ OBJ_Angle_Bottom_V_4 : 3950|1@1+ (1,0) [0|1] "bool" MCU
 SG_ OBJ_Angle_Bottom_4 : 3951|14@1+ (0.0002,-1.571) [-1.571|1.571] "rad" MCU
 SG_ Reserved_19_4 : 3965|3@1+ (1,0) [0|0] "NA" MCU
 SG_ OBJ_Angle_Bottom_STD_4 : 3968|13@1+ (0.0002,0) [0|1.571] "rad" MCU
 SG_ OBJ_Angle_Bottom_STD_V_4 : 3981|1@1+ (1,0) [0|1] "bool" MCU
 SG_ OBJ_Visibility_Side_V_4 : 3982|1@1+ (1,0) [0|1] "Bool" MCU
 SG_ OBJ_Visibility_Side_4 : 3983|2@1+ (1,0) [0|2] "ENUM" MCU
 SG_ OBJ_Is_In_Drivable_Area_4 : 3985|1@1+ (1,0) [0|1] "bool" MCU
 SG_ OBJ_Is_In_Drivable_Area_V_4 : 3986|1@1+ (1,0) [0|1] "bool" MCU
 SG_ OBJ_Is_VeryClose_4 : 3987|1@1+ (1,0) [0|1] "bool" MCU
 SG_ OBJ_Is_VeryClose_V_4 : 3988|1@1+ (1,0) [0|1] "bool" MCU
 SG_ OBJ_Occlusion_RL_4 : 3989|2@1+ (1,0) [0|2] "ENUM" MCU
 SG_ OBJ_Occlusion_RR_4 : 3991|2@1+ (1,0) [0|2] "ENUM" MCU
 SG_ OBJ_Occlusion_FR_4 : 3993|2@1+ (1,0) [0|2] "ENUM" MCU
 SG_ OBJ_Occlusion_FL_4 : 3995|2@1+ (1,0) [0|2] "ENUM" MCU
 SG_ OBJ_Buffer_4 : 3997|3@1+ (1,0) [0|0] "NA" MCU
 SG_ OBJ_CRC_5 : 4000|32@1+ (1,0) [0|4294967295] "NA" MCU
 SG_ OBJ_ID_5 : 4032|8@1+ (1,0) [0|255] "counter" MCU
 SG_ OBJ_Existence_Probability_5 : 4040|8@1+ (0.01,0) [0|1] "NA" MCU
 SG_ OBJ_Fusion_Source_5 : 4048|16@1+ (1,0) [0|65535] "BITWIZE" MCU
 SG_ OBJ_Triggered_SDM_5 : 4064|2@1+ (1,0) [0|2] "ENUM " MCU
 SG_ OBJ_Motion_Category_5 : 4066|4@1+ (1,0) [0|13] "ENUM " MCU
 SG_ OBJ_Buffer_C0_5 : 4070|7@1+ (1,0) [0|127] "NA" MCU
 SG_ OBJ_Object_Age_5 : 4077|11@1+ (1,0) [0|2047] "Frames" MCU
 SG_ OBJ_Measuring_Status_5 : 4088|3@1+ (1,0) [0|7] "BITWIZE" MCU
 SG_ OBJ_Object_Class_5 : 4091|4@1+ (1,0) [0|8] "ENUM" MCU
 SG_ Reserved_3_5 : 4095|1@1+ (1,0) [0|0] "NA" MCU
 SG_ OBJ_Class_Probability_5 : 4096|7@1+ (0.01,0) [0|1] "NA" MCU
 SG_ OBJ_Buffer_C1_5 : 4103|7@1+ (1,0) [0|127] "NA" MCU
 SG_ OBJ_Buffer_C2_5 : 4110|7@1+ (1,0) [0|127] "NA" MCU
 SG_ OBJ_Buffer_C3_5 : 4117|7@1+ (1,0) [0|127] "NA" MCU
 SG_ OBJ_Camera_Source_5 : 4124|4@1+ (1,0) [0|15] "ENUM" MCU
 SG_ OBJ_Motion_Status_5 : 4128|3@1+ (1,0) [0|5] "ENUM " MCU
 SG_ OBJ_Motion_Orientation_5 : 4131|4@1+ (1,0) [0|13] "ENUM " MCU
 SG_ OBJ_Has_Cut_Lane_5 : 4135|1@1+ (1,0) [0|1] "bool" MCU
 SG_ OBJ_Has_Cut_Path_5 : 4136|1@1+ (1,0) [0|1] "bool" MCU
 SG_ OBJ_Brake_Light_5 : 4137|1@1+ (1,0) [0|1] "bool" MCU
 SG_ OBJ_Turn_Indicator_Right_5 : 4138|1@1+ (1,0) [0|1] "bool" MCU
 SG_ OBJ_Turn_Indicator_Left_5 : 4139|1@1+ (1,0) [0|1] "bool" MCU
 SG_ OBJ_Light_Indicator_Validity_5 : 4140|1@1+ (1,0) [0|1] "bool" MCU
 SG_ OBJ_Right_Out_Of_Image_5 : 4141|1@1+ (1,0) [0|1] "bool" MCU
 SG_ OBJ_Left_Out_Of_Image_5 : 4142|1@1+ (1,0) [0|1] "bool" MCU
 SG_ OBJ_Right_Out_Of_Image_V_5 : 4143|1@1+ (1,0) [0|1] "bool" MCU
 SG_ OBJ_Left_Out_Of_Image_V_5 : 4144|1@1+ (1,0) [0|1] "bool" MCU
 SG_ OBJ_Top_Out_Of_Image_5 : 4145|1@1+ (1,0) [0|1] "bool" MCU
 SG_ OBJ_Bottom_Out_Of_Image_5 : 4146|1@1+ (1,0) [0|1] "bool" MCU
 SG_ OBJ_Top_Out_Of_Image_V_5 : 4147|1@1+ (1,0) [0|1] "bool" MCU
 SG_ OBJ_Bottom_Out_Of_Image_V_5 : 4148|1@1+ (1,0) [0|1] "bool" MCU
 SG_ OBJ_Lane_Assignment_5 : 4149|3@1+ (1,0) [0|5] "ENUM" MCU
 SG_ OBJ_Lane_Assignment_V_5 : 4152|1@1+ (1,0) [0|1] "bool" MCU
 SG_ OBJ_Age_Seconds_5 : 4153|7@1+ (1,0) [0|100] "s" MCU
 SG_ OBJ_Age_Seconds_V_5 : 4160|1@1+ (1,0) [0|1] "bool" MCU
 SG_ OBJ_Width_5 : 4161|9@1+ (0.01,0) [0.4|2.95] "m" MCU
 SG_ OBJ_Width_V_5 : 4170|1@1+ (1,0) [0|1] "bool" MCU
 SG_ OBJ_Width_STD_5 : 4171|8@1+ (0.01,0) [0|2] "m" MCU
 SG_ OBJ_Width_STD_V_5 : 4179|1@1+ (1,0) [0|1] "bool" MCU
 SG_ OBJ_Length_5 : 4180|9@1+ (0.05,0) [1.2|21] "m" MCU
 SG_ OBJ_Length_V_5 : 4189|1@1+ (1,0) [0|1] "bool" MCU
 SG_ Reserved_4_5 : 4190|2@1+ (1,0) [0|0] "NA" MCU
 SG_ OBJ_Length_STD_5 : 4192|8@1+ (0.05,0) [0|10] "m" MCU
 SG_ OBJ_Length_STD_V_5 : 4200|1@1+ (1,0) [0|1] "bool" MCU
 SG_ OBJ_Height_5 : 4201|9@1+ (0.01,0) [0|2.95] "m" MCU
 SG_ OBJ_Height_V_5 : 4210|1@1+ (1,0) [0|1] "bool" MCU
 SG_ OBJ_Height_STD_5 : 4211|8@1+ (0.01,0) [0|2] "m" MCU
 SG_ OBJ_Height_STD_V_5 : 4219|1@1+ (1,0) [0|1] "bool" MCU
 SG_ Reserved_5_5 : 4220|4@1+ (1,0) [0|0] "NA" MCU
 SG_ OBJ_Abs_Long_Velocity_5 : 4224|12@1+ (0.05,-30) [-30|100] "MPS" MCU
 SG_ OBJ_Abs_Long_Velocity_V_5 : 4236|1@1+ (1,0) [0|1] "bool" MCU
 SG_ OBJ_Abs_Long_Velocity_STD_5 : 4237|11@1+ (0.05,0) [0|65] "MPS" MCU
 SG_ OBJ_Abs_Long_Vel_STD_V_5 : 4248|1@1+ (1,0) [0|1] "bool" MCU
 SG_ Reserved_6_5 : 4249|7@1+ (1,0) [0|0] "NA" MCU
 SG_ OBJ_Abs_Lat_Velocity_5 : 4256|11@1+ (0.05,-50) [-50|50] "MPS" MCU
 SG_ OBJ_Abs_Lat_Velocity_V_5 : 4267|1@1+ (1,0) [0|1] "bool" MCU
 SG_ OBJ_Abs_Lat_Velocity_STD_5 : 4268|10@1+ (0.05,0) [0|50] "MPS" MCU
 SG_ OBJ_Abs_Lat_Vel_STD_V_5 : 4278|1@1+ (1,0) [0|1] "bool" MCU
 SG_ OBJ_Abs_Long_Acc_5 : 4279|9@1+ (0.05,-10.3) [-10.3|7.3] "MPS2" MCU
 SG_ OBJ_Abs_Long_Acc_V_5 : 4288|1@1+ (1,0) [0|1] "bool" MCU
 SG_ OBJ_Abs_Long_Acc_STD_5 : 4289|8@1+ (0.05,0) [0|7.3] "MPS2" MCU
 SG_ OBJ_Abs_Long_Acc_STD_V_5 : 4297|1@1+ (1,0) [0|1] "bool" MCU
 SG_ OBJ_Abs_Lat_Acc_5 : 4298|9@1+ (0.05,-10.3) [-10.3|7.3] "MPS2" MCU
 SG_ OBJ_Abs_Lat_Acc_V_5 : 4307|1@1+ (1,0) [0|1] "bool" MCU
 SG_ OBJ_Abs_Lat_Acc_STD_5 : 4308|8@1+ (0.05,0) [0|7.3] "MPS2" MCU
 SG_ OBJ_Abs_Lat_Acc_STD_V_5 : 4316|1@1+ (1,0) [0|1] "bool" MCU
 SG_ Reserved_7_5 : 4317|3@1+ (1,0) [0|0] "NA" MCU
 SG_ OBJ_Abs_Acceleration_5 : 4320|9@1+ (0.05,-10.3) [-10.3|7.3] "MPS2" MCU
 SG_ OBJ_Abs_Acceleration_V_5 : 4329|1@1+ (1,0) [0|1] "bool" MCU
 SG_ OBJ_Abs_Acc_STD_5 : 4330|8@1+ (0.05,0) [0|7.3] "MPS2" MCU
 SG_ OBJ_Abs_Acc_STD_V_5 : 4338|1@1+ (1,0) [0|1] "bool" MCU
 SG_ OBJ_Inv_TTC_5 : 4339|11@1+ (0.01,-8) [-8|8] "INV(s)" MCU
 SG_ OBJ_Inv_TTC_V_5 : 4350|1@1+ (1,0) [0|1] "bool" MCU
 SG_ Reserved_8_5 : 4351|1@1+ (1,0) [0|0] "NA" MCU
 SG_ OBJ_Inv_TTC_STD_5 : 4352|11@1+ (0.01,0) [0|4] "INV(s)" MCU
 SG_ OBJ_Inv_TTC_STD_V_5 : 4363|1@1+ (1,0) [0|1] "bool" MCU
 SG_ OBJ_Relative_Long_Acc_5 : 4364|9@1+ (0.05,-10.3) [-10.3|7.3] "MPS2" MCU
 SG_ OBJ_Relative_Long_Acc_V_5 : 4373|1@1+ (1,0) [0|1] "bool" MCU
 SG_ OBJ_Relative_Long_Acc_STD_5 : 4374|8@1+ (0.05,0) [0|7.3] "MPS2" MCU
 SG_ OBJ_Rel_Long_Acc_STD_V_5 : 4382|1@1+ (1,0) [0|1] "bool" MCU
 SG_ Reserved_9_5 : 4383|1@1+ (1,0) [0|0] "NA" MCU
 SG_ OBJ_Relative_Long_Velocity_5 : 4384|13@1+ (0.05,-120) [-120|130] "MPS" MCU
 SG_ OBJ_Relative_Long_Velocity_V_5 : 4397|1@1+ (1,0) [0|1] "bool" MCU
 SG_ OBJ_Relative_Long_Vel_STD_5 : 4398|12@1+ (0.05,0) [0|130] "MPS" MCU
 SG_ OBJ_Rel_Long_Vel_STD_V_5 : 4410|1@1+ (1,0) [0|1] "bool" MCU
 SG_ Reserved_10_5 : 4411|5@1+ (1,0) [0|0] "NA" MCU
 SG_ OBJ_Relative_Lat_Velocity_5 : 4416|11@1+ (0.05,-50) [-50|50] "MPS" MCU
 SG_ OBJ_Relative_Lat_Velocity_V_5 : 4427|1@1+ (1,0) [0|1] "bool" MCU
 SG_ OBJ_Relative_Lat_Velocity_STD_5 : 4428|10@1+ (0.05,0) [0|50] "MPS" MCU
 SG_ OBJ_Rel_Lat_Vel_STD_V_5 : 4438|1@1+ (1,0) [0|1] "bool" MCU
 SG_ Reserved_11_5 : 4439|9@1+ (1,0) [0|0] "NA" MCU
 SG_ OBJ_Long_Distance_5 : 4448|14@1+ (0.05,-200) [-200|250] "m" MCU
 SG_ OBJ_Long_Distance_V_5 : 4462|1@1+ (1,0) [0|1] "bool" MCU
 SG_ OBJ_Long_Distance_STD_5 : 4463|13@1+ (0.05,0) [0|250] "m" MCU
 SG_ OBJ_Long_Distance_STD_V_5 : 4476|1@1+ (1,0) [0|1] "bool" MCU
 SG_ Reserved_12_5 : 4477|3@1+ (1,0) [0|0] "NA" MCU
 SG_ OBJ_Lat_Distance_5 : 4480|12@1+ (0.05,-100) [-100|100] "m" MCU
 SG_ OBJ_Lat_Distance_V_5 : 4492|1@1+ (1,0) [0|1] "bool" MCU
 SG_ OBJ_Lat_Distance_STD_5 : 4493|11@1+ (0.05,0) [0|100] "m" MCU
 SG_ OBJ_Lat_Distance_STD_V_5 : 4504|1@1+ (1,0) [0|1] "bool" MCU
 SG_ Reserved_13_5 : 4505|7@1+ (1,0) [0|0] "NA" MCU
 SG_ OBJ_Absolute_Speed_5 : 4512|12@1+ (0.05,-65) [-65|65] "MPS" MCU
 SG_ OBJ_Absolute_Speed_V_5 : 4524|1@1+ (1,0) [0|1] "bool" MCU
 SG_ OBJ_Absolute_Speed_STD_5 : 4525|11@1+ (0.05,0) [0|65] "MPS" MCU
 SG_ OBJ_Absolute_Speed_STD_V_5 : 4536|1@1+ (1,0) [0|1] "bool" MCU
 SG_ Reserved_14_5 : 4537|7@1+ (1,0) [0|0] "NA" MCU
 SG_ OBJ_Heading_5 : 4544|10@1+ (0.01,-3.14) [-3.14|3.14] "rad" MCU
 SG_ OBJ_Heading_V_5 : 4554|1@1+ (1,0) [0|1] "bool" MCU
 SG_ OBJ_Heading_STD_5 : 4555|9@1+ (0.01,0) [0|3.14] "rad" MCU
 SG_ OBJ_Heading_STD_V_5 : 4564|1@1+ (1,0) [0|1] "bool" MCU
 SG_ OBJ_Angle_Rate_STD_5 : 4565|11@1+ (0.002,0) [0|2.2318] "RPS" MCU
 SG_ OBJ_Angle_Rate_STD_V_5 : 4576|1@1+ (1,0) [0|1] "bool" MCU
 SG_ OBJ_Angle_Rate_5 : 4577|12@1+ (0.002,-2.234) [-2.234|2.2318] "RPS" MCU
 SG_ OBJ_Angle_Rate_V_5 : 4589|1@1+ (1,0) [0|1] "bool" MCU
 SG_ OBJ_Angle_Right_5 : 4590|14@1+ (0.0002,-1.571) [-1.571|1.571] "rad " MCU
 SG_ OBJ_Angle_Right_V_5 : 4604|1@1+ (1,0) [0|1] "bool" MCU
 SG_ Reserved_15_5 : 4605|3@1+ (1,0) [0|0] "NA" MCU
 SG_ OBJ_Angle_Right_STD_5 : 4608|13@1+ (0.0002,0) [0|1.571] "rad " MCU
 SG_ OBJ_Angle_Right_STD_V_5 : 4621|1@1+ (1,0) [0|1] "bool" MCU
 SG_ OBJ_Angle_Left_5 : 4622|14@1+ (0.0002,-1.571) [-1.571|1.571] "rad " MCU
 SG_ OBJ_Angle_Left_V_5 : 4636|1@1+ (1,0) [0|1] "bool" MCU
 SG_ Reserved_16_5 : 4637|3@1+ (1,0) [0|0] "NA" MCU
 SG_ OBJ_Angle_Left_STD_5 : 4640|13@1+ (0.0002,0) [0|1.571] "rad" MCU
 SG_ OBJ_Angle_Left_STD_V_5 : 4653|1@1+ (1,0) [0|1] "bool" MCU
 SG_ OBJ_Angle_Side_5 : 4654|14@1+ (0.0002,-1.571) [-1.571|1.571] "rad" MCU
 SG_ OBJ_Angle_Side_V_5 : 4668|1@1+ (1,0) [0|1] "bool" MCU
 SG_ Reserved_17_5 : 4669|3@1+ (1,0) [0|0] "NA" MCU
 SG_ OBJ_Angle_Side_STD_5 : 4672|13@1+ (0.0002,0) [0|1.571] "rad" MCU
 SG_ OBJ_Angle_Side_STD_V_5 : 4685|1@1+ (1,0) [0|1] "bool" MCU
 SG_ OBJ_Angle_Mid_V_5 : 4686|1@1+ (1,0) [0|1] "bool" MCU
 SG_ OBJ_Angle_Mid_5 : 4687|14@1+ (0.0002,-1.571) [-1.571|1.571] "rad" MCU
 SG_ Reserved_18_5 : 4701|3@1+ (1,0) [0|0] "NA" MCU
 SG_ OBJ_Angle_Mid_STD_5 : 4704|13@1+ (0.0002,0) [0|1.571] "rad" MCU
 SG_ OBJ_Angle_Mid_STD_V_5 : 4717|1@1+ (1,0) [0|1] "bool" MCU
 SG_ OBJ_Angle_Bottom_V_5 : 4718|1@1+ (1,0) [0|1] "bool" MCU
 SG_ OBJ_Angle_Bottom_5 : 4719|14@1+ (0.0002,-1.571) [-1.571|1.571] "rad" MCU
 SG_ Reserved_19_5 : 4733|3@1+ (1,0) [0|0] "NA" MCU
 SG_ OBJ_Angle_Bottom_STD_5 : 4736|13@1+ (0.0002,0) [0|1.571] "rad" MCU
 SG_ OBJ_Angle_Bottom_STD_V_5 : 4749|1@1+ (1,0) [0|1] "bool" MCU
 SG_ OBJ_Visibility_Side_V_5 : 4750|1@1+ (1,0) [0|1] "Bool" MCU
 SG_ OBJ_Visibility_Side_5 : 4751|2@1+ (1,0) [0|2] "ENUM" MCU
 SG_ OBJ_Is_In_Drivable_Area_5 : 4753|1@1+ (1,0) [0|1] "bool" MCU
 SG_ OBJ_Is_In_Drivable_Area_V_5 : 4754|1@1+ (1,0) [0|1] "bool" MCU
 SG_ OBJ_Is_VeryClose_5 : 4755|1@1+ (1,0) [0|1] "bool" MCU
 SG_ OBJ_Is_VeryClose_V_5 : 4756|1@1+ (1,0) [0|1] "bool" MCU
 SG_ OBJ_Occlusion_RL_5 : 4757|2@1+ (1,0) [0|2] "ENUM" MCU
 SG_ OBJ_Occlusion_RR_5 : 4759|2@1+ (1,0) [0|2] "ENUM" MCU
 SG_ OBJ_Occlusion_FR_5 : 4761|2@1+ (1,0) [0|2] "ENUM" MCU
 SG_ OBJ_Occlusion_FL_5 : 4763|2@1+ (1,0) [0|2] "ENUM" MCU
 SG_ OBJ_Buffer_5 : 4765|3@1+ (1,0) [0|0] "NA" MCU
 SG_ OBJ_CRC_6 : 4768|32@1+ (1,0) [0|4294967295] "NA" MCU
 SG_ OBJ_ID_6 : 4800|8@1+ (1,0) [0|255] "counter" MCU
 SG_ OBJ_Existence_Probability_6 : 4808|8@1+ (0.01,0) [0|1] "NA" MCU
 SG_ OBJ_Fusion_Source_6 : 4816|16@1+ (1,0) [0|65535] "BITWIZE" MCU
 SG_ OBJ_Triggered_SDM_6 : 4832|2@1+ (1,0) [0|2] "ENUM " MCU
 SG_ OBJ_Motion_Category_6 : 4834|4@1+ (1,0) [0|13] "ENUM " MCU
 SG_ OBJ_Buffer_C0_6 : 4838|7@1+ (1,0) [0|127] "NA" MCU
 SG_ OBJ_Object_Age_6 : 4845|11@1+ (1,0) [0|2047] "Frames" MCU
 SG_ OBJ_Measuring_Status_6 : 4856|3@1+ (1,0) [0|7] "BITWIZE" MCU
 SG_ OBJ_Object_Class_6 : 4859|4@1+ (1,0) [0|8] "ENUM" MCU
 SG_ Reserved_3_6 : 4863|1@1+ (1,0) [0|0] "NA" MCU
 SG_ OBJ_Class_Probability_6 : 4864|7@1+ (0.01,0) [0|1] "NA" MCU
 SG_ OBJ_Buffer_C1_6 : 4871|7@1+ (1,0) [0|127] "NA" MCU
 SG_ OBJ_Buffer_C2_6 : 4878|7@1+ (1,0) [0|127] "NA" MCU
 SG_ OBJ_Buffer_C3_6 : 4885|7@1+ (1,0) [0|127] "NA" MCU
 SG_ OBJ_Camera_Source_6 : 4892|4@1+ (1,0) [0|15] "ENUM" MCU
 SG_ OBJ_Motion_Status_6 : 4896|3@1+ (1,0) [0|5] "ENUM " MCU
 SG_ OBJ_Motion_Orientation_6 : 4899|4@1+ (1,0) [0|13] "ENUM " MCU
 SG_ OBJ_Has_Cut_Lane_6 : 4903|1@1+ (1,0) [0|1] "bool" MCU
 SG_ OBJ_Has_Cut_Path_6 : 4904|1@1+ (1,0) [0|1] "bool" MCU
 SG_ OBJ_Brake_Light_6 : 4905|1@1+ (1,0) [0|1] "bool" MCU
 SG_ OBJ_Turn_Indicator_Right_6 : 4906|1@1+ (1,0) [0|1] "bool" MCU
 SG_ OBJ_Turn_Indicator_Left_6 : 4907|1@1+ (1,0) [0|1] "bool" MCU
 SG_ OBJ_Light_Indicator_Validity_6 : 4908|1@1+ (1,0) [0|1] "bool" MCU
 SG_ OBJ_Right_Out_Of_Image_6 : 4909|1@1+ (1,0) [0|1] "bool" MCU
 SG_ OBJ_Left_Out_Of_Image_6 : 4910|1@1+ (1,0) [0|1] "bool" MCU
 SG_ OBJ_Right_Out_Of_Image_V_6 : 4911|1@1+ (1,0) [0|1] "bool" MCU
 SG_ OBJ_Left_Out_Of_Image_V_6 : 4912|1@1+ (1,0) [0|1] "bool" MCU
 SG_ OBJ_Top_Out_Of_Image_6 : 4913|1@1+ (1,0) [0|1] "bool" MCU
 SG_ OBJ_Bottom_Out_Of_Image_6 : 4914|1@1+ (1,0) [0|1] "bool" MCU
 SG_ OBJ_Top_Out_Of_Image_V_6 : 4915|1@1+ (1,0) [0|1] "bool" MCU
 SG_ OBJ_Bottom_Out_Of_Image_V_6 : 4916|1@1+ (1,0) [0|1] "bool" MCU
 SG_ OBJ_Lane_Assignment_6 : 4917|3@1+ (1,0) [0|5] "ENUM" MCU
 SG_ OBJ_Lane_Assignment_V_6 : 4920|1@1+ (1,0) [0|1] "bool" MCU
 SG_ OBJ_Age_Seconds_6 : 4921|7@1+ (1,0) [0|100] "s" MCU
 SG_ OBJ_Age_Seconds_V_6 : 4928|1@1+ (1,0) [0|1] "bool" MCU
 SG_ OBJ_Width_6 : 4929|9@1+ (0.01,0) [0.4|2.95] "m" MCU
 SG_ OBJ_Width_V_6 : 4938|1@1+ (1,0) [0|1] "bool" MCU
 SG_ OBJ_Width_STD_6 : 4939|8@1+ (0.01,0) [0|2] "m" MCU
 SG_ OBJ_Width_STD_V_6 : 4947|1@1+ (1,0) [0|1] "bool" MCU
 SG_ OBJ_Length_6 : 4948|9@1+ (0.05,0) [1.2|21] "m" MCU
 SG_ OBJ_Length_V_6 : 4957|1@1+ (1,0) [0|1] "bool" MCU
 SG_ Reserved_4_6 : 4958|2@1+ (1,0) [0|0] "NA" MCU
 SG_ OBJ_Length_STD_6 : 4960|8@1+ (0.05,0) [0|10] "m" MCU
 SG_ OBJ_Length_STD_V_6 : 4968|1@1+ (1,0) [0|1] "bool" MCU
 SG_ OBJ_Height_6 : 4969|9@1+ (0.01,0) [0|2.95] "m" MCU
 SG_ OBJ_Height_V_6 : 4978|1@1+ (1,0) [0|1] "bool" MCU
 SG_ OBJ_Height_STD_6 : 4979|8@1+ (0.01,0) [0|2] "m" MCU
 SG_ OBJ_Height_STD_V_6 : 4987|1@1+ (1,0) [0|1] "bool" MCU
 SG_ Reserved_5_6 : 4988|4@1+ (1,0) [0|0] "NA" MCU
 SG_ OBJ_Abs_Long_Velocity_6 : 4992|12@1+ (0.05,-30) [-30|100] "MPS" MCU
 SG_ OBJ_Abs_Long_Velocity_V_6 : 5004|1@1+ (1,0) [0|1] "bool" MCU
 SG_ OBJ_Abs_Long_Velocity_STD_6 : 5005|11@1+ (0.05,0) [0|65] "MPS" MCU
 SG_ OBJ_Abs_Long_Vel_STD_V_6 : 5016|1@1+ (1,0) [0|1] "bool" MCU
 SG_ Reserved_6_6 : 5017|7@1+ (1,0) [0|0] "NA" MCU
 SG_ OBJ_Abs_Lat_Velocity_6 : 5024|11@1+ (0.05,-50) [-50|50] "MPS" MCU
 SG_ OBJ_Abs_Lat_Velocity_V_6 : 5035|1@1+ (1,0) [0|1] "bool" MCU
 SG_ OBJ_Abs_Lat_Velocity_STD_6 : 5036|10@1+ (0.05,0) [0|50] "MPS" MCU
 SG_ OBJ_Abs_Lat_Vel_STD_V_6 : 5046|1@1+ (1,0) [0|1] "bool" MCU
 SG_ OBJ_Abs_Long_Acc_6 : 5047|9@1+ (0.05,-10.3) [-10.3|7.3] "MPS2" MCU
 SG_ OBJ_Abs_Long_Acc_V_6 : 5056|1@1+ (1,0) [0|1] "bool" MCU
 SG_ OBJ_Abs_Long_Acc_STD_6 : 5057|8@1+ (0.05,0) [0|7.3] "MPS2" MCU
 SG_ OBJ_Abs_Long_Acc_STD_V_6 : 5065|1@1+ (1,0) [0|1] "bool" MCU
 SG_ OBJ_Abs_Lat_Acc_6 : 5066|9@1+ (0.05,-10.3) [-10.3|7.3] "MPS2" MCU
 SG_ OBJ_Abs_Lat_Acc_V_6 : 5075|1@1+ (1,0) [0|1] "bool" MCU
 SG_ OBJ_Abs_Lat_Acc_STD_6 : 5076|8@1+ (0.05,0) [0|7.3] "MPS2" MCU
 SG_ OBJ_Abs_Lat_Acc_STD_V_6 : 5084|1@1+ (1,0) [0|1] "bool" MCU
 SG_ Reserved_7_6 : 5085|3@1+ (1,0) [0|0] "NA" MCU
 SG_ OBJ_Abs_Acceleration_6 : 5088|9@1+ (0.05,-10.3) [-10.3|7.3] "MPS2" MCU
 SG_ OBJ_Abs_Acceleration_V_6 : 5097|1@1+ (1,0) [0|1] "bool" MCU
 SG_ OBJ_Abs_Acc_STD_6 : 5098|8@1+ (0.05,0) [0|7.3] "MPS2" MCU
 SG_ OBJ_Abs_Acc_STD_V_6 : 5106|1@1+ (1,0) [0|1] "bool" MCU
 SG_ OBJ_Inv_TTC_6 : 5107|11@1+ (0.01,-8) [-8|8] "INV(s)" MCU
 SG_ OBJ_Inv_TTC_V_6 : 5118|1@1+ (1,0) [0|1] "bool" MCU
 SG_ Reserved_8_6 : 5119|1@1+ (1,0) [0|0] "NA" MCU
 SG_ OBJ_Inv_TTC_STD_6 : 5120|11@1+ (0.01,0) [0|4] "INV(s)" MCU
 SG_ OBJ_Inv_TTC_STD_V_6 : 5131|1@1+ (1,0) [0|1] "bool" MCU
 SG_ OBJ_Relative_Long_Acc_6 : 5132|9@1+ (0.05,-10.3) [-10.3|7.3] "MPS2" MCU
 SG_ OBJ_Relative_Long_Acc_V_6 : 5141|1@1+ (1,0) [0|1] "bool" MCU
 SG_ OBJ_Relative_Long_Acc_STD_6 : 5142|8@1+ (0.05,0) [0|7.3] "MPS2" MCU
 SG_ OBJ_Rel_Long_Acc_STD_V_6 : 5150|1@1+ (1,0) [0|1] "bool" MCU
 SG_ Reserved_9_6 : 5151|1@1+ (1,0) [0|0] "NA" MCU
 SG_ OBJ_Relative_Long_Velocity_6 : 5152|13@1+ (0.05,-120) [-120|130] "MPS" MCU
 SG_ OBJ_Relative_Long_Velocity_V_6 : 5165|1@1+ (1,0) [0|1] "bool" MCU
 SG_ OBJ_Relative_Long_Vel_STD_6 : 5166|12@1+ (0.05,0) [0|130] "MPS" MCU
 SG_ OBJ_Rel_Long_Vel_STD_V_6 : 5178|1@1+ (1,0) [0|1] "bool" MCU
 SG_ Reserved_10_6 : 5179|5@1+ (1,0) [0|0] "NA" MCU
 SG_ OBJ_Relative_Lat_Velocity_6 : 5184|11@1+ (0.05,-50) [-50|50] "MPS" MCU
 SG_ OBJ_Relative_Lat_Velocity_V_6 : 5195|1@1+ (1,0) [0|1] "bool" MCU
 SG_ OBJ_Relative_Lat_Velocity_STD_6 : 5196|10@1+ (0.05,0) [0|50] "MPS" MCU
 SG_ OBJ_Rel_Lat_Vel_STD_V_6 : 5206|1@1+ (1,0) [0|1] "bool" MCU
 SG_ Reserved_11_6 : 5207|9@1+ (1,0) [0|0] "NA" MCU
 SG_ OBJ_Long_Distance_6 : 5216|14@1+ (0.05,-200) [-200|250] "m" MCU
 SG_ OBJ_Long_Distance_V_6 : 5230|1@1+ (1,0) [0|1] "bool" MCU
 SG_ OBJ_Long_Distance_STD_6 : 5231|13@1+ (0.05,0) [0|250] "m" MCU
 SG_ OBJ_Long_Distance_STD_V_6 : 5244|1@1+ (1,0) [0|1] "bool" MCU
 SG_ Reserved_12_6 : 5245|3@1+ (1,0) [0|0] "NA" MCU
 SG_ OBJ_Lat_Distance_6 : 5248|12@1+ (0.05,-100) [-100|100] "m" MCU
 SG_ OBJ_Lat_Distance_V_6 : 5260|1@1+ (1,0) [0|1] "bool" MCU
 SG_ OBJ_Lat_Distance_STD_6 : 5261|11@1+ (0.05,0) [0|100] "m" MCU
 SG_ OBJ_Lat_Distance_STD_V_6 : 5272|1@1+ (1,0) [0|1] "bool" MCU
 SG_ Reserved_13_6 : 5273|7@1+ (1,0) [0|0] "NA" MCU
 SG_ OBJ_Absolute_Speed_6 : 5280|12@1+ (0.05,-65) [-65|65] "MPS" MCU
 SG_ OBJ_Absolute_Speed_V_6 : 5292|1@1+ (1,0) [0|1] "bool" MCU

CM_ SG_ 154 OBJ_Zero_byte "in case set to FF message is not available.";
CM_ SG_ 154 OBJ_Header_CRC "CRC calculated over all header values.";
CM_ SG_ 154 OBJ_Protocol_Version "Denotes the protocol version";
CM_ SG_ 154 OBJ_Sync_ID "The ID of the Sync message, used to synchronize between signals in the system. Every new frame promotes the sync ID by one.";
CM_ SG_ 154 OBJ_VRU_Count "The number of recognized Vulnerable Road Users (pedestrians, bicycles) in the scene.";
CM_ SG_ 154 OBJ_VD_Count "The number of recognized vehicles in the scene.";
CM_ SG_ 154 OBJ_General_OBJ_Count "The number of recognized General Objects in the scene.";
CM_ SG_ 154 OBJ_Animal_Count "The number of recognized animals in the scene.";
CM_ SG_ 154 OBJ_VD_NIV_Left "The ID of the closet VD object to the left of the host.";
CM_ SG_ 154 OBJ_VD_NIV_Right "The ID of the closet VD object to the right of the host.";
CM_ SG_ 154 OBJ_VD_CIPV_ID "The Current In Path Vehicle (CIPV) object ID.";
CM_ SG_ 154 OBJ_VD_CIPV_Lost "Reports a CIPV loss that cannot be explained to initiate a take over request.   ";
CM_ SG_ 154 OBJ_VD_Allow_Acc "This signal is intended to suppress acceleration in stop and go ACC scenarios when we suspect something is in our way.  ";
CM_ SG_ 154 OBJ_Is_Blocked_Left "Indicates whether the left side is blocked for lane change.";
CM_ SG_ 154 OBJ_Is_Blocked_Right "Indicates whether the right side is blocked for lane change.";
CM_ SG_ 154 OBJ_CRC_0 "Calculated over each object signal";
CM_ SG_ 154 OBJ_ID_0 "The detected object ID. Range is 1-255, while 0 indicates that the field in unfilled.";
CM_ SG_ 154 OBJ_Existence_Probability_0 "The existence probability of the vehicle";
CM_ SG_ 154 OBJ_Fusion_Source_0 "sources ids used for fusion";
CM_ SG_ 154 OBJ_Triggered_SDM_0 "Indicates whether the object has trigered the SDM (Safety Diagnostic Manager) alert.";
CM_ SG_ 154 OBJ_Motion_Category_0 "Relevant for VD only. Full description of values can be found at the ACC guide.";
CM_ SG_ 154 OBJ_Object_Age_0 "The number of frames in which the object was recognized.";
CM_ SG_ 154 OBJ_Measuring_Status_0 "Measurment status. Old vs New marks if this is the first frame in which the object is reported. Predicted vs Measured marks if the report is raw or has been predicted forward in time using the measured dynamics and ego motion.";
CM_ SG_ 154 OBJ_Object_Class_0 "Indicates the object type. Uncertain is outputted in case the probability that a vehicle is a truck is very similar to the probability that it is a car. ";
CM_ SG_ 154 OBJ_Class_Probability_0 "The probability of this type classification.";
CM_ SG_ 154 OBJ_Camera_Source_0 "The camera in which this object was detected (best choice).";
CM_ SG_ 154 OBJ_Motion_Status_0 "MOVING - the object is moving STATIONARY - the object was never seen moving STOPPED -  the object was moving and has stopped MOVING_SLOWLY - the object is moving very slowly";
CM_ SG_ 154 OBJ_Motion_Orientation_0 "The direction of the target's heading compared to the host. ";
CM_ SG_ 154 OBJ_Has_Cut_Lane_0 "Indicates whether the object cut the host's (right or left) lane. In case there are no lanes, indicates whether the objects is at most 1 meters away from the host.";
CM_ SG_ 154 OBJ_Has_Cut_Path_0 "Indicates whether the object is in the host's path.";
CM_ SG_ 154 OBJ_Brake_Light_0 "Indication for brake lights ";
CM_ SG_ 154 OBJ_Turn_Indicator_Right_0 "Indication for blinking right light.";
CM_ SG_ 154 OBJ_Turn_Indicator_Left_0 "Indication for blinking left light ";
CM_ SG_ 154 OBJ_Light_Indicator_Validity_0 "Validator for light indicators";
CM_ SG_ 154 OBJ_Right_Out_Of_Image_0 "Indicates whether the measurment are predicted out of the right side of the image bounderies.";
CM_ SG_ 154 OBJ_Left_Out_Of_Image_0 "Indicates whether if measurment are predicted out of  the left side of the image bounderies";
CM_ SG_ 154 OBJ_Right_Out_Of_Image_V_0 "validator";
CM_ SG_ 154 OBJ_Left_Out_Of_Image_V_0 "validator";
CM_ SG_ 154 OBJ_Top_Out_Of_Image_0 "Indicates whether if measurment are predicted out of  the top of the image bounderies";
CM_ SG_ 154 OBJ_Bottom_Out_Of_Image_0 "validator";
CM_ SG_ 154 OBJ_Top_Out_Of_Image_V_0 "Indicates whether if measurment are predicted out of  the bottom of the image bounderies";
CM_ SG_ 154 OBJ_Bottom_Out_Of_Image_V_0 "validator";
CM_ SG_ 154 OBJ_Lane_Assignment_0 "The object's lane relative to the host lane.";
CM_ SG_ 154 OBJ_Lane_Assignment_V_0 "Validator for lane assignment";
CM_ SG_ 154 OBJ_Age_Seconds_0 "Time in seconds in which the object was recognized. Currently available for peds only. ";
CM_ SG_ 154 OBJ_Age_Seconds_V_0 "Validator for object age";
CM_ SG_ 154 OBJ_Width_0 "The width of the target vehicle in the world (not to be mistaken with the width of the visible part of the vehicle).";
CM_ SG_ 154 OBJ_Width_V_0 "Validator for object width";
CM_ SG_ 154 OBJ_Width_STD_0 "Standard deviation for object width";
CM_ SG_ 154 OBJ_Width_STD_V_0 "Validator for the standard deviation of object width";
CM_ SG_ 154 OBJ_Length_0 "The length of the vehicle in the world. For crossing bicycles it gives the viewed length of the bicycle.";
CM_ SG_ 154 OBJ_Length_V_0 "Validator for object length.";
CM_ SG_ 154 OBJ_Length_STD_0 "Standard deviation for object length.";
CM_ SG_ 154 OBJ_Length_STD_V_0 "Validator for the standard deviation of object length.";
CM_ SG_ 154 OBJ_Height_0 "The height of the object in the world. ";
CM_ SG_ 154 OBJ_Height_V_0 "Validator for object height.";
CM_ SG_ 154 OBJ_Height_STD_0 "Standard deviation for object height.";
CM_ SG_ 154 OBJ_Height_STD_V_0 "Validator for the standard deviation of object height.";
CM_ SG_ 154 OBJ_Abs_Long_Velocity_0 "Absolute longitudinal velocity.";
CM_ SG_ 154 OBJ_Abs_Long_Velocity_V_0 "Validator for absolute longitudinal velocity.";
CM_ SG_ 154 OBJ_Abs_Long_Velocity_STD_0 "Standard deviation of absolute longitudinal velocity.";
CM_ SG_ 154 OBJ_Abs_Long_Vel_STD_V_0 "Validator for the standard deviation of the absolute longitudinal velocity.";
CM_ SG_ 154 OBJ_Abs_Lat_Velocity_0 "The lateral ground speed of the object.";
CM_ SG_ 154 OBJ_Abs_Lat_Velocity_V_0 "Validator for the lateral ground speed of the object.";
CM_ SG_ 154 OBJ_Abs_Lat_Velocity_STD_0 "STD of the lateral ground speed of the object.";
CM_ SG_ 154 OBJ_Abs_Lat_Vel_STD_V_0 "Validator for the STD of the lateral ground speed of the object.";
CM_ SG_ 154 OBJ_Abs_Long_Acc_0 "The longitudinal ground acceleration of the object.";
CM_ SG_ 154 OBJ_Abs_Long_Acc_V_0 "Validator for the longitudinal ground acceleration of the object.";
CM_ SG_ 154 OBJ_Abs_Long_Acc_STD_0 "STD of the longitudinal ground acceleration of the object.";
CM_ SG_ 154 OBJ_Abs_Long_Acc_STD_V_0 "Validator for the STD of the longitudinal ground acceleration of the object.";
CM_ SG_ 154 OBJ_Abs_Lat_Acc_0 "The lateral ground acceleration of the object.";
CM_ SG_ 154 OBJ_Abs_Lat_Acc_V_0 "Validator for the lateral ground acceleration of the object.";
CM_ SG_ 154 OBJ_Abs_Lat_Acc_STD_0 "STD of the lateral ground acceleration of the object.";
CM_ SG_ 154 OBJ_Abs_Lat_Acc_STD_V_0 "Validator for the STD of the lateral ground acceleration of the object.";
CM_ SG_ 154 OBJ_Abs_Acceleration_0 "The absolute ground acceleration in the target's heading direction.";
CM_ SG_ 154 OBJ_Abs_Acceleration_V_0 "Validator for the absolute ground acceleration.";
CM_ SG_ 154 OBJ_Abs_Acc_STD_0 "STD of the absolute ground acceleration.";
CM_ SG_ 154 OBJ_Abs_Acc_STD_V_0 "Validator for the STD of the absolute ground acceleration.";
CM_ SG_ 154 OBJ_Inv_TTC_0 "Inverse TTC (time to collision).";
CM_ SG_ 154 OBJ_Inv_TTC_V_0 "Validator for Inverse TTC.";
CM_ SG_ 154 OBJ_Inv_TTC_STD_0 "STD for inverse TTC .";
CM_ SG_ 154 OBJ_Inv_TTC_STD_V_0 "Validator for the STD for inverse TTC .";
CM_ SG_ 154 OBJ_Relative_Long_Acc_0 "The relative lateral ground acceleration of the object.";
CM_ SG_ 154 OBJ_Relative_Long_Acc_V_0 "Validator for the relative lateral ground acceleration of the object.";
CM_ SG_ 154 OBJ_Relative_Long_Acc_STD_0 "STD of the relative lateral ground acceleration of the object.";
CM_ SG_ 154 OBJ_Rel_Long_Acc_STD_V_0 "Validator for the STD of the relative lateral ground acceleration.";
CM_ SG_ 154 OBJ_Relative_Long_Velocity_0 "The relative longtitudinal speed between the target and ego vehicle. ";
CM_ SG_ 154 OBJ_Relative_Long_Velocity_V_0 "Validator for the relative longtitudinal speed.";
CM_ SG_ 154 OBJ_Relative_Long_Vel_STD_0 "STD of the relative longtitudinal speed.";
CM_ SG_ 154 OBJ_Rel_Long_Vel_STD_V_0 "Validator for the STD of the relative longtitudinal speed.";
CM_ SG_ 154 OBJ_Relative_Lat_Velocity_0 "The relative lateral speed between the target and ego vehicle. ";
CM_ SG_ 154 OBJ_Relative_Lat_Velocity_V_0 "Validator for the relative lateral speed. ";
CM_ SG_ 154 OBJ_Relative_Lat_Velocity_STD_0 "STD of the relative lateral speed. ";
CM_ SG_ 154 OBJ_Rel_Lat_Vel_STD_V_0 "Validator for the STD of the relative lateral speed. ";
CM_ SG_ 154 OBJ_Long_Distance_0 "The longtitudinal distance from the object to the middle of the Rear-Left and Rear-Right corners of the host vehicle.  ";
CM_ SG_ 154 OBJ_Long_Distance_V_0 "Validator of the longtitudinal distance from the object to the middle of the rear-axle of the host.  ";
CM_ SG_ 154 OBJ_Long_Distance_STD_0 "STD of the  longtitudinal distance.";
CM_ SG_ 154 OBJ_Long_Distance_STD_V_0 "Validator for the STD of the  longtitudinal distance.";
CM_ SG_ 154 OBJ_Lat_Distance_0 "Lateral distance to the middle of the RL and RR corners.  ";
CM_ SG_ 154 OBJ_Lat_Distance_V_0 "Validator for the lateral distance of the object.";
CM_ SG_ 154 OBJ_Lat_Distance_STD_0 "STD of the lateral distance of the object.";
CM_ SG_ 154 OBJ_Lat_Distance_STD_V_0 "Validator for the STD of the lateral distance of the object.";
CM_ SG_ 154 OBJ_Absolute_Speed_0 "The absolute ground speed in the targets' heading direction.";
CM_ SG_ 154 OBJ_Absolute_Speed_V_0 "Validator for the absolute ground speed.";
CM_ SG_ 154 OBJ_Absolute_Speed_STD_0 "STD of the absolute ground speed.";
CM_ SG_ 154 OBJ_Absolute_Speed_STD_V_0 "Validator for the STD of the absolute ground speed.";
CM_ SG_ 154 OBJ_Heading_0 "The angle beetweenthe host longitudinal axis and target's heading (clockwise, e.g. PI/2 is a target crossing from left to right).";
CM_ SG_ 154 OBJ_Heading_V_0 "Validator for the object heading.";
CM_ SG_ 154 OBJ_Heading_STD_0 "STD of the object heading.";
CM_ SG_ 154 OBJ_Heading_STD_V_0 "Validator for the STD of the object heading.";
CM_ SG_ 154 OBJ_Angle_Rate_STD_0 "Standard deviation of the angular speed. (radians)";
CM_ SG_ 154 OBJ_Angle_Rate_STD_V_0 "Validator for the STD of the angular speed.";
CM_ SG_ 154 OBJ_Angle_Rate_0 "The momentary angular speed of the object. (radians)";
CM_ SG_ 154 OBJ_Angle_Rate_V_0 "Validator for the angular speed.";
CM_ SG_ 154 OBJ_Angle_Right_0 "The angle between the host longitudinal axis and the right side of the front / rear of the target (the visible one). The positive side is to the host's right.";
CM_ SG_ 154 OBJ_Angle_Right_V_0 "Validator for angleRight";
CM_ SG_ 154 OBJ_Angle_Right_STD_0 "Standard deviation of angleRight";
CM_ SG_ 154 OBJ_Angle_Right_STD_V_0 "Validator for the standard deviation of angleRight.";
CM_ SG_ 154 OBJ_Angle_Left_0 "The angle between the host longitudinal axis and the left side of the front / rear of the target (the visible one). The positive side is to the host's right.";
CM_ SG_ 154 OBJ_Angle_Left_V_0 "Validator for angleLeft.";
CM_ SG_ 154 OBJ_Angle_Left_STD_0 "Standard deviation of angleLeft.";
CM_ SG_ 154 OBJ_Angle_Left_STD_V_0 "Validator for the standard deviation of angleLeft.";
CM_ SG_ 154 OBJ_Angle_Side_0 "The angle between the host longitudinal axis and the far visible edge - the visible edge of the front / rear of the target that is not visible. Currently supported for vehicles only.";
CM_ SG_ 154 OBJ_Angle_Side_V_0 "Validator for angleSide.";
CM_ SG_ 154 OBJ_Angle_Side_STD_0 "Standard deviation of angleSide.";
CM_ SG_ 154 OBJ_Angle_Side_STD_V_0 "Validator for the STD of angleSide.";
CM_ SG_ 154 OBJ_Angle_Mid_V_0 "Validator for angleMid.";
CM_ SG_ 154 OBJ_Angle_Mid_0 "The angle between the host longitudinal axis and the middle of the front / rear of the target (the visible one). The positive side is to the host's right.";
CM_ SG_ 154 OBJ_Angle_Mid_STD_0 "Standard deviation of angleMid.";
CM_ SG_ 154 OBJ_Angle_Mid_STD_V_0 "Validator for the STD of angleMid.";
CM_ SG_ 154 OBJ_Angle_Bottom_V_0 "Validator for OBJAngle_Bottom. ";
CM_ SG_ 154 OBJ_Angle_Bottom_0 "The angle between the logitudinal axis and the Bottom of the front / rear of the target (the visible one). The positive side is to the hosts right";
CM_ SG_ 154 OBJ_Angle_Bottom_STD_0 "STD for OBJAngle_Bottom. ";
CM_ SG_ 154 OBJ_Angle_Bottom_STD_V_0 "Validator for OBJAngle_Bottom_STD. ";
CM_ SG_ 154 OBJ_Visibility_Side_V_0 "Currently Supported for VD only";
CM_ SG_ 154 OBJ_Visibility_Side_0 "From what car  side is the object visible";
CM_ SG_ 154 OBJ_Is_In_Drivable_Area_0 "Indicates whether the target is in a driveable area.";
CM_ SG_ 154 OBJ_Is_In_Drivable_Area_V_0 "Validator for OBJ_Is_In_Drivable_Area.";
CM_ SG_ 154 OBJ_Is_VeryClose_0 "Indicates whether the target is very close to the host such that it is hard to measure it's distance. Currently relevant for peds only. ";
CM_ SG_ 154 OBJ_Is_VeryClose_V_0 "Validator for OBJ_Is_VeryClose. ";
CM_ SG_ 154 OBJ_Occlusion_RL_0 "Was Rear left of the 3D detection of theobject occluded";
CM_ SG_ 154 OBJ_Occlusion_RR_0 "Was Rear Right of the 3D detection of theobject occluded";
CM_ SG_ 154 OBJ_Occlusion_FR_0 "Was front Right of the 3D detection of theobject occluded";
CM_ SG_ 154 OBJ_Occlusion_FL_0 "Was Front left of the 3D detection of theobject occluded";
CM_ SG_ 154 OBJ_CRC_1 "Calculated over each object signal";
CM_ SG_ 154 OBJ_ID_1 "The detected object ID. Range is 1-255, while 0 indicates that the field in unfilled.";
CM_ SG_ 154 OBJ_Existence_Probability_1 "The existence probability of the vehicle";
CM_ SG_ 154 OBJ_Fusion_Source_1 "sources ids used for fusion";
CM_ SG_ 154 OBJ_Triggered_SDM_1 "Indicates whether the object has trigered the SDM (Safety Diagnostic Manager) alert.";
CM_ SG_ 154 OBJ_Motion_Category_1 "Relevant for VD only. Full description of values can be found at the ACC guide.";
CM_ SG_ 154 OBJ_Object_Age_1 "The number of frames in which the object was recognized.";
CM_ SG_ 154 OBJ_Measuring_Status_1 "Measurment status. Old vs New marks if this is the first frame in which the object is reported. Predicted vs Measured marks if the report is raw or has been predicted forward in time using the measured dynamics and ego motion.";
CM_ SG_ 154 OBJ_Object_Class_1 "Indicates the object type. Uncertain is outputted in case the probability that a vehicle is a truck is very similar to the probability that it is a car. ";
CM_ SG_ 154 OBJ_Class_Probability_1 "The probability of this type classification.";
CM_ SG_ 154 OBJ_Camera_Source_1 "The camera in which this object was detected (best choice).";
CM_ SG_ 154 OBJ_Motion_Status_1 "MOVING - the object is moving STATIONARY - the object was never seen moving STOPPED -  the object was moving and has stopped MOVING_SLOWLY - the object is moving very slowly";
CM_ SG_ 154 OBJ_Motion_Orientation_1 "The direction of the target's heading compared to the host. ";
CM_ SG_ 154 OBJ_Has_Cut_Lane_1 "Indicates whether the object cut the host's (right or left) lane. In case there are no lanes, indicates whether the objects is at most 1 meters away from the host.";
CM_ SG_ 154 OBJ_Has_Cut_Path_1 "Indicates whether the object is in the host's path.";
CM_ SG_ 154 OBJ_Brake_Light_1 "Indication for brake lights ";
CM_ SG_ 154 OBJ_Turn_Indicator_Right_1 "Indication for blinking right light.";
CM_ SG_ 154 OBJ_Turn_Indicator_Left_1 "Indication for blinking left light ";
CM_ SG_ 154 OBJ_Light_Indicator_Validity_1 "Validator for light indicators";
CM_ SG_ 154 OBJ_Right_Out_Of_Image_1 "Indicates whether the measurment are predicted out of the right side of the image bounderies.";
CM_ SG_ 154 OBJ_Left_Out_Of_Image_1 "Indicates whether if measurment are predicted out of  the left side of the image bounderies";
CM_ SG_ 154 OBJ_Right_Out_Of_Image_V_1 "validator";
CM_ SG_ 154 OBJ_Left_Out_Of_Image_V_1 "validator";
CM_ SG_ 154 OBJ_Top_Out_Of_Image_1 "Indicates whether if measurment are predicted out of  the top of the image bounderies";
CM_ SG_ 154 OBJ_Bottom_Out_Of_Image_1 "validator";
CM_ SG_ 154 OBJ_Top_Out_Of_Image_V_1 "Indicates whether if measurment are predicted out of  the bottom of the image bounderies";
CM_ SG_ 154 OBJ_Bottom_Out_Of_Image_V_1 "validator";
CM_ SG_ 154 OBJ_Lane_Assignment_1 "The object's lane relative to the host lane.";
CM_ SG_ 154 OBJ_Lane_Assignment_V_1 "Validator for lane assignment";
CM_ SG_ 154 OBJ_Age_Seconds_1 "Time in seconds in which the object was recognized. Currently available for peds only. ";
CM_ SG_ 154 OBJ_Age_Seconds_V_1 "Validator for object age";
CM_ SG_ 154 OBJ_Width_1 "The width of the target vehicle in the world (not to be mistaken with the width of the visible part of the vehicle).";
CM_ SG_ 154 OBJ_Width_V_1 "Validator for object width";
CM_ SG_ 154 OBJ_Width_STD_1 "Standard deviation for object width";
CM_ SG_ 154 OBJ_Width_STD_V_1 "Validator for the standard deviation of object width";
CM_ SG_ 154 OBJ_Length_1 "The length of the vehicle in the world. For crossing bicycles it gives the viewed length of the bicycle.";
CM_ SG_ 154 OBJ_Length_V_1 "Validator for object length.";
CM_ SG_ 154 OBJ_Length_STD_1 "Standard deviation for object length.";
CM_ SG_ 154 OBJ_Length_STD_V_1 "Validator for the standard deviation of object length.";
CM_ SG_ 154 OBJ_Height_1 "The height of the object in the world. ";
CM_ SG_ 154 OBJ_Height_V_1 "Validator for object height.";
CM_ SG_ 154 OBJ_Height_STD_1 "Standard deviation for object height.";
CM_ SG_ 154 OBJ_Height_STD_V_1 "Validator for the standard deviation of object height.";
CM_ SG_ 154 OBJ_Abs_Long_Velocity_1 "Absolute longitudinal velocity.";
CM_ SG_ 154 OBJ_Abs_Long_Velocity_V_1 "Validator for absolute longitudinal velocity.";
CM_ SG_ 154 OBJ_Abs_Long_Velocity_STD_1 "Standard deviation of absolute longitudinal velocity.";
CM_ SG_ 154 OBJ_Abs_Long_Vel_STD_V_1 "Validator for the standard deviation of the absolute longitudinal velocity.";
CM_ SG_ 154 OBJ_Abs_Lat_Velocity_1 "The lateral ground speed of the object.";
CM_ SG_ 154 OBJ_Abs_Lat_Velocity_V_1 "Validator for the lateral ground speed of the object.";
CM_ SG_ 154 OBJ_Abs_Lat_Velocity_STD_1 "STD of the lateral ground speed of the object.";
CM_ SG_ 154 OBJ_Abs_Lat_Vel_STD_V_1 "Validator for the STD of the lateral ground speed of the object.";
CM_ SG_ 154 OBJ_Abs_Long_Acc_1 "The longitudinal ground acceleration of the object.";
CM_ SG_ 154 OBJ_Abs_Long_Acc_V_1 "Validator for the longitudinal ground acceleration of the object.";
CM_ SG_ 154 OBJ_Abs_Long_Acc_STD_1 "STD of the longitudinal ground acceleration of the object.";
CM_ SG_ 154 OBJ_Abs_Long_Acc_STD_V_1 "Validator for the STD of the longitudinal ground acceleration of the object.";
CM_ SG_ 154 OBJ_Abs_Lat_Acc_1 "The lateral ground acceleration of the object.";
CM_ SG_ 154 OBJ_Abs_Lat_Acc_V_1 "Validator for the lateral ground acceleration of the object.";
CM_ SG_ 154 OBJ_Abs_Lat_Acc_STD_1 "STD of the lateral ground acceleration of the object.";
CM_ SG_ 154 OBJ_Abs_Lat_Acc_STD_V_1 "Validator for the STD of the lateral ground acceleration of the object.";
CM_ SG_ 154 OBJ_Abs_Acceleration_1 "The absolute ground acceleration in the target's heading direction.";
CM_ SG_ 154 OBJ_Abs_Acceleration_V_1 "Validator for the absolute ground acceleration.";
CM_ SG_ 154 OBJ_Abs_Acc_STD_1 "STD of the absolute ground acceleration.";
CM_ SG_ 154 OBJ_Abs_Acc_STD_V_1 "Validator for the STD of the absolute ground acceleration.";
CM_ SG_ 154 OBJ_Inv_TTC_1 "Inverse TTC (time to collision).";
CM_ SG_ 154 OBJ_Inv_TTC_V_1 "Validator for Inverse TTC.";
CM_ SG_ 154 OBJ_Inv_TTC_STD_1 "STD for inverse TTC .";
CM_ SG_ 154 OBJ_Inv_TTC_STD_V_1 "Validator for the STD for inverse TTC .";
CM_ SG_ 154 OBJ_Relative_Long_Acc_1 "The relative lateral ground acceleration of the object.";
CM_ SG_ 154 OBJ_Relative_Long_Acc_V_1 "Validator for the relative lateral ground acceleration of the object.";
CM_ SG_ 154 OBJ_Relative_Long_Acc_STD_1 "STD of the relative lateral ground acceleration of the object.";
CM_ SG_ 154 OBJ_Rel_Long_Acc_STD_V_1 "Validator for the STD of the relative lateral ground acceleration.";
CM_ SG_ 154 OBJ_Relative_Long_Velocity_1 "The relative longtitudinal speed between the target and ego vehicle. ";
CM_ SG_ 154 OBJ_Relative_Long_Velocity_V_1 "Validator for the relative longtitudinal speed.";
CM_ SG_ 154 OBJ_Relative_Long_Vel_STD_1 "STD of the relative longtitudinal speed.";
CM_ SG_ 154 OBJ_Rel_Long_Vel_STD_V_1 "Validator for the STD of the relative longtitudinal speed.";
CM_ SG_ 154 OBJ_Relative_Lat_Velocity_1 "The relative lateral speed between the target and ego vehicle. ";
CM_ SG_ 154 OBJ_Relative_Lat_Velocity_V_1 "Validator for the relative lateral speed. ";
CM_ SG_ 154 OBJ_Relative_Lat_Velocity_STD_1 "STD of the relative lateral speed. ";
CM_ SG_ 154 OBJ_Rel_Lat_Vel_STD_V_1 "Validator for the STD of the relative lateral speed. ";
CM_ SG_ 154 OBJ_Long_Distance_1 "The longtitudinal distance from the object to the middle of the Rear-Left and Rear-Right corners of the host vehicle.  ";
CM_ SG_ 154 OBJ_Long_Distance_V_1 "Validator of the longtitudinal distance from the object to the middle of the rear-axle of the host.  ";
CM_ SG_ 154 OBJ_Long_Distance_STD_1 "STD of the  longtitudinal distance.";
CM_ SG_ 154 OBJ_Long_Distance_STD_V_1 "Validator for the STD of the  longtitudinal distance.";
CM_ SG_ 154 OBJ_Lat_Distance_1 "Lateral distance to the middle of the RL and RR corners.  ";
CM_ SG_ 154 OBJ_Lat_Distance_V_1 "Validator for the lateral distance of the object.";
CM_ SG_ 154 OBJ_Lat_Distance_STD_1 "STD of the lateral distance of the object.";
CM_ SG_ 154 OBJ_Lat_Distance_STD_V_1 "Validator for the STD of the lateral distance of the object.";
CM_ SG_ 154 OBJ_Absolute_Speed_1 "The absolute ground speed in the targets' heading direction.";
CM_ SG_ 154 OBJ_Absolute_Speed_V_1 "Validator for the absolute ground speed.";
CM_ SG_ 154 OBJ_Absolute_Speed_STD_1 "STD of the absolute ground speed.";
CM_ SG_ 154 OBJ_Absolute_Speed_STD_V_1 "Validator for the STD of the absolute ground speed.";
CM_ SG_ 154 OBJ_Heading_1 "The angle beetweenthe host longitudinal axis and target's heading (clockwise, e.g. PI/2 is a target crossing from left to right).";
CM_ SG_ 154 OBJ_Heading_V_1 "Validator for the object heading.";
CM_ SG_ 154 OBJ_Heading_STD_1 "STD of the object heading.";
CM_ SG_ 154 OBJ_Heading_STD_V_1 "Validator for the STD of the object heading.";
CM_ SG_ 154 OBJ_Angle_Rate_STD_1 "Standard deviation of the angular speed. (radians)";
CM_ SG_ 154 OBJ_Angle_Rate_STD_V_1 "Validator for the STD of the angular speed.";
CM_ SG_ 154 OBJ_Angle_Rate_1 "The momentary angular speed of the object. (radians)";
CM_ SG_ 154 OBJ_Angle_Rate_V_1 "Validator for the angular speed.";
CM_ SG_ 154 OBJ_Angle_Right_1 "The angle between the host longitudinal axis and the right side of the front / rear of the target (the visible one). The positive side is to the host's right.";
CM_ SG_ 154 OBJ_Angle_Right_V_1 "Validator for angleRight";
CM_ SG_ 154 OBJ_Angle_Right_STD_1 "Standard deviation of angleRight";
CM_ SG_ 154 OBJ_Angle_Right_STD_V_1 "Validator for the standard deviation of angleRight.";
CM_ SG_ 154 OBJ_Angle_Left_1 "The angle between the host longitudinal axis and the left side of the front / rear of the target (the visible one). The positive side is to the host's right.";
CM_ SG_ 154 OBJ_Angle_Left_V_1 "Validator for angleLeft.";
CM_ SG_ 154 OBJ_Angle_Left_STD_1 "Standard deviation of angleLeft.";
CM_ SG_ 154 OBJ_Angle_Left_STD_V_1 "Validator for the standard deviation of angleLeft.";
CM_ SG_ 154 OBJ_Angle_Side_1 "The angle between the host longitudinal axis and the far visible edge - the visible edge of the front / rear of the target that is not visible. Currently supported for vehicles only.";
CM_ SG_ 154 OBJ_Angle_Side_V_1 "Validator for angleSide.";
CM_ SG_ 154 OBJ_Angle_Side_STD_1 "Standard deviation of angleSide.";
CM_ SG_ 154 OBJ_Angle_Side_STD_V_1 "Validator for the STD of angleSide.";
CM_ SG_ 154 OBJ_Angle_Mid_V_1 "Validator for angleMid.";
CM_ SG_ 154 OBJ_Angle_Mid_1 "The angle between the host longitudinal axis and the middle of the front / rear of the target (the visible one). The positive side is to the host's right.";
CM_ SG_ 154 OBJ_Angle_Mid_STD_1 "Standard deviation of angleMid.";
CM_ SG_ 154 OBJ_Angle_Mid_STD_V_1 "Validator for the STD of angleMid.";
CM_ SG_ 154 OBJ_Angle_Bottom_V_1 "Validator for OBJAngle_Bottom. ";
CM_ SG_ 154 OBJ_Angle_Bottom_1 "The angle between the logitudinal axis and the Bottom of the front / rear of the target (the visible one). The positive side is to the hosts right";
CM_ SG_ 154 OBJ_Angle_Bottom_STD_1 "STD for OBJAngle_Bottom. ";
CM_ SG_ 154 OBJ_Angle_Bottom_STD_V_1 "Validator for OBJAngle_Bottom_STD. ";
CM_ SG_ 154 OBJ_Visibility_Side_V_1 "Currently Supported for VD only";
CM_ SG_ 154 OBJ_Visibility_Side_1 "From what car  side is the object visible";
CM_ SG_ 154 OBJ_Is_In_Drivable_Area_1 "Indicates whether the target is in a driveable area.";
CM_ SG_ 154 OBJ_Is_In_Drivable_Area_V_1 "Validator for OBJ_Is_In_Drivable_Area.";
CM_ SG_ 154 OBJ_Is_VeryClose_1 "Indicates whether the target is very close to the host such that it is hard to measure it's distance. Currently relevant for peds only. ";
CM_ SG_ 154 OBJ_Is_VeryClose_V_1 "Validator for OBJ_Is_VeryClose. ";
CM_ SG_ 154 OBJ_Occlusion_RL_1 "Was Rear left of the 3D detection of theobject occluded";
CM_ SG_ 154 OBJ_Occlusion_RR_1 "Was Rear Right of the 3D detection of theobject occluded";
CM_ SG_ 154 OBJ_Occlusion_FR_1 "Was front Right of the 3D detection of theobject occluded";
CM_ SG_ 154 OBJ_Occlusion_FL_1 "Was Front left of the 3D detection of theobject occluded";
CM_ SG_ 154 OBJ_CRC_2 "Calculated over each object signal";
CM_ SG_ 154 OBJ_ID_2 "The detected object ID. Range is 1-255, while 0 indicates that the field in unfilled.";
CM_ SG_ 154 OBJ_Existence_Probability_2 "The existence probability of the vehicle";
CM_ SG_ 154 OBJ_Fusion_Source_2 "sources ids used for fusion";
CM_ SG_ 154 OBJ_Triggered_SDM_2 "Indicates whether the object has trigered the SDM (Safety Diagnostic Manager) alert.";
CM_ SG_ 154 OBJ_Motion_Category_2 "Relevant for VD only. Full description of values can be found at the ACC guide.";
CM_ SG_ 154 OBJ_Object_Age_2 "The number of frames in which the object was recognized.";
CM_ SG_ 154 OBJ_Measuring_Status_2 "Measurment status. Old vs New marks if this is the first frame in which the object is reported. Predicted vs Measured marks if the report is raw or has been predicted forward in time using the measured dynamics and ego motion.";
CM_ SG_ 154 OBJ_Object_Class_2 "Indicates the object type. Uncertain is outputted in case the probability that a vehicle is a truck is very similar to the probability that it is a car. ";
CM_ SG_ 154 OBJ_Class_Probability_2 "The probability of this type classification.";
CM_ SG_ 154 OBJ_Camera_Source_2 "The camera in which this object was detected (best choice).";
CM_ SG_ 154 OBJ_Motion_Status_2 "MOVING - the object is moving STATIONARY - the object was never seen moving STOPPED -  the object was moving and has stopped MOVING_SLOWLY - the object is moving very slowly";
CM_ SG_ 154 OBJ_Motion_Orientation_2 "The direction of the target's heading compared to the host. ";
CM_ SG_ 154 OBJ_Has_Cut_Lane_2 "Indicates whether the object cut the host's (right or left) lane. In case there are no lanes, indicates whether the objects is at most 1 meters away from the host.";
CM_ SG_ 154 OBJ_Has_Cut_Path_2 "Indicates whether the object is in the host's path.";
CM_ SG_ 154 OBJ_Brake_Light_2 "Indication for brake lights ";
CM_ SG_ 154 OBJ_Turn_Indicator_Right_2 "Indication for blinking right light.";
CM_ SG_ 154 OBJ_Turn_Indicator_Left_2 "Indication for blinking left light ";
CM_ SG_ 154 OBJ_Light_Indicator_Validity_2 "Validator for light indicators";
CM_ SG_ 154 OBJ_Right_Out_Of_Image_2 "Indicates whether the measurment are predicted out of the right side of the image bounderies.";
CM_ SG_ 154 OBJ_Left_Out_Of_Image_2 "Indicates whether if measurment are predicted out of  the left side of the image bounderies";
CM_ SG_ 154 OBJ_Right_Out_Of_Image_V_2 "validator";
CM_ SG_ 154 OBJ_Left_Out_Of_Image_V_2 "validator";
CM_ SG_ 154 OBJ_Top_Out_Of_Image_2 "Indicates whether if measurment are predicted out of  the top of the image bounderies";
CM_ SG_ 154 OBJ_Bottom_Out_Of_Image_2 "validator";
CM_ SG_ 154 OBJ_Top_Out_Of_Image_V_2 "Indicates whether if measurment are predicted out of  the bottom of the image bounderies";
CM_ SG_ 154 OBJ_Bottom_Out_Of_Image_V_2 "validator";
CM_ SG_ 154 OBJ_Lane_Assignment_2 "The object's lane relative to the host lane.";
CM_ SG_ 154 OBJ_Lane_Assignment_V_2 "Validator for lane assignment";
CM_ SG_ 154 OBJ_Age_Seconds_2 "Time in seconds in which the object was recognized. Currently available for peds only. ";
CM_ SG_ 154 OBJ_Age_Seconds_V_2 "Validator for object age";
CM_ SG_ 154 OBJ_Width_2 "The width of the target vehicle in the world (not to be mistaken with the width of the visible part of the vehicle).";
CM_ SG_ 154 OBJ_Width_V_2 "Validator for object width";
CM_ SG_ 154 OBJ_Width_STD_2 "Standard deviation for object width";
CM_ SG_ 154 OBJ_Width_STD_V_2 "Validator for the standard deviation of object width";
CM_ SG_ 154 OBJ_Length_2 "The length of the vehicle in the world. For crossing bicycles it gives the viewed length of the bicycle.";
CM_ SG_ 154 OBJ_Length_V_2 "Validator for object length.";
CM_ SG_ 154 OBJ_Length_STD_2 "Standard deviation for object length.";
CM_ SG_ 154 OBJ_Length_STD_V_2 "Validator for the standard deviation of object length.";
CM_ SG_ 154 OBJ_Height_2 "The height of the object in the world. ";
CM_ SG_ 154 OBJ_Height_V_2 "Validator for object height.";
CM_ SG_ 154 OBJ_Height_STD_2 "Standard deviation for object height.";
CM_ SG_ 154 OBJ_Height_STD_V_2 "Validator for the standard deviation of object height.";
CM_ SG_ 154 OBJ_Abs_Long_Velocity_2 "Absolute longitudinal velocity.";
CM_ SG_ 154 OBJ_Abs_Long_Velocity_V_2 "Validator for absolute longitudinal velocity.";
CM_ SG_ 154 OBJ_Abs_Long_Velocity_STD_2 "Standard deviation of absolute longitudinal velocity.";
CM_ SG_ 154 OBJ_Abs_Long_Vel_STD_V_2 "Validator for the standard deviation of the absolute longitudinal velocity.";
CM_ SG_ 154 OBJ_Abs_Lat_Velocity_2 "The lateral ground speed of the object.";
CM_ SG_ 154 OBJ_Abs_Lat_Velocity_V_2 "Validator for the lateral ground speed of the object.";
CM_ SG_ 154 OBJ_Abs_Lat_Velocity_STD_2 "STD of the lateral ground speed of the object.";
CM_ SG_ 154 OBJ_Abs_Lat_Vel_STD_V_2 "Validator for the STD of the lateral ground speed of the object.";
CM_ SG_ 154 OBJ_Abs_Long_Acc_2 "The longitudinal ground acceleration of the object.";
CM_ SG_ 154 OBJ_Abs_Long_Acc_V_2 "Validator for the longitudinal ground acceleration of the object.";
CM_ SG_ 154 OBJ_Abs_Long_Acc_STD_2 "STD of the longitudinal ground acceleration of the object.";
CM_ SG_ 154 OBJ_Abs_Long_Acc_STD_V_2 "Validator for the STD of the longitudinal ground acceleration of the object.";
CM_ SG_ 154 OBJ_Abs_Lat_Acc_2 "The lateral ground acceleration of the object.";
CM_ SG_ 154 OBJ_Abs_Lat_Acc_V_2 "Validator for the lateral ground acceleration of the object.";
CM_ SG_ 154 OBJ_Abs_Lat_Acc_STD_2 "STD of the lateral ground acceleration of the object.";
CM_ SG_ 154 OBJ_Abs_Lat_Acc_STD_V_2 "Validator for the STD of the lateral ground acceleration of the object.";
CM_ SG_ 154 OBJ_Abs_Acceleration_2 "The absolute ground acceleration in the target's heading direction.";
CM_ SG_ 154 OBJ_Abs_Acceleration_V_2 "Validator for the absolute ground acceleration.";
CM_ SG_ 154 OBJ_Abs_Acc_STD_2 "STD of the absolute ground acceleration.";
CM_ SG_ 154 OBJ_Abs_Acc_STD_V_2 "Validator for the STD of the absolute ground acceleration.";
CM_ SG_ 154 OBJ_Inv_TTC_2 "Inverse TTC (time to collision).";
CM_ SG_ 154 OBJ_Inv_TTC_V_2 "Validator for Inverse TTC.";
CM_ SG_ 154 OBJ_Inv_TTC_STD_2 "STD for inverse TTC .";
CM_ SG_ 154 OBJ_Inv_TTC_STD_V_2 "Validator for the STD for inverse TTC .";
CM_ SG_ 154 OBJ_Relative_Long_Acc_2 "The relative lateral ground acceleration of the object.";
CM_ SG_ 154 OBJ_Relative_Long_Acc_V_2 "Validator for the relative lateral ground acceleration of the object.";
CM_ SG_ 154 OBJ_Relative_Long_Acc_STD_2 "STD of the relative lateral ground acceleration of the object.";
CM_ SG_ 154 OBJ_Rel_Long_Acc_STD_V_2 "Validator for the STD of the relative lateral ground acceleration.";
CM_ SG_ 154 OBJ_Relative_Long_Velocity_2 "The relative longtitudinal speed between the target and ego vehicle. ";
CM_ SG_ 154 OBJ_Relative_Long_Velocity_V_2 "Validator for the relative longtitudinal speed.";
CM_ SG_ 154 OBJ_Relative_Long_Vel_STD_2 "STD of the relative longtitudinal speed.";
CM_ SG_ 154 OBJ_Rel_Long_Vel_STD_V_2 "Validator for the STD of the relative longtitudinal speed.";
CM_ SG_ 154 OBJ_Relative_Lat_Velocity_2 "The relative lateral speed between the target and ego vehicle. ";
CM_ SG_ 154 OBJ_Relative_Lat_Velocity_V_2 "Validator for the relative lateral speed. ";
CM_ SG_ 154 OBJ_Relative_Lat_Velocity_STD_2 "STD of the relative lateral speed. ";
CM_ SG_ 154 OBJ_Rel_Lat_Vel_STD_V_2 "Validator for the STD of the relative lateral speed. ";
CM_ SG_ 154 OBJ_Long_Distance_2 "The longtitudinal distance from the object to the middle of the Rear-Left and Rear-Right corners of the host vehicle.  ";
CM_ SG_ 154 OBJ_Long_Distance_V_2 "Validator of the longtitudinal distance from the object to the middle of the rear-axle of the host.  ";
CM_ SG_ 154 OBJ_Long_Distance_STD_2 "STD of the  longtitudinal distance.";
CM_ SG_ 154 OBJ_Long_Distance_STD_V_2 "Validator for the STD of the  longtitudinal distance.";
CM_ SG_ 154 OBJ_Lat_Distance_2 "Lateral distance to the middle of the RL and RR corners.  ";
CM_ SG_ 154 OBJ_Lat_Distance_V_2 "Validator for the lateral distance of the object.";
CM_ SG_ 154 OBJ_Lat_Distance_STD_2 "STD of the lateral distance of the object.";
CM_ SG_ 154 OBJ_Lat_Distance_STD_V_2 "Validator for the STD of the lateral distance of the object.";
CM_ SG_ 154 OBJ_Absolute_Speed_2 "The absolute ground speed in the targets' heading direction.";
CM_ SG_ 154 OBJ_Absolute_Speed_V_2 "Validator for the absolute ground speed.";
CM_ SG_ 154 OBJ_Absolute_Speed_STD_2 "STD of the absolute ground speed.";
CM_ SG_ 154 OBJ_Absolute_Speed_STD_V_2 "Validator for the STD of the absolute ground speed.";
CM_ SG_ 154 OBJ_Heading_2 "The angle beetweenthe host longitudinal axis and target's heading (clockwise, e.g. PI/2 is a target crossing from left to right).";
CM_ SG_ 154 OBJ_Heading_V_2 "Validator for the object heading.";
CM_ SG_ 154 OBJ_Heading_STD_2 "STD of the object heading.";
CM_ SG_ 154 OBJ_Heading_STD_V_2 "Validator for the STD of the object heading.";
CM_ SG_ 154 OBJ_Angle_Rate_STD_2 "Standard deviation of the angular speed. (radians)";
CM_ SG_ 154 OBJ_Angle_Rate_STD_V_2 "Validator for the STD of the angular speed.";
CM_ SG_ 154 OBJ_Angle_Rate_2 "The momentary angular speed of the object. (radians)";
CM_ SG_ 154 OBJ_Angle_Rate_V_2 "Validator for the angular speed.";
CM_ SG_ 154 OBJ_Angle_Right_2 "The angle between the host longitudinal axis and the right side of the front / rear of the target (the visible one). The positive side is to the host's right.";
CM_ SG_ 154 OBJ_Angle_Right_V_2 "Validator for angleRight";
CM_ SG_ 154 OBJ_Angle_Right_STD_2 "Standard deviation of angleRight";
CM_ SG_ 154 OBJ_Angle_Right_STD_V_2 "Validator for the standard deviation of angleRight.";
CM_ SG_ 154 OBJ_Angle_Left_2 "The angle between the host longitudinal axis and the left side of the front / rear of the target (the visible one). The positive side is to the host's right.";
CM_ SG_ 154 OBJ_Angle_Left_V_2 "Validator for angleLeft.";
CM_ SG_ 154 OBJ_Angle_Left_STD_2 "Standard deviation of angleLeft.";
CM_ SG_ 154 OBJ_Angle_Left_STD_V_2 "Validator for the standard deviation of angleLeft.";
CM_ SG_ 154 OBJ_Angle_Side_2 "The angle between the host longitudinal axis and the far visible edge - the visible edge of the front / rear of the target that is not visible. Currently supported for vehicles only.";
CM_ SG_ 154 OBJ_Angle_Side_V_2 "Validator for angleSide.";
CM_ SG_ 154 OBJ_Angle_Side_STD_2 "Standard deviation of angleSide.";
CM_ SG_ 154 OBJ_Angle_Side_STD_V_2 "Validator for the STD of angleSide.";
CM_ SG_ 154 OBJ_Angle_Mid_V_2 "Validator for angleMid.";
CM_ SG_ 154 OBJ_Angle_Mid_2 "The angle between the host longitudinal axis and the middle of the front / rear of the target (the visible one). The positive side is to the host's right.";
CM_ SG_ 154 OBJ_Angle_Mid_STD_2 "Standard deviation of angleMid.";
CM_ SG_ 154 OBJ_Angle_Mid_STD_V_2 "Validator for the STD of angleMid.";
CM_ SG_ 154 OBJ_Angle_Bottom_V_2 "Validator for OBJAngle_Bottom. ";
CM_ SG_ 154 OBJ_Angle_Bottom_2 "The angle between the logitudinal axis and the Bottom of the front / rear of the target (the visible one). The positive side is to the hosts right";
CM_ SG_ 154 OBJ_Angle_Bottom_STD_2 "STD for OBJAngle_Bottom. ";
CM_ SG_ 154 OBJ_Angle_Bottom_STD_V_2 "Validator for OBJAngle_Bottom_STD. ";
CM_ SG_ 154 OBJ_Visibility_Side_V_2 "Currently Supported for VD only";
CM_ SG_ 154 OBJ_Visibility_Side_2 "From what car  side is the object visible";
CM_ SG_ 154 OBJ_Is_In_Drivable_Area_2 "Indicates whether the target is in a driveable area.";
CM_ SG_ 154 OBJ_Is_In_Drivable_Area_V_2 "Validator for OBJ_Is_In_Drivable_Area.";
CM_ SG_ 154 OBJ_Is_VeryClose_2 "Indicates whether the target is very close to the host such that it is hard to measure it's distance. Currently relevant for peds only. ";
CM_ SG_ 154 OBJ_Is_VeryClose_V_2 "Validator for OBJ_Is_VeryClose. ";
CM_ SG_ 154 OBJ_Occlusion_RL_2 "Was Rear left of the 3D detection of theobject occluded";
CM_ SG_ 154 OBJ_Occlusion_RR_2 "Was Rear Right of the 3D detection of theobject occluded";
CM_ SG_ 154 OBJ_Occlusion_FR_2 "Was front Right of the 3D detection of theobject occluded";
CM_ SG_ 154 OBJ_Occlusion_FL_2 "Was Front left of the 3D detection of theobject occluded";
CM_ SG_ 154 OBJ_CRC_3 "Calculated over each object signal";
CM_ SG_ 154 OBJ_ID_3 "The detected object ID. Range is 1-255, while 0 indicates that the field in unfilled.";
CM_ SG_ 154 OBJ_Existence_Probability_3 "The existence probability of the vehicle";
CM_ SG_ 154 OBJ_Fusion_Source_3 "sources ids used for fusion";
CM_ SG_ 154 OBJ_Triggered_SDM_3 "Indicates whether the object has trigered the SDM (Safety Diagnostic Manager) alert.";
CM_ SG_ 154 OBJ_Motion_Category_3 "Relevant for VD only. Full description of values can be found at the ACC guide.";
CM_ SG_ 154 OBJ_Object_Age_3 "The number of frames in which the object was recognized.";
CM_ SG_ 154 OBJ_Measuring_Status_3 "Measurment status. Old vs New marks if this is the first frame in which the object is reported. Predicted vs Measured marks if the report is raw or has been predicted forward in time using the measured dynamics and ego motion.";
CM_ SG_ 154 OBJ_Object_Class_3 "Indicates the object type. Uncertain is outputted in case the probability that a vehicle is a truck is very similar to the probability that it is a car. ";
CM_ SG_ 154 OBJ_Class_Probability_3 "The probability of this type classification.";
CM_ SG_ 154 OBJ_Camera_Source_3 "The camera in which this object was detected (best choice).";
CM_ SG_ 154 OBJ_Motion_Status_3 "MOVING - the object is moving STATIONARY - the object was never seen moving STOPPED -  the object was moving and has stopped MOVING_SLOWLY - the object is moving very slowly";
CM_ SG_ 154 OBJ_Motion_Orientation_3 "The direction of the target's heading compared to the host. ";
CM_ SG_ 154 OBJ_Has_Cut_Lane_3 "Indicates whether the object cut the host's (right or left) lane. In case there are no lanes, indicates whether the objects is at most 1 meters away from the host.";
CM_ SG_ 154 OBJ_Has_Cut_Path_3 "Indicates whether the object is in the host's path.";
CM_ SG_ 154 OBJ_Brake_Light_3 "Indication for brake lights ";
CM_ SG_ 154 OBJ_Turn_Indicator_Right_3 "Indication for blinking right light.";
CM_ SG_ 154 OBJ_Turn_Indicator_Left_3 "Indication for blinking left light ";
CM_ SG_ 154 OBJ_Light_Indicator_Validity_3 "Validator for light indicators";
CM_ SG_ 154 OBJ_Right_Out_Of_Image_3 "Indicates whether the measurment are predicted out of the right side of the image bounderies.";
CM_ SG_ 154 OBJ_Left_Out_Of_Image_3 "Indicates whether if measurment are predicted out of  the left side of the image bounderies";
CM_ SG_ 154 OBJ_Right_Out_Of_Image_V_3 "validator";
CM_ SG_ 154 OBJ_Left_Out_Of_Image_V_3 "validator";
CM_ SG_ 154 OBJ_Top_Out_Of_Image_3 "Indicates whether if measurment are predicted out of  the top of the image bounderies";
CM_ SG_ 154 OBJ_Bottom_Out_Of_Image_3 "validator";
CM_ SG_ 154 OBJ_Top_Out_Of_Image_V_3 "Indicates whether if measurment are predicted out of  the bottom of the image bounderies";
CM_ SG_ 154 OBJ_Bottom_Out_Of_Image_V_3 "validator";
CM_ SG_ 154 OBJ_Lane_Assignment_3 "The object's lane relative to the host lane.";
CM_ SG_ 154 OBJ_Lane_Assignment_V_3 "Validator for lane assignment";
CM_ SG_ 154 OBJ_Age_Seconds_3 "Time in seconds in which the object was recognized. Currently available for peds only. ";
CM_ SG_ 154 OBJ_Age_Seconds_V_3 "Validator for object age";
CM_ SG_ 154 OBJ_Width_3 "The width of the target vehicle in the world (not to be mistaken with the width of the visible part of the vehicle).";
CM_ SG_ 154 OBJ_Width_V_3 "Validator for object width";
CM_ SG_ 154 OBJ_Width_STD_3 "Standard deviation for object width";
CM_ SG_ 154 OBJ_Width_STD_V_3 "Validator for the standard deviation of object width";
CM_ SG_ 154 OBJ_Length_3 "The length of the vehicle in the world. For crossing bicycles it gives the viewed length of the bicycle.";
CM_ SG_ 154 OBJ_Length_V_3 "Validator for object length.";
CM_ SG_ 154 OBJ_Length_STD_3 "Standard deviation for object length.";
CM_ SG_ 154 OBJ_Length_STD_V_3 "Validator for the standard deviation of object length.";
CM_ SG_ 154 OBJ_Height_3 "The height of the object in the world. ";
CM_ SG_ 154 OBJ_Height_V_3 "Validator for object height.";
CM_ SG_ 154 OBJ_Height_STD_3 "Standard deviation for object height.";
CM_ SG_ 154 OBJ_Height_STD_V_3 "Validator for the standard deviation of object height.";
CM_ SG_ 154 OBJ_Abs_Long_Velocity_3 "Absolute longitudinal velocity.";
CM_ SG_ 154 OBJ_Abs_Long_Velocity_V_3 "Validator for absolute longitudinal velocity.";
CM_ SG_ 154 OBJ_Abs_Long_Velocity_STD_3 "Standard deviation of absolute longitudinal velocity.";
CM_ SG_ 154 OBJ_Abs_Long_Vel_STD_V_3 "Validator for the standard deviation of the absolute longitudinal velocity.";
CM_ SG_ 154 OBJ_Abs_Lat_Velocity_3 "The lateral ground speed of the object.";
CM_ SG_ 154 OBJ_Abs_Lat_Velocity_V_3 "Validator for the lateral ground speed of the object.";
CM_ SG_ 154 OBJ_Abs_Lat_Velocity_STD_3 "STD of the lateral ground speed of the object.";
CM_ SG_ 154 OBJ_Abs_Lat_Vel_STD_V_3 "Validator for the STD of the lateral ground speed of the object.";
CM_ SG_ 154 OBJ_Abs_Long_Acc_3 "The longitudinal ground acceleration of the object.";
CM_ SG_ 154 OBJ_Abs_Long_Acc_V_3 "Validator for the longitudinal ground acceleration of the object.";
CM_ SG_ 154 OBJ_Abs_Long_Acc_STD_3 "STD of the longitudinal ground acceleration of the object.";
CM_ SG_ 154 OBJ_Abs_Long_Acc_STD_V_3 "Validator for the STD of the longitudinal ground acceleration of the object.";
CM_ SG_ 154 OBJ_Abs_Lat_Acc_3 "The lateral ground acceleration of the object.";
CM_ SG_ 154 OBJ_Abs_Lat_Acc_V_3 "Validator for the lateral ground acceleration of the object.";
CM_ SG_ 154 OBJ_Abs_Lat_Acc_STD_3 "STD of the lateral ground acceleration of the object.";
CM_ SG_ 154 OBJ_Abs_Lat_Acc_STD_V_3 "Validator for the STD of the lateral ground acceleration of the object.";
CM_ SG_ 154 OBJ_Abs_Acceleration_3 "The absolute ground acceleration in the target's heading direction.";
CM_ SG_ 154 OBJ_Abs_Acceleration_V_3 "Validator for the absolute ground acceleration.";
CM_ SG_ 154 OBJ_Abs_Acc_STD_3 "STD of the absolute ground acceleration.";
CM_ SG_ 154 OBJ_Abs_Acc_STD_V_3 "Validator for the STD of the absolute ground acceleration.";
CM_ SG_ 154 OBJ_Inv_TTC_3 "Inverse TTC (time to collision).";
CM_ SG_ 154 OBJ_Inv_TTC_V_3 "Validator for Inverse TTC.";
CM_ SG_ 154 OBJ_Inv_TTC_STD_3 "STD for inverse TTC .";
CM_ SG_ 154 OBJ_Inv_TTC_STD_V_3 "Validator for the STD for inverse TTC .";
CM_ SG_ 154 OBJ_Relative_Long_Acc_3 "The relative lateral ground acceleration of the object.";
CM_ SG_ 154 OBJ_Relative_Long_Acc_V_3 "Validator for the relative lateral ground acceleration of the object.";
CM_ SG_ 154 OBJ_Relative_Long_Acc_STD_3 "STD of the relative lateral ground acceleration of the object.";
CM_ SG_ 154 OBJ_Rel_Long_Acc_STD_V_3 "Validator for the STD of the relative lateral ground acceleration.";
CM_ SG_ 154 OBJ_Relative_Long_Velocity_3 "The relative longtitudinal speed between the target and ego vehicle. ";
CM_ SG_ 154 OBJ_Relative_Long_Velocity_V_3 "Validator for the relative longtitudinal speed.";
CM_ SG_ 154 OBJ_Relative_Long_Vel_STD_3 "STD of the relative longtitudinal speed.";
CM_ SG_ 154 OBJ_Rel_Long_Vel_STD_V_3 "Validator for the STD of the relative longtitudinal speed.";
CM_ SG_ 154 OBJ_Relative_Lat_Velocity_3 "The relative lateral speed between the target and ego vehicle. ";
CM_ SG_ 154 OBJ_Relative_Lat_Velocity_V_3 "Validator for the relative lateral speed. ";
CM_ SG_ 154 OBJ_Relative_Lat_Velocity_STD_3 "STD of the relative lateral speed. ";
CM_ SG_ 154 OBJ_Rel_Lat_Vel_STD_V_3 "Validator for the STD of the relative lateral speed. ";
CM_ SG_ 154 OBJ_Long_Distance_3 "The longtitudinal distance from the object to the middle of the Rear-Left and Rear-Right corners of the host vehicle.  ";
CM_ SG_ 154 OBJ_Long_Distance_V_3 "Validator of the longtitudinal distance from the object to the middle of the rear-axle of the host.  ";
CM_ SG_ 154 OBJ_Long_Distance_STD_3 "STD of the  longtitudinal distance.";
CM_ SG_ 154 OBJ_Long_Distance_STD_V_3 "Validator for the STD of the  longtitudinal distance.";
CM_ SG_ 154 OBJ_Lat_Distance_3 "Lateral distance to the middle of the RL and RR corners.  ";
CM_ SG_ 154 OBJ_Lat_Distance_V_3 "Validator for the lateral distance of the object.";
CM_ SG_ 154 OBJ_Lat_Distance_STD_3 "STD of the lateral distance of the object.";
CM_ SG_ 154 OBJ_Lat_Distance_STD_V_3 "Validator for the STD of the lateral distance of the object.";
CM_ SG_ 154 OBJ_Absolute_Speed_3 "The absolute ground speed in the targets' heading direction.";
CM_ SG_ 154 OBJ_Absolute_Speed_V_3 "Validator for the absolute ground speed.";
CM_ SG_ 154 OBJ_Absolute_Speed_STD_3 "STD of the absolute ground speed.";
CM_ SG_ 154 OBJ_Absolute_Speed_STD_V_3 "Validator for the STD of the absolute ground speed.";
CM_ SG_ 154 OBJ_Heading_3 "The angle beetweenthe host longitudinal axis and target's heading (clockwise, e.g. PI/2 is a target crossing from left to right).";
CM_ SG_ 154 OBJ_Heading_V_3 "Validator for the object heading.";
CM_ SG_ 154 OBJ_Heading_STD_3 "STD of the object heading.";
CM_ SG_ 154 OBJ_Heading_STD_V_3 "Validator for the STD of the object heading.";
CM_ SG_ 154 OBJ_Angle_Rate_STD_3 "Standard deviation of the angular speed. (radians)";
CM_ SG_ 154 OBJ_Angle_Rate_STD_V_3 "Validator for the STD of the angular speed.";
CM_ SG_ 154 OBJ_Angle_Rate_3 "The momentary angular speed of the object. (radians)";
CM_ SG_ 154 OBJ_Angle_Rate_V_3 "Validator for the angular speed.";
CM_ SG_ 154 OBJ_Angle_Right_3 "The angle between the host longitudinal axis and the right side of the front / rear of the target (the visible one). The positive side is to the host's right.";
CM_ SG_ 154 OBJ_Angle_Right_V_3 "Validator for angleRight";
CM_ SG_ 154 OBJ_Angle_Right_STD_3 "Standard deviation of angleRight";
CM_ SG_ 154 OBJ_Angle_Right_STD_V_3 "Validator for the standard deviation of angleRight.";
CM_ SG_ 154 OBJ_Angle_Left_3 "The angle between the host longitudinal axis and the left side of the front / rear of the target (the visible one). The positive side is to the host's right.";
CM_ SG_ 154 OBJ_Angle_Left_V_3 "Validator for angleLeft.";
CM_ SG_ 154 OBJ_Angle_Left_STD_3 "Standard deviation of angleLeft.";
CM_ SG_ 154 OBJ_Angle_Left_STD_V_3 "Validator for the standard deviation of angleLeft.";
CM_ SG_ 154 OBJ_Angle_Side_3 "The angle between the host longitudinal axis and the far visible edge - the visible edge of the front / rear of the target that is not visible. Currently supported for vehicles only.";
CM_ SG_ 154 OBJ_Angle_Side_V_3 "Validator for angleSide.";
CM_ SG_ 154 OBJ_Angle_Side_STD_3 "Standard deviation of angleSide.";
CM_ SG_ 154 OBJ_Angle_Side_STD_V_3 "Validator for the STD of angleSide.";
CM_ SG_ 154 OBJ_Angle_Mid_V_3 "Validator for angleMid.";
CM_ SG_ 154 OBJ_Angle_Mid_3 "The angle between the host longitudinal axis and the middle of the front / rear of the target (the visible one). The positive side is to the host's right.";
CM_ SG_ 154 OBJ_Angle_Mid_STD_3 "Standard deviation of angleMid.";
CM_ SG_ 154 OBJ_Angle_Mid_STD_V_3 "Validator for the STD of angleMid.";
CM_ SG_ 154 OBJ_Angle_Bottom_V_3 "Validator for OBJAngle_Bottom. ";
CM_ SG_ 154 OBJ_Angle_Bottom_3 "The angle between the logitudinal axis and the Bottom of the front / rear of the target (the visible one). The positive side is to the hosts right";
CM_ SG_ 154 OBJ_Angle_Bottom_STD_3 "STD for OBJAngle_Bottom. ";
CM_ SG_ 154 OBJ_Angle_Bottom_STD_V_3 "Validator for OBJAngle_Bottom_STD. ";
CM_ SG_ 154 OBJ_Visibility_Side_V_3 "Currently Supported for VD only";
CM_ SG_ 154 OBJ_Visibility_Side_3 "From what car  side is the object visible";
CM_ SG_ 154 OBJ_Is_In_Drivable_Area_3 "Indicates whether the target is in a driveable area.";
CM_ SG_ 154 OBJ_Is_In_Drivable_Area_V_3 "Validator for OBJ_Is_In_Drivable_Area.";
CM_ SG_ 154 OBJ_Is_VeryClose_3 "Indicates whether the target is very close to the host such that it is hard to measure it's distance. Currently relevant for peds only. ";
CM_ SG_ 154 OBJ_Is_VeryClose_V_3 "Validator for OBJ_Is_VeryClose. ";
CM_ SG_ 154 OBJ_Occlusion_RL_3 "Was Rear left of the 3D detection of theobject occluded";
CM_ SG_ 154 OBJ_Occlusion_RR_3 "Was Rear Right of the 3D detection of theobject occluded";
CM_ SG_ 154 OBJ_Occlusion_FR_3 "Was front Right of the 3D detection of theobject occluded";
CM_ SG_ 154 OBJ_Occlusion_FL_3 "Was Front left of the 3D detection of theobject occluded";
CM_ SG_ 154 OBJ_CRC_4 "Calculated over each object signal";
CM_ SG_ 154 OBJ_ID_4 "The detected object ID. Range is 1-255, while 0 indicates that the field in unfilled.";
CM_ SG_ 154 OBJ_Existence_Probability_4 "The existence probability of the vehicle";
CM_ SG_ 154 OBJ_Fusion_Source_4 "sources ids used for fusion";
CM_ SG_ 154 OBJ_Triggered_SDM_4 "Indicates whether the object has trigered the SDM (Safety Diagnostic Manager) alert.";
CM_ SG_ 154 OBJ_Motion_Category_4 "Relevant for VD only. Full description of values can be found at the ACC guide.";
CM_ SG_ 154 OBJ_Object_Age_4 "The number of frames in which the object was recognized.";
CM_ SG_ 154 OBJ_Measuring_Status_4 "Measurment status. Old vs New marks if this is the first frame in which the object is reported. Predicted vs Measured marks if the report is raw or has been predicted forward in time using the measured dynamics and ego motion.";
CM_ SG_ 154 OBJ_Object_Class_4 "Indicates the object type. Uncertain is outputted in case the probability that a vehicle is a truck is very similar to the probability that it is a car. ";
CM_ SG_ 154 OBJ_Class_Probability_4 "The probability of this type classification.";
CM_ SG_ 154 OBJ_Camera_Source_4 "The camera in which this object was detected (best choice).";
CM_ SG_ 154 OBJ_Motion_Status_4 "MOVING - the object is moving STATIONARY - the object was never seen moving STOPPED -  the object was moving and has stopped MOVING_SLOWLY - the object is moving very slowly";
CM_ SG_ 154 OBJ_Motion_Orientation_4 "The direction of the target's heading compared to the host. ";
CM_ SG_ 154 OBJ_Has_Cut_Lane_4 "Indicates whether the object cut the host's (right or left) lane. In case there are no lanes, indicates whether the objects is at most 1 meters away from the host.";
CM_ SG_ 154 OBJ_Has_Cut_Path_4 "Indicates whether the object is in the host's path.";
CM_ SG_ 154 OBJ_Brake_Light_4 "Indication for brake lights ";
CM_ SG_ 154 OBJ_Turn_Indicator_Right_4 "Indication for blinking right light.";
CM_ SG_ 154 OBJ_Turn_Indicator_Left_4 "Indication for blinking left light ";
CM_ SG_ 154 OBJ_Light_Indicator_Validity_4 "Validator for light indicators";
CM_ SG_ 154 OBJ_Right_Out_Of_Image_4 "Indicates whether the measurment are predicted out of the right side of the image bounderies.";
CM_ SG_ 154 OBJ_Left_Out_Of_Image_4 "Indicates whether if measurment are predicted out of  the left side of the image bounderies";
CM_ SG_ 154 OBJ_Right_Out_Of_Image_V_4 "validator";
CM_ SG_ 154 OBJ_Left_Out_Of_Image_V_4 "validator";
CM_ SG_ 154 OBJ_Top_Out_Of_Image_4 "Indicates whether if measurment are predicted out of  the top of the image bounderies";
CM_ SG_ 154 OBJ_Bottom_Out_Of_Image_4 "validator";
CM_ SG_ 154 OBJ_Top_Out_Of_Image_V_4 "Indicates whether if measurment are predicted out of  the bottom of the image bounderies";
CM_ SG_ 154 OBJ_Bottom_Out_Of_Image_V_4 "validator";
CM_ SG_ 154 OBJ_Lane_Assignment_4 "The object's lane relative to the host lane.";
CM_ SG_ 154 OBJ_Lane_Assignment_V_4 "Validator for lane assignment";
CM_ SG_ 154 OBJ_Age_Seconds_4 "Time in seconds in which the object was recognized. Currently available for peds only. ";
CM_ SG_ 154 OBJ_Age_Seconds_V_4 "Validator for object age";
CM_ SG_ 154 OBJ_Width_4 "The width of the target vehicle in the world (not to be mistaken with the width of the visible part of the vehicle).";
CM_ SG_ 154 OBJ_Width_V_4 "Validator for object width";
CM_ SG_ 154 OBJ_Width_STD_4 "Standard deviation for object width";
CM_ SG_ 154 OBJ_Width_STD_V_4 "Validator for the standard deviation of object width";
CM_ SG_ 154 OBJ_Length_4 "The length of the vehicle in the world. For crossing bicycles it gives the viewed length of the bicycle.";
CM_ SG_ 154 OBJ_Length_V_4 "Validator for object length.";
CM_ SG_ 154 OBJ_Length_STD_4 "Standard deviation for object length.";
CM_ SG_ 154 OBJ_Length_STD_V_4 "Validator for the standard deviation of object length.";
CM_ SG_ 154 OBJ_Height_4 "The height of the object in the world. ";
CM_ SG_ 154 OBJ_Height_V_4 "Validator for object height.";
CM_ SG_ 154 OBJ_Height_STD_4 "Standard deviation for object height.";
CM_ SG_ 154 OBJ_Height_STD_V_4 "Validator for the standard deviation of object height.";
CM_ SG_ 154 OBJ_Abs_Long_Velocity_4 "Absolute longitudinal velocity.";
CM_ SG_ 154 OBJ_Abs_Long_Velocity_V_4 "Validator for absolute longitudinal velocity.";
CM_ SG_ 154 OBJ_Abs_Long_Velocity_STD_4 "Standard deviation of absolute longitudinal velocity.";
CM_ SG_ 154 OBJ_Abs_Long_Vel_STD_V_4 "Validator for the standard deviation of the absolute longitudinal velocity.";
CM_ SG_ 154 OBJ_Abs_Lat_Velocity_4 "The lateral ground speed of the object.";
CM_ SG_ 154 OBJ_Abs_Lat_Velocity_V_4 "Validator for the lateral ground speed of the object.";
CM_ SG_ 154 OBJ_Abs_Lat_Velocity_STD_4 "STD of the lateral ground speed of the object.";
CM_ SG_ 154 OBJ_Abs_Lat_Vel_STD_V_4 "Validator for the STD of the lateral ground speed of the object.";
CM_ SG_ 154 OBJ_Abs_Long_Acc_4 "The longitudinal ground acceleration of the object.";
CM_ SG_ 154 OBJ_Abs_Long_Acc_V_4 "Validator for the longitudinal ground acceleration of the object.";
CM_ SG_ 154 OBJ_Abs_Long_Acc_STD_4 "STD of the longitudinal ground acceleration of the object.";
CM_ SG_ 154 OBJ_Abs_Long_Acc_STD_V_4 "Validator for the STD of the longitudinal ground acceleration of the object.";
CM_ SG_ 154 OBJ_Abs_Lat_Acc_4 "The lateral ground acceleration of the object.";
CM_ SG_ 154 OBJ_Abs_Lat_Acc_V_4 "Validator for the lateral ground acceleration of the object.";
CM_ SG_ 154 OBJ_Abs_Lat_Acc_STD_4 "STD of the lateral ground acceleration of the object.";
CM_ SG_ 154 OBJ_Abs_Lat_Acc_STD_V_4 "Validator for the STD of the lateral ground acceleration of the object.";
CM_ SG_ 154 OBJ_Abs_Acceleration_4 "The absolute ground acceleration in the target's heading direction.";
CM_ SG_ 154 OBJ_Abs_Acceleration_V_4 "Validator for the absolute ground acceleration.";
CM_ SG_ 154 OBJ_Abs_Acc_STD_4 "STD of the absolute ground acceleration.";
CM_ SG_ 154 OBJ_Abs_Acc_STD_V_4 "Validator for the STD of the absolute ground acceleration.";
CM_ SG_ 154 OBJ_Inv_TTC_4 "Inverse TTC (time to collision).";
CM_ SG_ 154 OBJ_Inv_TTC_V_4 "Validator for Inverse TTC.";
CM_ SG_ 154 OBJ_Inv_TTC_STD_4 "STD for inverse TTC .";
CM_ SG_ 154 OBJ_Inv_TTC_STD_V_4 "Validator for the STD for inverse TTC .";
CM_ SG_ 154 OBJ_Relative_Long_Acc_4 "The relative lateral ground acceleration of the object.";
CM_ SG_ 154 OBJ_Relative_Long_Acc_V_4 "Validator for the relative lateral ground acceleration of the object.";
CM_ SG_ 154 OBJ_Relative_Long_Acc_STD_4 "STD of the relative lateral ground acceleration of the object.";
CM_ SG_ 154 OBJ_Rel_Long_Acc_STD_V_4 "Validator for the STD of the relative lateral ground acceleration.";
CM_ SG_ 154 OBJ_Relative_Long_Velocity_4 "The relative longtitudinal speed between the target and ego vehicle. ";
CM_ SG_ 154 OBJ_Relative_Long_Velocity_V_4 "Validator for the relative longtitudinal speed.";
CM_ SG_ 154 OBJ_Relative_Long_Vel_STD_4 "STD of the relative longtitudinal speed.";
CM_ SG_ 154 OBJ_Rel_Long_Vel_STD_V_4 "Validator for the STD of the relative longtitudinal speed.";
CM_ SG_ 154 OBJ_Relative_Lat_Velocity_4 "The relative lateral speed between the target and ego vehicle. ";
CM_ SG_ 154 OBJ_Relative_Lat_Velocity_V_4 "Validator for the relative lateral speed. ";
CM_ SG_ 154 OBJ_Relative_Lat_Velocity_STD_4 "STD of the relative lateral speed. ";
CM_ SG_ 154 OBJ_Rel_Lat_Vel_STD_V_4 "Validator for the STD of the relative lateral speed. ";
CM_ SG_ 154 OBJ_Long_Distance_4 "The longtitudinal distance from the object to the middle of the Rear-Left and Rear-Right corners of the host vehicle.  ";
CM_ SG_ 154 OBJ_Long_Distance_V_4 "Validator of the longtitudinal distance from the object to the middle of the rear-axle of the host.  ";
CM_ SG_ 154 OBJ_Long_Distance_STD_4 "STD of the  longtitudinal distance.";
CM_ SG_ 154 OBJ_Long_Distance_STD_V_4 "Validator for the STD of the  longtitudinal distance.";
CM_ SG_ 154 OBJ_Lat_Distance_4 "Lateral distance to the middle of the RL and RR corners.  ";
CM_ SG_ 154 OBJ_Lat_Distance_V_4 "Validator for the lateral distance of the object.";
CM_ SG_ 154 OBJ_Lat_Distance_STD_4 "STD of the lateral distance of the object.";
CM_ SG_ 154 OBJ_Lat_Distance_STD_V_4 "Validator for the STD of the lateral distance of the object.";
CM_ SG_ 154 OBJ_Absolute_Speed_4 "The absolute ground speed in the targets' heading direction.";
CM_ SG_ 154 OBJ_Absolute_Speed_V_4 "Validator for the absolute ground speed.";
CM_ SG_ 154 OBJ_Absolute_Speed_STD_4 "STD of the absolute ground speed.";
CM_ SG_ 154 OBJ_Absolute_Speed_STD_V_4 "Validator for the STD of the absolute ground speed.";
CM_ SG_ 154 OBJ_Heading_4 "The angle beetweenthe host longitudinal axis and target's heading (clockwise, e.g. PI/2 is a target crossing from left to right).";
CM_ SG_ 154 OBJ_Heading_V_4 "Validator for the object heading.";
CM_ SG_ 154 OBJ_Heading_STD_4 "STD of the object heading.";
CM_ SG_ 154 OBJ_Heading_STD_V_4 "Validator for the STD of the object heading.";
CM_ SG_ 154 OBJ_Angle_Rate_STD_4 "Standard deviation of the angular speed. (radians)";
CM_ SG_ 154 OBJ_Angle_Rate_STD_V_4 "Validator for the STD of the angular speed.";
CM_ SG_ 154 OBJ_Angle_Rate_4 "The momentary angular speed of the object. (radians)";
CM_ SG_ 154 OBJ_Angle_Rate_V_4 "Validator for the angular speed.";
CM_ SG_ 154 OBJ_Angle_Right_4 "The angle between the host longitudinal axis and the right side of the front / rear of the target (the visible one). The positive side is to the host's right.";
CM_ SG_ 154 OBJ_Angle_Right_V_4 "Validator for angleRight";
CM_ SG_ 154 OBJ_Angle_Right_STD_4 "Standard deviation of angleRight";
CM_ SG_ 154 OBJ_Angle_Right_STD_V_4 "Validator for the standard deviation of angleRight.";
CM_ SG_ 154 OBJ_Angle_Left_4 "The angle between the host longitudinal axis and the left side of the front / rear of the target (the visible one). The positive side is to the host's right.";
CM_ SG_ 154 OBJ_Angle_Left_V_4 "Validator for angleLeft.";
CM_ SG_ 154 OBJ_Angle_Left_STD_4 "Standard deviation of angleLeft.";
CM_ SG_ 154 OBJ_Angle_Left_STD_V_4 "Validator for the standard deviation of angleLeft.";
CM_ SG_ 154 OBJ_Angle_Side_4 "The angle between the host longitudinal axis and the far visible edge - the visible edge of the front / rear of the target that is not visible. Currently supported for vehicles only.";
CM_ SG_ 154 OBJ_Angle_Side_V_4 "Validator for angleSide.";
CM_ SG_ 154 OBJ_Angle_Side_STD_4 "Standard deviation of angleSide.";
CM_ SG_ 154 OBJ_Angle_Side_STD_V_4 "Validator for the STD of angleSide.";
CM_ SG_ 154 OBJ_Angle_Mid_V_4 "Validator for angleMid.";
CM_ SG_ 154 OBJ_Angle_Mid_4 "The angle between the host longitudinal axis and the middle of the front / rear of the target (the visible one). The positive side is to the host's right.";
CM_ SG_ 154 OBJ_Angle_Mid_STD_4 "Standard deviation of angleMid.";
CM_ SG_ 154 OBJ_Angle_Mid_STD_V_4 "Validator for the STD of angleMid.";
CM_ SG_ 154 OBJ_Angle_Bottom_V_4 "Validator for OBJAngle_Bottom. ";
CM_ SG_ 154 OBJ_Angle_Bottom_4 "The angle between the logitudinal axis and the Bottom of the front / rear of the target (the visible one). The positive side is to the hosts right";
CM_ SG_ 154 OBJ_Angle_Bottom_STD_4 "STD for OBJAngle_Bottom. ";
CM_ SG_ 154 OBJ_Angle_Bottom_STD_V_4 "Validator for OBJAngle_Bottom_STD. ";
CM_ SG_ 154 OBJ_Visibility_Side_V_4 "Currently Supported for VD only";
CM_ SG_ 154 OBJ_Visibility_Side_4 "From what car  side is the object visible";
CM_ SG_ 154 OBJ_Is_In_Drivable_Area_4 "Indicates whether the target is in a driveable area.";
CM_ SG_ 154 OBJ_Is_In_Drivable_Area_V_4 "Validator for OBJ_Is_In_Drivable_Area.";
CM_ SG_ 154 OBJ_Is_VeryClose_4 "Indicates whether the target is very close to the host such that it is hard to measure it's distance. Currently relevant for peds only. ";
CM_ SG_ 154 OBJ_Is_VeryClose_V_4 "Validator for OBJ_Is_VeryClose. ";
CM_ SG_ 154 OBJ_Occlusion_RL_4 "Was Rear left of the 3D detection of theobject occluded";
CM_ SG_ 154 OBJ_Occlusion_RR_4 "Was Rear Right of the 3D detection of theobject occluded";
CM_ SG_ 154 OBJ_Occlusion_FR_4 "Was front Right of the 3D detection of theobject occluded";
CM_ SG_ 154 OBJ_Occlusion_FL_4 "Was Front left of the 3D detection of theobject occluded";
CM_ SG_ 154 OBJ_CRC_5 "Calculated over each object signal";
CM_ SG_ 154 OBJ_ID_5 "The detected object ID. Range is 1-255, while 0 indicates that the field in unfilled.";
CM_ SG_ 154 OBJ_Existence_Probability_5 "The existence probability of the vehicle";
CM_ SG_ 154 OBJ_Fusion_Source_5 "sources ids used for fusion";
CM_ SG_ 154 OBJ_Triggered_SDM_5 "Indicates whether the object has trigered the SDM (Safety Diagnostic Manager) alert.";
CM_ SG_ 154 OBJ_Motion_Category_5 "Relevant for VD only. Full description of values can be found at the ACC guide.";
CM_ SG_ 154 OBJ_Object_Age_5 "The number of frames in which the object was recognized.";
CM_ SG_ 154 OBJ_Measuring_Status_5 "Measurment status. Old vs New marks if this is the first frame in which the object is reported. Predicted vs Measured marks if the report is raw or has been predicted forward in time using the measured dynamics and ego motion.";
CM_ SG_ 154 OBJ_Object_Class_5 "Indicates the object type. Uncertain is outputted in case the probability that a vehicle is a truck is very similar to the probability that it is a car. ";
CM_ SG_ 154 OBJ_Class_Probability_5 "The probability of this type classification.";
CM_ SG_ 154 OBJ_Camera_Source_5 "The camera in which this object was detected (best choice).";
CM_ SG_ 154 OBJ_Motion_Status_5 "MOVING - the object is moving STATIONARY - the object was never seen moving STOPPED -  the object was moving and has stopped MOVING_SLOWLY - the object is moving very slowly";
CM_ SG_ 154 OBJ_Motion_Orientation_5 "The direction of the target's heading compared to the host. ";
CM_ SG_ 154 OBJ_Has_Cut_Lane_5 "Indicates whether the object cut the host's (right or left) lane. In case there are no lanes, indicates whether the objects is at most 1 meters away from the host.";
CM_ SG_ 154 OBJ_Has_Cut_Path_5 "Indicates whether the object is in the host's path.";
CM_ SG_ 154 OBJ_Brake_Light_5 "Indication for brake lights ";
CM_ SG_ 154 OBJ_Turn_Indicator_Right_5 "Indication for blinking right light.";
CM_ SG_ 154 OBJ_Turn_Indicator_Left_5 "Indication for blinking left light ";
CM_ SG_ 154 OBJ_Light_Indicator_Validity_5 "Validator for light indicators";
CM_ SG_ 154 OBJ_Right_Out_Of_Image_5 "Indicates whether the measurment are predicted out of the right side of the image bounderies.";
CM_ SG_ 154 OBJ_Left_Out_Of_Image_5 "Indicates whether if measurment are predicted out of  the left side of the image bounderies";
CM_ SG_ 154 OBJ_Right_Out_Of_Image_V_5 "validator";
CM_ SG_ 154 OBJ_Left_Out_Of_Image_V_5 "validator";
CM_ SG_ 154 OBJ_Top_Out_Of_Image_5 "Indicates whether if measurment are predicted out of  the top of the image bounderies";
CM_ SG_ 154 OBJ_Bottom_Out_Of_Image_5 "validator";
CM_ SG_ 154 OBJ_Top_Out_Of_Image_V_5 "Indicates whether if measurment are predicted out of  the bottom of the image bounderies";
CM_ SG_ 154 OBJ_Bottom_Out_Of_Image_V_5 "validator";
CM_ SG_ 154 OBJ_Lane_Assignment_5 "The object's lane relative to the host lane.";
CM_ SG_ 154 OBJ_Lane_Assignment_V_5 "Validator for lane assignment";
CM_ SG_ 154 OBJ_Age_Seconds_5 "Time in seconds in which the object was recognized. Currently available for peds only. ";
CM_ SG_ 154 OBJ_Age_Seconds_V_5 "Validator for object age";
CM_ SG_ 154 OBJ_Width_5 "The width of the target vehicle in the world (not to be mistaken with the width of the visible part of the vehicle).";
CM_ SG_ 154 OBJ_Width_V_5 "Validator for object width";
CM_ SG_ 154 OBJ_Width_STD_5 "Standard deviation for object width";
CM_ SG_ 154 OBJ_Width_STD_V_5 "Validator for the standard deviation of object width";
CM_ SG_ 154 OBJ_Length_5 "The length of the vehicle in the world. For crossing bicycles it gives the viewed length of the bicycle.";
CM_ SG_ 154 OBJ_Length_V_5 "Validator for object length.";
CM_ SG_ 154 OBJ_Length_STD_5 "Standard deviation for object length.";
CM_ SG_ 154 OBJ_Length_STD_V_5 "Validator for the standard deviation of object length.";
CM_ SG_ 154 OBJ_Height_5 "The height of the object in the world. ";
CM_ SG_ 154 OBJ_Height_V_5 "Validator for object height.";
CM_ SG_ 154 OBJ_Height_STD_5 "Standard deviation for object height.";
CM_ SG_ 154 OBJ_Height_STD_V_5 "Validator for the standard deviation of object height.";
CM_ SG_ 154 OBJ_Abs_Long_Velocity_5 "Absolute longitudinal velocity.";
CM_ SG_ 154 OBJ_Abs_Long_Velocity_V_5 "Validator for absolute longitudinal velocity.";
CM_ SG_ 154 OBJ_Abs_Long_Velocity_STD_5 "Standard deviation of absolute longitudinal velocity.";
CM_ SG_ 154 OBJ_Abs_Long_Vel_STD_V_5 "Validator for the standard deviation of the absolute longitudinal velocity.";
CM_ SG_ 154 OBJ_Abs_Lat_Velocity_5 "The lateral ground speed of the object.";
CM_ SG_ 154 OBJ_Abs_Lat_Velocity_V_5 "Validator for the lateral ground speed of the object.";
CM_ SG_ 154 OBJ_Abs_Lat_Velocity_STD_5 "STD of the lateral ground speed of the object.";
CM_ SG_ 154 OBJ_Abs_Lat_Vel_STD_V_5 "Validator for the STD of the lateral ground speed of the object.";
CM_ SG_ 154 OBJ_Abs_Long_Acc_5 "The longitudinal ground acceleration of the object.";
CM_ SG_ 154 OBJ_Abs_Long_Acc_V_5 "Validator for the longitudinal ground acceleration of the object.";
CM_ SG_ 154 OBJ_Abs_Long_Acc_STD_5 "STD of the longitudinal ground acceleration of the object.";
CM_ SG_ 154 OBJ_Abs_Long_Acc_STD_V_5 "Validator for the STD of the longitudinal ground acceleration of the object.";
CM_ SG_ 154 OBJ_Abs_Lat_Acc_5 "The lateral ground acceleration of the object.";
CM_ SG_ 154 OBJ_Abs_Lat_Acc_V_5 "Validator for the lateral ground acceleration of the object.";
CM_ SG_ 154 OBJ_Abs_Lat_Acc_STD_5 "STD of the lateral ground acceleration of the object.";
CM_ SG_ 154 OBJ_Abs_Lat_Acc_STD_V_5 "Validator for the STD of the lateral ground acceleration of the object.";
CM_ SG_ 154 OBJ_Abs_Acceleration_5 "The absolute ground acceleration in the target's heading direction.";
CM_ SG_ 154 OBJ_Abs_Acceleration_V_5 "Validator for the absolute ground acceleration.";
CM_ SG_ 154 OBJ_Abs_Acc_STD_5 "STD of the absolute ground acceleration.";
CM_ SG_ 154 OBJ_Abs_Acc_STD_V_5 "Validator for the STD of the absolute ground acceleration.";
CM_ SG_ 154 OBJ_Inv_TTC_5 "Inverse TTC (time to collision).";
CM_ SG_ 154 OBJ_Inv_TTC_V_5 "Validator for Inverse TTC.";
CM_ SG_ 154 OBJ_Inv_TTC_STD_5 "STD for inverse TTC .";
CM_ SG_ 154 OBJ_Inv_TTC_STD_V_5 "Validator for the STD for inverse TTC .";
CM_ SG_ 154 OBJ_Relative_Long_Acc_5 "The relative lateral ground acceleration of the object.";
CM_ SG_ 154 OBJ_Relative_Long_Acc_V_5 "Validator for the relative lateral ground acceleration of the object.";
CM_ SG_ 154 OBJ_Relative_Long_Acc_STD_5 "STD of the relative lateral ground acceleration of the object.";
CM_ SG_ 154 OBJ_Rel_Long_Acc_STD_V_5 "Validator for the STD of the relative lateral ground acceleration.";
CM_ SG_ 154 OBJ_Relative_Long_Velocity_5 "The relative longtitudinal speed between the target and ego vehicle. ";
CM_ SG_ 154 OBJ_Relative_Long_Velocity_V_5 "Validator for the relative longtitudinal speed.";
CM_ SG_ 154 OBJ_Relative_Long_Vel_STD_5 "STD of the relative longtitudinal speed.";
CM_ SG_ 154 OBJ_Rel_Long_Vel_STD_V_5 "Validator for the STD of the relative longtitudinal speed.";
CM_ SG_ 154 OBJ_Relative_Lat_Velocity_5 "The relative lateral speed between the target and ego vehicle. ";
CM_ SG_ 154 OBJ_Relative_Lat_Velocity_V_5 "Validator for the relative lateral speed. ";
CM_ SG_ 154 OBJ_Relative_Lat_Velocity_STD_5 "STD of the relative lateral speed. ";
CM_ SG_ 154 OBJ_Rel_Lat_Vel_STD_V_5 "Validator for the STD of the relative lateral speed. ";
CM_ SG_ 154 OBJ_Long_Distance_5 "The longtitudinal distance from the object to the middle of the Rear-Left and Rear-Right corners of the host vehicle.  ";
CM_ SG_ 154 OBJ_Long_Distance_V_5 "Validator of the longtitudinal distance from the object to the middle of the rear-axle of the host.  ";
CM_ SG_ 154 OBJ_Long_Distance_STD_5 "STD of the  longtitudinal distance.";
CM_ SG_ 154 OBJ_Long_Distance_STD_V_5 "Validator for the STD of the  longtitudinal distance.";
CM_ SG_ 154 OBJ_Lat_Distance_5 "Lateral distance to the middle of the RL and RR corners.  ";
CM_ SG_ 154 OBJ_Lat_Distance_V_5 "Validator for the lateral distance of the object.";
CM_ SG_ 154 OBJ_Lat_Distance_STD_5 "STD of the lateral distance of the object.";
CM_ SG_ 154 OBJ_Lat_Distance_STD_V_5 "Validator for the STD of the lateral distance of the object.";
CM_ SG_ 154 OBJ_Absolute_Speed_5 "The absolute ground speed in the targets' heading direction.";
CM_ SG_ 154 OBJ_Absolute_Speed_V_5 "Validator for the absolute ground speed.";
CM_ SG_ 154 OBJ_Absolute_Speed_STD_5 "STD of the absolute ground speed.";
CM_ SG_ 154 OBJ_Absolute_Speed_STD_V_5 "Validator for the STD of the absolute ground speed.";
CM_ SG_ 154 OBJ_Heading_5 "The angle beetweenthe host longitudinal axis and target's heading (clockwise, e.g. PI/2 is a target crossing from left to right).";
CM_ SG_ 154 OBJ_Heading_V_5 "Validator for the object heading.";
CM_ SG_ 154 OBJ_Heading_STD_5 "STD of the object heading.";
CM_ SG_ 154 OBJ_Heading_STD_V_5 "Validator for the STD of the object heading.";
CM_ SG_ 154 OBJ_Angle_Rate_STD_5 "Standard deviation of the angular speed. (radians)";
CM_ SG_ 154 OBJ_Angle_Rate_STD_V_5 "Validator for the STD of the angular speed.";
CM_ SG_ 154 OBJ_Angle_Rate_5 "The momentary angular speed of the object. (radians)";
CM_ SG_ 154 OBJ_Angle_Rate_V_5 "Validator for the angular speed.";
CM_ SG_ 154 OBJ_Angle_Right_5 "The angle between the host longitudinal axis and the right side of the front / rear of the target (the visible one). The positive side is to the host's right.";
CM_ SG_ 154 OBJ_Angle_Right_V_5 "Validator for angleRight";
CM_ SG_ 154 OBJ_Angle_Right_STD_5 "Standard deviation of angleRight";
CM_ SG_ 154 OBJ_Angle_Right_STD_V_5 "Validator for the standard deviation of angleRight.";
CM_ SG_ 154 OBJ_Angle_Left_5 "The angle between the host longitudinal axis and the left side of the front / rear of the target (the visible one). The positive side is to the host's right.";
CM_ SG_ 154 OBJ_Angle_Left_V_5 "Validator for angleLeft.";
CM_ SG_ 154 OBJ_Angle_Left_STD_5 "Standard deviation of angleLeft.";
CM_ SG_ 154 OBJ_Angle_Left_STD_V_5 "Validator for the standard deviation of angleLeft.";
CM_ SG_ 154 OBJ_Angle_Side_5 "The angle between the host longitudinal axis and the far visible edge - the visible edge of the front / rear of the target that is not visible. Currently supported for vehicles only.";
CM_ SG_ 154 OBJ_Angle_Side_V_5 "Validator for angleSide.";
CM_ SG_ 154 OBJ_Angle_Side_STD_5 "Standard deviation of angleSide.";
CM_ SG_ 154 OBJ_Angle_Side_STD_V_5 "Validator for the STD of angleSide.";
CM_ SG_ 154 OBJ_Angle_Mid_V_5 "Validator for angleMid.";
CM_ SG_ 154 OBJ_Angle_Mid_5 "The angle between the host longitudinal axis and the middle of the front / rear of the target (the visible one). The positive side is to the host's right.";
CM_ SG_ 154 OBJ_Angle_Mid_STD_5 "Standard deviation of angleMid.";
CM_ SG_ 154 OBJ_Angle_Mid_STD_V_5 "Validator for the STD of angleMid.";
CM_ SG_ 154 OBJ_Angle_Bottom_V_5 "Validator for OBJAngle_Bottom. ";
CM_ SG_ 154 OBJ_Angle_Bottom_5 "The angle between the logitudinal axis and the Bottom of the front / rear of the target (the visible one). The positive side is to the hosts right";
CM_ SG_ 154 OBJ_Angle_Bottom_STD_5 "STD for OBJAngle_Bottom. ";
CM_ SG_ 154 OBJ_Angle_Bottom_STD_V_5 "Validator for OBJAngle_Bottom_STD. ";
CM_ SG_ 154 OBJ_Visibility_Side_V_5 "Currently Supported for VD only";
CM_ SG_ 154 OBJ_Visibility_Side_5 "From what car  side is the object visible";
CM_ SG_ 154 OBJ_Is_In_Drivable_Area_5 "Indicates whether the target is in a driveable area.";
CM_ SG_ 154 OBJ_Is_In_Drivable_Area_V_5 "Validator for OBJ_Is_In_Drivable_Area.";
CM_ SG_ 154 OBJ_Is_VeryClose_5 "Indicates whether the target is very close to the host such that it is hard to measure it's distance. Currently relevant for peds only. ";
CM_ SG_ 154 OBJ_Is_VeryClose_V_5 "Validator for OBJ_Is_VeryClose. ";
CM_ SG_ 154 OBJ_Occlusion_RL_5 "Was Rear left of the 3D detection of theobject occluded";
CM_ SG_ 154 OBJ_Occlusion_RR_5 "Was Rear Right of the 3D detection of theobject occluded";
CM_ SG_ 154 OBJ_Occlusion_FR_5 "Was front Right of the 3D detection of theobject occluded";
CM_ SG_ 154 OBJ_Occlusion_FL_5 "Was Front left of the 3D detection of theobject occluded";
CM_ SG_ 154 OBJ_CRC_6 "Calculated over each object signal";
CM_ SG_ 154 OBJ_ID_6 "The detected object ID. Range is 1-255, while 0 indicates that the field in unfilled.";
CM_ SG_ 154 OBJ_Existence_Probability_6 "The existence probability of the vehicle";
CM_ SG_ 154 OBJ_Fusion_Source_6 "sources ids used for fusion";
CM_ SG_ 154 OBJ_Triggered_SDM_6 "Indicates whether the object has trigered the SDM (Safety Diagnostic Manager) alert.";
CM_ SG_ 154 OBJ_Motion_Category_6 "Relevant for VD only. Full description of values can be found at the ACC guide.";
CM_ SG_ 154 OBJ_Object_Age_6 "The number of frames in which the object was recognized.";
CM_ SG_ 154 OBJ_Measuring_Status_6 "Measurment status. Old vs New marks if this is the first frame in which the object is reported. Predicted vs Measured marks if the report is raw or has been predicted forward in time using the measured dynamics and ego motion.";
CM_ SG_ 154 OBJ_Object_Class_6 "Indicates the object type. Uncertain is outputted in case the probability that a vehicle is a truck is very similar to the probability that it is a car. ";
CM_ SG_ 154 OBJ_Class_Probability_6 "The probability of this type classification.";
CM_ SG_ 154 OBJ_Camera_Source_6 "The camera in which this object was detected (best choice).";
CM_ SG_ 154 OBJ_Motion_Status_6 "MOVING - the object is moving STATIONARY - the object was never seen moving STOPPED -  the object was moving and has stopped MOVING_SLOWLY - the object is moving very slowly";
CM_ SG_ 154 OBJ_Motion_Orientation_6 "The direction of the target's heading compared to the host. ";
CM_ SG_ 154 OBJ_Has_Cut_Lane_6 "Indicates whether the object cut the host's (right or left) lane. In case there are no lanes, indicates whether the objects is at most 1 meters away from the host.";
CM_ SG_ 154 OBJ_Has_Cut_Path_6 "Indicates whether the object is in the host's path.";
CM_ SG_ 154 OBJ_Brake_Light_6 "Indication for brake lights ";
CM_ SG_ 154 OBJ_Turn_Indicator_Right_6 "Indication for blinking right light.";
CM_ SG_ 154 OBJ_Turn_Indicator_Left_6 "Indication for blinking left light ";
CM_ SG_ 154 OBJ_Light_Indicator_Validity_6 "Validator for light indicators";
CM_ SG_ 154 OBJ_Right_Out_Of_Image_6 "Indicates whether the measurment are predicted out of the right side of the image bounderies.";
CM_ SG_ 154 OBJ_Left_Out_Of_Image_6 "Indicates whether if measurment are predicted out of  the left side of the image bounderies";
CM_ SG_ 154 OBJ_Right_Out_Of_Image_V_6 "validator";
CM_ SG_ 154 OBJ_Left_Out_Of_Image_V_6 "validator";
CM_ SG_ 154 OBJ_Top_Out_Of_Image_6 "Indicates whether if measurment are predicted out of  the top of the image bounderies";
CM_ SG_ 154 OBJ_Bottom_Out_Of_Image_6 "validator";
CM_ SG_ 154 OBJ_Top_Out_Of_Image_V_6 "Indicates whether if measurment are predicted out of  the bottom of the image bounderies";
CM_ SG_ 154 OBJ_Bottom_Out_Of_Image_V_6 "validator";
CM_ SG_ 154 OBJ_Lane_Assignment_6 "The object's lane relative to the host lane.";
CM_ SG_ 154 OBJ_Lane_Assignment_V_6 "Validator for lane assignment";
CM_ SG_ 154 OBJ_Age_Seconds_6 "Time in seconds in which the object was recognized. Currently available for peds only. ";
CM_ SG_ 154 OBJ_Age_Seconds_V_6 "Validator for object age";
CM_ SG_ 154 OBJ_Width_6 "The width of the target vehicle in the world (not to be mistaken with the width of the visible part of the vehicle).";
CM_ SG_ 154 OBJ_Width_V_6 "Validator for object width";
CM_ SG_ 154 OBJ_Width_STD_6 "Standard deviation for object width";
CM_ SG_ 154 OBJ_Width_STD_V_6 "Validator for the standard deviation of object width";
CM_ SG_ 154 OBJ_Length_6 "The length of the vehicle in the world. For crossing bicycles it gives the viewed length of the bicycle.";
CM_ SG_ 154 OBJ_Length_V_6 "Validator for object length.";
CM_ SG_ 154 OBJ_Length_STD_6 "Standard deviation for object length.";
CM_ SG_ 154 OBJ_Length_STD_V_6 "Validator for the standard deviation of object length.";
CM_ SG_ 154 OBJ_Height_6 "The height of the object in the world. ";
CM_ SG_ 154 OBJ_Height_V_6 "Validator for object height.";
CM_ SG_ 154 OBJ_Height_STD_6 "Standard deviation for object height.";
CM_ SG_ 154 OBJ_Height_STD_V_6 "Validator for the standard deviation of object height.";
CM_ SG_ 154 OBJ_Abs_Long_Velocity_6 "Absolute longitudinal velocity.";
CM_ SG_ 154 OBJ_Abs_Long_Velocity_V_6 "Validator for absolute longitudinal velocity.";
CM_ SG_ 154 OBJ_Abs_Long_Velocity_STD_6 "Standard deviation of absolute longitudinal velocity.";
CM_ SG_ 154 OBJ_Abs_Long_Vel_STD_V_6 "Validator for the standard deviation of the absolute longitudinal velocity.";
CM_ SG_ 154 OBJ_Abs_Lat_Velocity_6 "The lateral ground speed of the object.";
CM_ SG_ 154 OBJ_Abs_Lat_Velocity_V_6 "Validator for the lateral ground speed of the object.";
CM_ SG_ 154 OBJ_Abs_Lat_Velocity_STD_6 "STD of the lateral ground speed of the object.";
CM_ SG_ 154 OBJ_Abs_Lat_Vel_STD_V_6 "Validator for the STD of the lateral ground speed of the object.";
CM_ SG_ 154 OBJ_Abs_Long_Acc_6 "The longitudinal ground acceleration of the object.";
CM_ SG_ 154 OBJ_Abs_Long_Acc_V_6 "Validator for the longitudinal ground acceleration of the object.";
CM_ SG_ 154 OBJ_Abs_Long_Acc_STD_6 "STD of the longitudinal ground acceleration of the object.";
CM_ SG_ 154 OBJ_Abs_Long_Acc_STD_V_6 "Validator for the STD of the longitudinal ground acceleration of the object.";
CM_ SG_ 154 OBJ_Abs_Lat_Acc_6 "The lateral ground acceleration of the object.";
CM_ SG_ 154 OBJ_Abs_Lat_Acc_V_6 "Validator for the lateral ground acceleration of the object.";
CM_ SG_ 154 OBJ_Abs_Lat_Acc_STD_6 "STD of the lateral ground acceleration of the object.";
CM_ SG_ 154 OBJ_Abs_Lat_Acc_STD_V_6 "Validator for the STD of the lateral ground acceleration of the object.";
CM_ SG_ 154 OBJ_Abs_Acceleration_6 "The absolute ground acceleration in the target's heading direction.";
CM_ SG_ 154 OBJ_Abs_Acceleration_V_6 "Validator for the absolute ground acceleration.";
CM_ SG_ 154 OBJ_Abs_Acc_STD_6 "STD of the absolute ground acceleration.";
CM_ SG_ 154 OBJ_Abs_Acc_STD_V_6 "Validator for the STD of the absolute ground acceleration.";
CM_ SG_ 154 OBJ_Inv_TTC_6 "Inverse TTC (time to collision).";
CM_ SG_ 154 OBJ_Inv_TTC_V_6 "Validator for Inverse TTC.";
CM_ SG_ 154 OBJ_Inv_TTC_STD_6 "STD for inverse TTC .";
CM_ SG_ 154 OBJ_Inv_TTC_STD_V_6 "Validator for the STD for inverse TTC .";
CM_ SG_ 154 OBJ_Relative_Long_Acc_6 "The relative lateral ground acceleration of the object.";
CM_ SG_ 154 OBJ_Relative_Long_Acc_V_6 "Validator for the relative lateral ground acceleration of the object.";
CM_ SG_ 154 OBJ_Relative_Long_Acc_STD_6 "STD of the relative lateral ground acceleration of the object.";
CM_ SG_ 154 OBJ_Rel_Long_Acc_STD_V_6 "Validator for the STD of the relative lateral ground acceleration.";
CM_ SG_ 154 OBJ_Relative_Long_Velocity_6 "The relative longtitudinal speed between the target and ego vehicle. ";
CM_ SG_ 154 OBJ_Relative_Long_Velocity_V_6 "Validator for the relative longtitudinal speed.";
CM_ SG_ 154 OBJ_Relative_Long_Vel_STD_6 "STD of the relative longtitudinal speed.";
CM_ SG_ 154 OBJ_Rel_Long_Vel_STD_V_6 "Validator for the STD of the relative longtitudinal speed.";
CM_ SG_ 154 OBJ_Relative_Lat_Velocity_6 "The relative lateral speed between the target and ego vehicle. ";
CM_ SG_ 154 OBJ_Relative_Lat_Velocity_V_6 "Validator for the relative lateral speed. ";
CM_ SG_ 154 OBJ_Relative_Lat_Velocity_STD_6 "STD of the relative lateral speed. ";
CM_ SG_ 154 OBJ_Rel_Lat_Vel_STD_V_6 "Validator for the STD of the relative lateral speed. ";
CM_ SG_ 154 OBJ_Long_Distance_6 "The longtitudinal distance from the object to the middle of the Rear-Left and Rear-Right corners of the host vehicle.  ";
CM_ SG_ 154 OBJ_Long_Distance_V_6 "Validator of the longtitudinal distance from the object to the middle of the rear-axle of the host.  ";
CM_ SG_ 154 OBJ_Long_Distance_STD_6 "STD of the  longtitudinal distance.";
CM_ SG_ 154 OBJ_Long_Distance_STD_V_6 "Validator for the STD of the  longtitudinal distance.";
CM_ SG_ 154 OBJ_Lat_Distance_6 "Lateral distance to the middle of the RL and RR corners.  ";
CM_ SG_ 154 OBJ_Lat_Distance_V_6 "Validator for the lateral distance of the object.";
CM_ SG_ 154 OBJ_Lat_Distance_STD_6 "STD of the lateral distance of the object.";
CM_ SG_ 154 OBJ_Lat_Distance_STD_V_6 "Validator for the STD of the lateral distance of the object.";
CM_ SG_ 154 OBJ_Absolute_Speed_6 "The absolute ground speed in the targets' heading direction.";
CM_ SG_ 154 OBJ_Absolute_Speed_V_6 "Validator for the absolute ground speed.";

BA_DEF_  "BusType" STRING ;
BA_DEF_ SG_  "GenSigStartValue" INT 0 0;
BA_DEF_DEF_  "GenSigStartValue" 0;
BA_DEF_DEF_  "BusType" "Ethernet";

BA_ "GenSigStartValue" SG_ 154 OBJ_Protocol_Version 8;
BA_ "GenSigStartValue" SG_ 154 OBJ_Width_0 40;
BA_ "GenSigStartValue" SG_ 154 OBJ_Length_0 24;
BA_ "GenSigStartValue" SG_ 154 OBJ_Width_1 40;
BA_ "GenSigStartValue" SG_ 154 OBJ_Length_1 24;
BA_ "GenSigStartValue" SG_ 154 OBJ_Width_2 40;
BA_ "GenSigStartValue" SG_ 154 OBJ_Length_2 24;
BA_ "GenSigStartValue" SG_ 154 OBJ_Width_3 40;
BA_ "GenSigStartValue" SG_ 154 OBJ_Length_3 24;
BA_ "GenSigStartValue" SG_ 154 OBJ_Width_4 40;
BA_ "GenSigStartValue" SG_ 154 OBJ_Length_4 24;
BA_ "GenSigStartValue" SG_ 154 OBJ_Width_5 40;
BA_ "GenSigStartValue" SG_ 154 OBJ_Length_5 24;
BA_ "GenSigStartValue" SG_ 154 OBJ_Width_6 40;
BA_ "GenSigStartValue" SG_ 154 OBJ_Length_6 24;

VAL_ 154 OBJ_VD_CIPV_Lost 2 "LOST_TARGET_FOV_IN" 1 "LOST_TARGET_FOV_OUT" 0 "NO_LOSS" ;
VAL_ 154 OBJ_VD_Allow_Acc 2 "FREE_SPACE_UNKNOWN" 1 "SPACE_NOT_FREE" 0 "FREE_SPACE" ;
VAL_ 154 OBJ_Is_Blocked_Left 1 "TRUE" 0 "FALSE" ;
VAL_ 154 OBJ_Is_Blocked_Right 1 "TRUE" 0 "FALSE" ;
VAL_ 154 OBJ_Triggered_SDM_0 2 "NOT_TRIGGERED" 1 "TRIGGERED" 0 "NOT_AVAILABLE" ;
VAL_ 154 OBJ_Motion_Category_0 13 "ONCOMING" 12 "PRECEEDING" 11 "MOVING" 10 "RTAP" 9 "LTAP" 8 "CROSSING" 7 "MOVING_OUT" 6 "MOVING_IN" 5 "CLOSE_CUT_IN" 4 "PASSING_OUT" 3 "PASSING_IN" 2 "PASSING" 1 "UNDEFINED" 0 "UNFILLED" ;
VAL_ 154 OBJ_Measuring_Status_0 2 "(BIT_2)NOT_VALID_OR_VALID" 1 "(BIT_1)PREDICTED_OR_MEASURED" 0 "(BIT_0)OLD_OR_NEW" ;
VAL_ 154 OBJ_Object_Class_0 8 "UNCERTAIN_VCL" 7 "ANIMAL" 6 "GENERAL_OBJECT" 5 "PEDESTRIAN" 4 "BICYCLE" 3 "MOTORBIKE" 2 "TRUCK" 1 "CAR" 0 "UNFILLED" ;
VAL_ 154 OBJ_Camera_Source_0 11 "PARKING_RIGHT" 10 "PARKING_LEFT" 9 "PARKING_REAR" 8 "PARKING_FRONT" 7 "FRONT_CORNER_RIGHT" 6 "FRONT_CORNER_LEFT" 5 "REAR_CORNER_RIGHT" 4 "REAR_CORNER_LEFT" 3 "REAR" 2 "FRONT_FISHEYE" 1 "FRONT_NARROW" 0 "FRONT_MAIN" ;
VAL_ 154 OBJ_Motion_Status_0 5 "MOVING_SLOWLY" 4 "STOPPED" 3 "STATIONARY" 2 "MOVING" 1 "UNKNOWN" 0 "INVALID" ;
VAL_ 154 OBJ_Motion_Orientation_0 13 "UNKNOWN" 12 "PRECEEDING" 11 "DRIFTING_LEFT" 9 "CROSSING_LEFT" 7 "OC_DRIFTING_LEFT" 6 "ONCOMING" 5 "OC_DRIFTING_RIGHT" 3 "CROSSING_RIGHT" 1 "DRIFTING_RIGHT" 0 "INVALID" ;
VAL_ 154 OBJ_Has_Cut_Lane_0 1 "TRUE" 0 "FALSE" ;
VAL_ 154 OBJ_Has_Cut_Path_0 1 "TRUE" 0 "FALSE" ;
VAL_ 154 OBJ_Brake_Light_0 1 "TRUE" 0 "FALSE" ;
VAL_ 154 OBJ_Turn_Indicator_Right_0 1 "TRUE" 0 "FALSE" ;
VAL_ 154 OBJ_Turn_Indicator_Left_0 1 "TRUE" 0 "FALSE" ;
VAL_ 154 OBJ_Light_Indicator_Validity_0 1 "TRUE" 0 "FALSE" ;
VAL_ 154 OBJ_Right_Out_Of_Image_0 1 "TRUE" 0 "FALSE" ;
VAL_ 154 OBJ_Left_Out_Of_Image_0 1 "TRUE" 0 "FALSE" ;
VAL_ 154 OBJ_Right_Out_Of_Image_V_0 1 "TRUE" 0 "FALSE" ;
VAL_ 154 OBJ_Left_Out_Of_Image_V_0 1 "TRUE" 0 "FALSE" ;
VAL_ 154 OBJ_Top_Out_Of_Image_0 1 "TRUE" 0 "FALSE" ;
VAL_ 154 OBJ_Bottom_Out_Of_Image_0 1 "TRUE" 0 "FALSE" ;
VAL_ 154 OBJ_Top_Out_Of_Image_V_0 1 "VALID" 0 "INVALID" ;
VAL_ 154 OBJ_Bottom_Out_Of_Image_V_0 1 "VALID" 0 "INVALID" ;
VAL_ 154 OBJ_Lane_Assignment_0 5 "RIGHT_RIGHT" 4 "RIGHT" 3 "HOST" 2 "LEFT" 1 "LEFT_LEFT" 0 "UNKNOWN" ;
VAL_ 154 OBJ_Lane_Assignment_V_0 1 "VALID" 0 "INVALID" ;
VAL_ 154 OBJ_Age_Seconds_V_0 1 "VALID" 0 "INVALID" ;
VAL_ 154 OBJ_Width_V_0 1 "VALID" 0 "INVALID" ;
VAL_ 154 OBJ_Width_STD_V_0 1 "VALID" 0 "INVALID" ;
VAL_ 154 OBJ_Length_V_0 1 "VALID" 0 "INVALID" ;
VAL_ 154 OBJ_Length_STD_V_0 1 "VALID" 0 "INVALID" ;
VAL_ 154 OBJ_Height_V_0 1 "VALID" 0 "INVALID" ;
VAL_ 154 OBJ_Height_STD_V_0 1 "VALID" 0 "INVALID" ;
VAL_ 154 OBJ_Abs_Long_Velocity_V_0 1 "VALID" 0 "INVALID" ;
VAL_ 154 OBJ_Abs_Long_Vel_STD_V_0 1 "VALID" 0 "INVALID" ;
VAL_ 154 OBJ_Abs_Lat_Velocity_V_0 1 "VALID" 0 "INVALID" ;
VAL_ 154 OBJ_Abs_Lat_Vel_STD_V_0 1 "VALID" 0 "INVALID" ;
VAL_ 154 OBJ_Abs_Long_Acc_V_0 1 "VALID" 0 "INVALID" ;
VAL_ 154 OBJ_Abs_Long_Acc_STD_V_0 1 "VALID" 0 "INVALID" ;
VAL_ 154 OBJ_Abs_Lat_Acc_V_0 1 "VALID" 0 "INVALID" ;
VAL_ 154 OBJ_Abs_Lat_Acc_STD_V_0 1 "VALID" 0 "INVALID" ;
VAL_ 154 OBJ_Abs_Acceleration_V_0 1 "VALID" 0 "INVALID" ;
VAL_ 154 OBJ_Abs_Acc_STD_V_0 1 "VALID" 0 "INVALID" ;
VAL_ 154 OBJ_Inv_TTC_V_0 1 "VALID" 0 "INVALID" ;
VAL_ 154 OBJ_Inv_TTC_STD_V_0 1 "VALID" 0 "INVALID" ;
VAL_ 154 OBJ_Relative_Long_Acc_V_0 1 "VALID" 0 "INVALID" ;
VAL_ 154 OBJ_Rel_Long_Acc_STD_V_0 1 "VALID" 0 "INVALID" ;
VAL_ 154 OBJ_Relative_Long_Velocity_V_0 1 "VALID" 0 "INVALID" ;
VAL_ 154 OBJ_Rel_Long_Vel_STD_V_0 1 "VALID" 0 "INVALID" ;
VAL_ 154 OBJ_Relative_Lat_Velocity_V_0 1 "VALID" 0 "INVALID" ;
VAL_ 154 OBJ_Rel_Lat_Vel_STD_V_0 1 "VALID" 0 "INVALID" ;
VAL_ 154 OBJ_Long_Distance_V_0 1 "VALID" 0 "INVALID" ;
VAL_ 154 OBJ_Long_Distance_STD_V_0 1 "VALID" 0 "INVALID" ;
VAL_ 154 OBJ_Lat_Distance_V_0 1 "VALID" 0 "INVALID" ;
VAL_ 154 OBJ_Lat_Distance_STD_V_0 1 "VALID" 0 "INVALID" ;
VAL_ 154 OBJ_Absolute_Speed_V_0 1 "VALID" 0 "INVALID" ;
VAL_ 154 OBJ_Absolute_Speed_STD_V_0 1 "VALID" 0 "INVALID" ;
VAL_ 154 OBJ_Heading_V_0 1 "VALID" 0 "INVALID" ;
VAL_ 154 OBJ_Heading_STD_V_0 1 "VALID" 0 "INVALID" ;
VAL_ 154 OBJ_Angle_Rate_STD_V_0 1 "VALID" 0 "INVALID" ;
VAL_ 154 OBJ_Angle_Rate_V_0 1 "VALID" 0 "INVALID" ;
VAL_ 154 OBJ_Angle_Right_V_0 1 "VALID" 0 "INVALID" ;
VAL_ 154 OBJ_Angle_Right_STD_V_0 1 "VALID" 0 "INVALID" ;
VAL_ 154 OBJ_Angle_Left_V_0 1 "VALID" 0 "INVALID" ;
VAL_ 154 OBJ_Angle_Left_STD_V_0 1 "VALID" 0 "INVALID" ;
VAL_ 154 OBJ_Angle_Side_V_0 1 "VALID" 0 "INVALID" ;
VAL_ 154 OBJ_Angle_Side_STD_V_0 1 "VALID" 0 "INVALID" ;
VAL_ 154 OBJ_Angle_Mid_V_0 1 "VALID" 0 "INVALID" ;
VAL_ 154 OBJ_Angle_Mid_STD_V_0 1 "VALID" 0 "INVALID" ;
VAL_ 154 OBJ_Angle_Bottom_V_0 1 "VALID" 0 "INVALID" ;
VAL_ 154 OBJ_Angle_Bottom_STD_V_0 1 "VALID" 0 "INVALID" ;
VAL_ 154 OBJ_Visibility_Side_V_0 1 "VALID" 0 "INVALID" ;
VAL_ 154 OBJ_Visibility_Side_0 2 "REAR" 1 "FRONT" 0 "NOT_VISIBLE" ;
VAL_ 154 OBJ_Is_In_Drivable_Area_0 1 "TRUE" 0 "FALSE" ;
VAL_ 154 OBJ_Is_In_Drivable_Area_V_0 1 "VALID" 0 "INVALID" ;
VAL_ 154 OBJ_Is_VeryClose_0 1 "TRUE" 0 "FALSE" ;
VAL_ 154 OBJ_Is_VeryClose_V_0 1 "VALID" 0 "INVALID" ;
VAL_ 154 OBJ_Occlusion_RL_0 2 "OCCLUDED" 1 "NOT_OCCLUDED" 0 "NOT_RELEVANT" ;
VAL_ 154 OBJ_Occlusion_RR_0 2 "OCCLUDED" 1 "NOT_OCCLUDED" 0 "NOT_RELEVANT" ;
VAL_ 154 OBJ_Occlusion_FR_0 2 "OCCLUDED" 1 "NOT_OCCLUDED" 0 "NOT_RELEVANT" ;
VAL_ 154 OBJ_Occlusion_FL_0 2 "OCCLUDED" 1 "NOT_OCCLUDED" 0 "NOT_RELEVANT" ;
VAL_ 154 OBJ_Triggered_SDM_1 2 "NOT_TRIGGERED" 1 "TRIGGERED" 0 "NOT_AVAILABLE" ;
VAL_ 154 OBJ_Motion_Category_1 13 "ONCOMING" 12 "PRECEEDING" 11 "MOVING" 10 "RTAP" 9 "LTAP" 8 "CROSSING" 7 "MOVING_OUT" 6 "MOVING_IN" 5 "CLOSE_CUT_IN" 4 "PASSING_OUT" 3 "PASSING_IN" 2 "PASSING" 1 "UNDEFINED" 0 "UNFILLED" ;
VAL_ 154 OBJ_Measuring_Status_1 2 "(BIT_2)NOT_VALID_OR_VALID" 1 "(BIT_1)PREDICTED_OR_MEASURED" 0 "(BIT_0)OLD_OR_NEW" ;
VAL_ 154 OBJ_Object_Class_1 8 "UNCERTAIN_VCL" 7 "ANIMAL" 6 "GENERAL_OBJECT" 5 "PEDESTRIAN" 4 "BICYCLE" 3 "MOTORBIKE" 2 "TRUCK" 1 "CAR" 0 "UNFILLED" ;
VAL_ 154 OBJ_Camera_Source_1 11 "PARKING_RIGHT" 10 "PARKING_LEFT" 9 "PARKING_REAR" 8 "PARKING_FRONT" 7 "FRONT_CORNER_RIGHT" 6 "FRONT_CORNER_LEFT" 5 "REAR_CORNER_RIGHT" 4 "REAR_CORNER_LEFT" 3 "REAR" 2 "FRONT_FISHEYE" 1 "FRONT_NARROW" 0 "FRONT_MAIN" ;
VAL_ 154 OBJ_Motion_Status_1 5 "MOVING_SLOWLY" 4 "STOPPED" 3 "STATIONARY" 2 "MOVING" 1 "UNKNOWN" 0 "INVALID" ;
VAL_ 154 OBJ_Motion_Orientation_1 13 "UNKNOWN" 12 "PRECEEDING" 11 "DRIFTING_LEFT" 9 "CROSSING_LEFT" 7 "OC_DRIFTING_LEFT" 6 "ONCOMING" 5 "OC_DRIFTING_RIGHT" 3 "CROSSING_RIGHT" 1 "DRIFTING_RIGHT" 0 "INVALID" ;
VAL_ 154 OBJ_Has_Cut_Lane_1 1 "TRUE" 0 "FALSE" ;
VAL_ 154 OBJ_Has_Cut_Path_1 1 "TRUE" 0 "FALSE" ;
VAL_ 154 OBJ_Brake_Light_1 1 "TRUE" 0 "FALSE" ;
VAL_ 154 OBJ_Turn_Indicator_Right_1 1 "TRUE" 0 "FALSE" ;
VAL_ 154 OBJ_Turn_Indicator_Left_1 1 "TRUE" 0 "FALSE" ;
VAL_ 154 OBJ_Light_Indicator_Validity_1 1 "TRUE" 0 "FALSE" ;
VAL_ 154 OBJ_Right_Out_Of_Image_1 1 "TRUE" 0 "FALSE" ;
VAL_ 154 OBJ_Left_Out_Of_Image_1 1 "TRUE" 0 "FALSE" ;
VAL_ 154 OBJ_Right_Out_Of_Image_V_1 1 "TRUE" 0 "FALSE" ;
VAL_ 154 OBJ_Left_Out_Of_Image_V_1 1 "TRUE" 0 "FALSE" ;
VAL_ 154 OBJ_Top_Out_Of_Image_1 1 "TRUE" 0 "FALSE" ;
VAL_ 154 OBJ_Bottom_Out_Of_Image_1 1 "TRUE" 0 "FALSE" ;
VAL_ 154 OBJ_Top_Out_Of_Image_V_1 1 "VALID" 0 "INVALID" ;
VAL_ 154 OBJ_Bottom_Out_Of_Image_V_1 1 "VALID" 0 "INVALID" ;
VAL_ 154 OBJ_Lane_Assignment_1 5 "RIGHT_RIGHT" 4 "RIGHT" 3 "HOST" 2 "LEFT" 1 "LEFT_LEFT" 0 "UNKNOWN" ;
VAL_ 154 OBJ_Lane_Assignment_V_1 1 "VALID" 0 "INVALID" ;
VAL_ 154 OBJ_Age_Seconds_V_1 1 "VALID" 0 "INVALID" ;
VAL_ 154 OBJ_Width_V_1 1 "VALID" 0 "INVALID" ;
VAL_ 154 OBJ_Width_STD_V_1 1 "VALID" 0 "INVALID" ;
VAL_ 154 OBJ_Length_V_1 1 "VALID" 0 "INVALID" ;
VAL_ 154 OBJ_Length_STD_V_1 1 "VALID" 0 "INVALID" ;
VAL_ 154 OBJ_Height_V_1 1 "VALID" 0 "INVALID" ;
VAL_ 154 OBJ_Height_STD_V_1 1 "VALID" 0 "INVALID" ;
VAL_ 154 OBJ_Abs_Long_Velocity_V_1 1 "VALID" 0 "INVALID" ;
VAL_ 154 OBJ_Abs_Long_Vel_STD_V_1 1 "VALID" 0 "INVALID" ;
VAL_ 154 OBJ_Abs_Lat_Velocity_V_1 1 "VALID" 0 "INVALID" ;
VAL_ 154 OBJ_Abs_Lat_Vel_STD_V_1 1 "VALID" 0 "INVALID" ;
VAL_ 154 OBJ_Abs_Long_Acc_V_1 1 "VALID" 0 "INVALID" ;
VAL_ 154 OBJ_Abs_Long_Acc_STD_V_1 1 "VALID" 0 "INVALID" ;
VAL_ 154 OBJ_Abs_Lat_Acc_V_1 1 "VALID" 0 "INVALID" ;
VAL_ 154 OBJ_Abs_Lat_Acc_STD_V_1 1 "VALID" 0 "INVALID" ;
VAL_ 154 OBJ_Abs_Acceleration_V_1 1 "VALID" 0 "INVALID" ;
VAL_ 154 OBJ_Abs_Acc_STD_V_1 1 "VALID" 0 "INVALID" ;
VAL_ 154 OBJ_Inv_TTC_V_1 1 "VALID" 0 "INVALID" ;
VAL_ 154 OBJ_Inv_TTC_STD_V_1 1 "VALID" 0 "INVALID" ;
VAL_ 154 OBJ_Relative_Long_Acc_V_1 1 "VALID" 0 "INVALID" ;
VAL_ 154 OBJ_Rel_Long_Acc_STD_V_1 1 "VALID" 0 "INVALID" ;
VAL_ 154 OBJ_Relative_Long_Velocity_V_1 1 "VALID" 0 "INVALID" ;
VAL_ 154 OBJ_Rel_Long_Vel_STD_V_1 1 "VALID" 0 "INVALID" ;
VAL_ 154 OBJ_Relative_Lat_Velocity_V_1 1 "VALID" 0 "INVALID" ;
VAL_ 154 OBJ_Rel_Lat_Vel_STD_V_1 1 "VALID" 0 "INVALID" ;
VAL_ 154 OBJ_Long_Distance_V_1 1 "VALID" 0 "INVALID" ;
VAL_ 154 OBJ_Long_Distance_STD_V_1 1 "VALID" 0 "INVALID" ;
VAL_ 154 OBJ_Lat_Distance_V_1 1 "VALID" 0 "INVALID" ;
VAL_ 154 OBJ_Lat_Distance_STD_V_1 1 "VALID" 0 "INVALID" ;
VAL_ 154 OBJ_Absolute_Speed_V_1 1 "VALID" 0 "INVALID" ;
VAL_ 154 OBJ_Absolute_Speed_STD_V_1 1 "VALID" 0 "INVALID" ;
VAL_ 154 OBJ_Heading_V_1 1 "VALID" 0 "INVALID" ;
VAL_ 154 OBJ_Heading_STD_V_1 1 "VALID" 0 "INVALID" ;
VAL_ 154 OBJ_Angle_Rate_STD_V_1 1 "VALID" 0 "INVALID" ;
VAL_ 154 OBJ_Angle_Rate_V_1 1 "VALID" 0 "INVALID" ;
VAL_ 154 OBJ_Angle_Right_V_1 1 "VALID" 0 "INVALID" ;
VAL_ 154 OBJ_Angle_Right_STD_V_1 1 "VALID" 0 "INVALID" ;
VAL_ 154 OBJ_Angle_Left_V_1 1 "VALID" 0 "INVALID" ;
VAL_ 154 OBJ_Angle_Left_STD_V_1 1 "VALID" 0 "INVALID" ;
VAL_ 154 OBJ_Angle_Side_V_1 1 "VALID" 0 "INVALID" ;
VAL_ 154 OBJ_Angle_Side_STD_V_1 1 "VALID" 0 "INVALID" ;
VAL_ 154 OBJ_Angle_Mid_V_1 1 "VALID" 0 "INVALID" ;
VAL_ 154 OBJ_Angle_Mid_STD_V_1 1 "VALID" 0 "INVALID" ;
VAL_ 154 OBJ_Angle_Bottom_V_1 1 "VALID" 0 "INVALID" ;
VAL_ 154 OBJ_Angle_Bottom_STD_V_1 1 "VALID" 0 "INVALID" ;
VAL_ 154 OBJ_Visibility_Side_V_1 1 "VALID" 0 "INVALID" ;
VAL_ 154 OBJ_Visibility_Side_1 2 "REAR" 1 "FRONT" 0 "NOT_VISIBLE" ;
VAL_ 154 OBJ_Is_In_Drivable_Area_1 1 "TRUE" 0 "FALSE" ;
VAL_ 154 OBJ_Is_In_Drivable_Area_V_1 1 "VALID" 0 "INVALID" ;
VAL_ 154 OBJ_Is_VeryClose_1 1 "TRUE" 0 "FALSE" ;
VAL_ 154 OBJ_Is_VeryClose_V_1 1 "VALID" 0 "INVALID" ;
VAL_ 154 OBJ_Occlusion_RL_1 2 "OCCLUDED" 1 "NOT_OCCLUDED" 0 "NOT_RELEVANT" ;
VAL_ 154 OBJ_Occlusion_RR_1 2 "OCCLUDED" 1 "NOT_OCCLUDED" 0 "NOT_RELEVANT" ;
VAL_ 154 OBJ_Occlusion_FR_1 2 "OCCLUDED" 1 "NOT_OCCLUDED" 0 "NOT_RELEVANT" ;
VAL_ 154 OBJ_Occlusion_FL_1 2 "OCCLUDED" 1 "NOT_OCCLUDED" 0 "NOT_RELEVANT" ;
VAL_ 154 OBJ_Triggered_SDM_2 2 "NOT_TRIGGERED" 1 "TRIGGERED" 0 "NOT_AVAILABLE" ;
VAL_ 154 OBJ_Motion_Category_2 13 "ONCOMING" 12 "PRECEEDING" 11 "MOVING" 10 "RTAP" 9 "LTAP" 8 "CROSSING" 7 "MOVING_OUT" 6 "MOVING_IN" 5 "CLOSE_CUT_IN" 4 "PASSING_OUT" 3 "PASSING_IN" 2 "PASSING" 1 "UNDEFINED" 0 "UNFILLED" ;
VAL_ 154 OBJ_Measuring_Status_2 2 "(BIT_2)NOT_VALID_OR_VALID" 1 "(BIT_1)PREDICTED_OR_MEASURED" 0 "(BIT_0)OLD_OR_NEW" ;
VAL_ 154 OBJ_Object_Class_2 8 "UNCERTAIN_VCL" 7 "ANIMAL" 6 "GENERAL_OBJECT" 5 "PEDESTRIAN" 4 "BICYCLE" 3 "MOTORBIKE" 2 "TRUCK" 1 "CAR" 0 "UNFILLED" ;
VAL_ 154 OBJ_Camera_Source_2 11 "PARKING_RIGHT" 10 "PARKING_LEFT" 9 "PARKING_REAR" 8 "PARKING_FRONT" 7 "FRONT_CORNER_RIGHT" 6 "FRONT_CORNER_LEFT" 5 "REAR_CORNER_RIGHT" 4 "REAR_CORNER_LEFT" 3 "REAR" 2 "FRONT_FISHEYE" 1 "FRONT_NARROW" 0 "FRONT_MAIN" ;
VAL_ 154 OBJ_Motion_Status_2 5 "MOVING_SLOWLY" 4 "STOPPED" 3 "STATIONARY" 2 "MOVING" 1 "UNKNOWN" 0 "INVALID" ;
VAL_ 154 OBJ_Motion_Orientation_2 13 "UNKNOWN" 12 "PRECEEDING" 11 "DRIFTING_LEFT" 9 "CROSSING_LEFT" 7 "OC_DRIFTING_LEFT" 6 "ONCOMING" 5 "OC_DRIFTING_RIGHT" 3 "CROSSING_RIGHT" 1 "DRIFTING_RIGHT" 0 "INVALID" ;
VAL_ 154 OBJ_Has_Cut_Lane_2 1 "TRUE" 0 "FALSE" ;
VAL_ 154 OBJ_Has_Cut_Path_2 1 "TRUE" 0 "FALSE" ;
VAL_ 154 OBJ_Brake_Light_2 1 "TRUE" 0 "FALSE" ;
VAL_ 154 OBJ_Turn_Indicator_Right_2 1 "TRUE" 0 "FALSE" ;
VAL_ 154 OBJ_Turn_Indicator_Left_2 1 "TRUE" 0 "FALSE" ;
VAL_ 154 OBJ_Light_Indicator_Validity_2 1 "TRUE" 0 "FALSE" ;
VAL_ 154 OBJ_Right_Out_Of_Image_2 1 "TRUE" 0 "FALSE" ;
VAL_ 154 OBJ_Left_Out_Of_Image_2 1 "TRUE" 0 "FALSE" ;
VAL_ 154 OBJ_Right_Out_Of_Image_V_2 1 "TRUE" 0 "FALSE" ;
VAL_ 154 OBJ_Left_Out_Of_Image_V_2 1 "TRUE" 0 "FALSE" ;
VAL_ 154 OBJ_Top_Out_Of_Image_2 1 "TRUE" 0 "FALSE" ;
VAL_ 154 OBJ_Bottom_Out_Of_Image_2 1 "TRUE" 0 "FALSE" ;
VAL_ 154 OBJ_Top_Out_Of_Image_V_2 1 "VALID" 0 "INVALID" ;
VAL_ 154 OBJ_Bottom_Out_Of_Image_V_2 1 "VALID" 0 "INVALID" ;
VAL_ 154 OBJ_Lane_Assignment_2 5 "RIGHT_RIGHT" 4 "RIGHT" 3 "HOST" 2 "LEFT" 1 "LEFT_LEFT" 0 "UNKNOWN" ;
VAL_ 154 OBJ_Lane_Assignment_V_2 1 "VALID" 0 "INVALID" ;
VAL_ 154 OBJ_Age_Seconds_V_2 1 "VALID" 0 "INVALID" ;
VAL_ 154 OBJ_Width_V_2 1 "VALID" 0 "INVALID" ;
VAL_ 154 OBJ_Width_STD_V_2 1 "VALID" 0 "INVALID" ;
VAL_ 154 OBJ_Length_V_2 1 "VALID" 0 "INVALID" ;
VAL_ 154 OBJ_Length_STD_V_2 1 "VALID" 0 "INVALID" ;
VAL_ 154 OBJ_Height_V_2 1 "VALID" 0 "INVALID" ;
VAL_ 154 OBJ_Height_STD_V_2 1 "VALID" 0 "INVALID" ;
VAL_ 154 OBJ_Abs_Long_Velocity_V_2 1 "VALID" 0 "INVALID" ;
VAL_ 154 OBJ_Abs_Long_Vel_STD_V_2 1 "VALID" 0 "INVALID" ;
VAL_ 154 OBJ_Abs_Lat_Velocity_V_2 1 "VALID" 0 "INVALID" ;
VAL_ 154 OBJ_Abs_Lat_Vel_STD_V_2 1 "VALID" 0 "INVALID" ;
VAL_ 154 OBJ_Abs_Long_Acc_V_2 1 "VALID" 0 "INVALID" ;
VAL_ 154 OBJ_Abs_Long_Acc_STD_V_2 1 "VALID" 0 "INVALID" ;
VAL_ 154 OBJ_Abs_Lat_Acc_V_2 1 "VALID" 0 "INVALID" ;
VAL_ 154 OBJ_Abs_Lat_Acc_STD_V_2 1 "VALID" 0 "INVALID" ;
VAL_ 154 OBJ_Abs_Acceleration_V_2 1 "VALID" 0 "INVALID" ;
VAL_ 154 OBJ_Abs_Acc_STD_V_2 1 "VALID" 0 "INVALID" ;
VAL_ 154 OBJ_Inv_TTC_V_2 1 "VALID" 0 "INVALID" ;
VAL_ 154 OBJ_Inv_TTC_STD_V_2 1 "VALID" 0 "INVALID" ;
VAL_ 154 OBJ_Relative_Long_Acc_V_2 1 "VALID" 0 "INVALID" ;
VAL_ 154 OBJ_Rel_Long_Acc_STD_V_2 1 "VALID" 0 "INVALID" ;
VAL_ 154 OBJ_Relative_Long_Velocity_V_2 1 "VALID" 0 "INVALID" ;
VAL_ 154 OBJ_Rel_Long_Vel_STD_V_2 1 "VALID" 0 "INVALID" ;
VAL_ 154 OBJ_Relative_Lat_Velocity_V_2 1 "VALID" 0 "INVALID" ;
VAL_ 154 OBJ_Rel_Lat_Vel_STD_V_2 1 "VALID" 0 "INVALID" ;
VAL_ 154 OBJ_Long_Distance_V_2 1 "VALID" 0 "INVALID" ;
VAL_ 154 OBJ_Long_Distance_STD_V_2 1 "VALID" 0 "INVALID" ;
VAL_ 154 OBJ_Lat_Distance_V_2 1 "VALID" 0 "INVALID" ;
VAL_ 154 OBJ_Lat_Distance_STD_V_2 1 "VALID" 0 "INVALID" ;
VAL_ 154 OBJ_Absolute_Speed_V_2 1 "VALID" 0 "INVALID" ;
VAL_ 154 OBJ_Absolute_Speed_STD_V_2 1 "VALID" 0 "INVALID" ;
VAL_ 154 OBJ_Heading_V_2 1 "VALID" 0 "INVALID" ;
VAL_ 154 OBJ_Heading_STD_V_2 1 "VALID" 0 "INVALID" ;
VAL_ 154 OBJ_Angle_Rate_STD_V_2 1 "VALID" 0 "INVALID" ;
VAL_ 154 OBJ_Angle_Rate_V_2 1 "VALID" 0 "INVALID" ;
VAL_ 154 OBJ_Angle_Right_V_2 1 "VALID" 0 "INVALID" ;
VAL_ 154 OBJ_Angle_Right_STD_V_2 1 "VALID" 0 "INVALID" ;
VAL_ 154 OBJ_Angle_Left_V_2 1 "VALID" 0 "INVALID" ;
VAL_ 154 OBJ_Angle_Left_STD_V_2 1 "VALID" 0 "INVALID" ;
VAL_ 154 OBJ_Angle_Side_V_2 1 "VALID" 0 "INVALID" ;
VAL_ 154 OBJ_Angle_Side_STD_V_2 1 "VALID" 0 "INVALID" ;
VAL_ 154 OBJ_Angle_Mid_V_2 1 "VALID" 0 "INVALID" ;
VAL_ 154 OBJ_Angle_Mid_STD_V_2 1 "VALID" 0 "INVALID" ;
VAL_ 154 OBJ_Angle_Bottom_V_2 1 "VALID" 0 "INVALID" ;
VAL_ 154 OBJ_Angle_Bottom_STD_V_2 1 "VALID" 0 "INVALID" ;
VAL_ 154 OBJ_Visibility_Side_V_2 1 "VALID" 0 "INVALID" ;
VAL_ 154 OBJ_Visibility_Side_2 2 "REAR" 1 "FRONT" 0 "NOT_VISIBLE" ;
VAL_ 154 OBJ_Is_In_Drivable_Area_2 1 "TRUE" 0 "FALSE" ;
VAL_ 154 OBJ_Is_In_Drivable_Area_V_2 1 "VALID" 0 "INVALID" ;
VAL_ 154 OBJ_Is_VeryClose_2 1 "TRUE" 0 "FALSE" ;
VAL_ 154 OBJ_Is_VeryClose_V_2 1 "VALID" 0 "INVALID" ;
VAL_ 154 OBJ_Occlusion_RL_2 2 "OCCLUDED" 1 "NOT_OCCLUDED" 0 "NOT_RELEVANT" ;
VAL_ 154 OBJ_Occlusion_RR_2 2 "OCCLUDED" 1 "NOT_OCCLUDED" 0 "NOT_RELEVANT" ;
VAL_ 154 OBJ_Occlusion_FR_2 2 "OCCLUDED" 1 "NOT_OCCLUDED" 0 "NOT_RELEVANT" ;
VAL_ 154 OBJ_Occlusion_FL_2 2 "OCCLUDED" 1 "NOT_OCCLUDED" 0 "NOT_RELEVANT" ;
VAL_ 154 OBJ_Triggered_SDM_3 2 "NOT_TRIGGERED" 1 "TRIGGERED" 0 "NOT_AVAILABLE" ;
VAL_ 154 OBJ_Motion_Category_3 13 "ONCOMING" 12 "PRECEEDING" 11 "MOVING" 10 "RTAP" 9 "LTAP" 8 "CROSSING" 7 "MOVING_OUT" 6 "MOVING_IN" 5 "CLOSE_CUT_IN" 4 "PASSING_OUT" 3 "PASSING_IN" 2 "PASSING" 1 "UNDEFINED" 0 "UNFILLED" ;
VAL_ 154 OBJ_Measuring_Status_3 2 "(BIT_2)NOT_VALID_OR_VALID" 1 "(BIT_1)PREDICTED_OR_MEASURED" 0 "(BIT_0)OLD_OR_NEW" ;
VAL_ 154 OBJ_Object_Class_3 8 "UNCERTAIN_VCL" 7 "ANIMAL" 6 "GENERAL_OBJECT" 5 "PEDESTRIAN" 4 "BICYCLE" 3 "MOTORBIKE" 2 "TRUCK" 1 "CAR" 0 "UNFILLED" ;
VAL_ 154 OBJ_Camera_Source_3 11 "PARKING_RIGHT" 10 "PARKING_LEFT" 9 "PARKING_REAR" 8 "PARKING_FRONT" 7 "FRONT_CORNER_RIGHT" 6 "FRONT_CORNER_LEFT" 5 "REAR_CORNER_RIGHT" 4 "REAR_CORNER_LEFT" 3 "REAR" 2 "FRONT_FISHEYE" 1 "FRONT_NARROW" 0 "FRONT_MAIN" ;
VAL_ 154 OBJ_Motion_Status_3 5 "MOVING_SLOWLY" 4 "STOPPED" 3 "STATIONARY" 2 "MOVING" 1 "UNKNOWN" 0 "INVALID" ;
VAL_ 154 OBJ_Motion_Orientation_3 13 "UNKNOWN" 12 "PRECEEDING" 11 "DRIFTING_LEFT" 9 "CROSSING_LEFT" 7 "OC_DRIFTING_LEFT" 6 "ONCOMING" 5 "OC_DRIFTING_RIGHT" 3 "CROSSING_RIGHT" 1 "DRIFTING_RIGHT" 0 "INVALID" ;
VAL_ 154 OBJ_Has_Cut_Lane_3 1 "TRUE" 0 "FALSE" ;
VAL_ 154 OBJ_Has_Cut_Path_3 1 "TRUE" 0 "FALSE" ;
VAL_ 154 OBJ_Brake_Light_3 1 "TRUE" 0 "FALSE" ;
VAL_ 154 OBJ_Turn_Indicator_Right_3 1 "TRUE" 0 "FALSE" ;
VAL_ 154 OBJ_Turn_Indicator_Left_3 1 "TRUE" 0 "FALSE" ;
VAL_ 154 OBJ_Light_Indicator_Validity_3 1 "TRUE" 0 "FALSE" ;
VAL_ 154 OBJ_Right_Out_Of_Image_3 1 "TRUE" 0 "FALSE" ;
VAL_ 154 OBJ_Left_Out_Of_Image_3 1 "TRUE" 0 "FALSE" ;
VAL_ 154 OBJ_Right_Out_Of_Image_V_3 1 "TRUE" 0 "FALSE" ;
VAL_ 154 OBJ_Left_Out_Of_Image_V_3 1 "TRUE" 0 "FALSE" ;
VAL_ 154 OBJ_Top_Out_Of_Image_3 1 "TRUE" 0 "FALSE" ;
VAL_ 154 OBJ_Bottom_Out_Of_Image_3 1 "TRUE" 0 "FALSE" ;
VAL_ 154 OBJ_Top_Out_Of_Image_V_3 1 "VALID" 0 "INVALID" ;
VAL_ 154 OBJ_Bottom_Out_Of_Image_V_3 1 "VALID" 0 "INVALID" ;
VAL_ 154 OBJ_Lane_Assignment_3 5 "RIGHT_RIGHT" 4 "RIGHT" 3 "HOST" 2 "LEFT" 1 "LEFT_LEFT" 0 "UNKNOWN" ;
VAL_ 154 OBJ_Lane_Assignment_V_3 1 "VALID" 0 "INVALID" ;
VAL_ 154 OBJ_Age_Seconds_V_3 1 "VALID" 0 "INVALID" ;
VAL_ 154 OBJ_Width_V_3 1 "VALID" 0 "INVALID" ;
VAL_ 154 OBJ_Width_STD_V_3 1 "VALID" 0 "INVALID" ;
VAL_ 154 OBJ_Length_V_3 1 "VALID" 0 "INVALID" ;
VAL_ 154 OBJ_Length_STD_V_3 1 "VALID" 0 "INVALID" ;
VAL_ 154 OBJ_Height_V_3 1 "VALID" 0 "INVALID" ;
VAL_ 154 OBJ_Height_STD_V_3 1 "VALID" 0 "INVALID" ;
VAL_ 154 OBJ_Abs_Long_Velocity_V_3 1 "VALID" 0 "INVALID" ;
VAL_ 154 OBJ_Abs_Long_Vel_STD_V_3 1 "VALID" 0 "INVALID" ;
VAL_ 154 OBJ_Abs_Lat_Velocity_V_3 1 "VALID" 0 "INVALID" ;
VAL_ 154 OBJ_Abs_Lat_Vel_STD_V_3 1 "VALID" 0 "INVALID" ;
VAL_ 154 OBJ_Abs_Long_Acc_V_3 1 "VALID" 0 "INVALID" ;
VAL_ 154 OBJ_Abs_Long_Acc_STD_V_3 1 "VALID" 0 "INVALID" ;
VAL_ 154 OBJ_Abs_Lat_Acc_V_3 1 "VALID" 0 "INVALID" ;
VAL_ 154 OBJ_Abs_Lat_Acc_STD_V_3 1 "VALID" 0 "INVALID" ;
VAL_ 154 OBJ_Abs_Acceleration_V_3 1 "VALID" 0 "INVALID" ;
VAL_ 154 OBJ_Abs_Acc_STD_V_3 1 "VALID" 0 "INVALID" ;
VAL_ 154 OBJ_Inv_TTC_V_3 1 "VALID" 0 "INVALID" ;
VAL_ 154 OBJ_Inv_TTC_STD_V_3 1 "VALID" 0 "INVALID" ;
VAL_ 154 OBJ_Relative_Long_Acc_V_3 1 "VALID" 0 "INVALID" ;
VAL_ 154 OBJ_Rel_Long_Acc_STD_V_3 1 "VALID" 0 "INVALID" ;
VAL_ 154 OBJ_Relative_Long_Velocity_V_3 1 "VALID" 0 "INVALID" ;
VAL_ 154 OBJ_Rel_Long_Vel_STD_V_3 1 "VALID" 0 "INVALID" ;
VAL_ 154 OBJ_Relative_Lat_Velocity_V_3 1 "VALID" 0 "INVALID" ;
VAL_ 154 OBJ_Rel_Lat_Vel_STD_V_3 1 "VALID" 0 "INVALID" ;
VAL_ 154 OBJ_Long_Distance_V_3 1 "VALID" 0 "INVALID" ;
VAL_ 154 OBJ_Long_Distance_STD_V_3 1 "VALID" 0 "INVALID" ;
VAL_ 154 OBJ_Lat_Distance_V_3 1 "VALID" 0 "INVALID" ;
VAL_ 154 OBJ_Lat_Distance_STD_V_3 1 "VALID" 0 "INVALID" ;
VAL_ 154 OBJ_Absolute_Speed_V_3 1 "VALID" 0 "INVALID" ;
VAL_ 154 OBJ_Absolute_Speed_STD_V_3 1 "VALID" 0 "INVALID" ;
VAL_ 154 OBJ_Heading_V_3 1 "VALID" 0 "INVALID" ;
VAL_ 154 OBJ_Heading_STD_V_3 1 "VALID" 0 "INVALID" ;
VAL_ 154 OBJ_Angle_Rate_STD_V_3 1 "VALID" 0 "INVALID" ;
VAL_ 154 OBJ_Angle_Rate_V_3 1 "VALID" 0 "INVALID" ;
VAL_ 154 OBJ_Angle_Right_V_3 1 "VALID" 0 "INVALID" ;
VAL_ 154 OBJ_Angle_Right_STD_V_3 1 "VALID" 0 "INVALID" ;
VAL_ 154 OBJ_Angle_Left_V_3 1 "VALID" 0 "INVALID" ;
VAL_ 154 OBJ_Angle_Left_STD_V_3 1 "VALID" 0 "INVALID" ;
VAL_ 154 OBJ_Angle_Side_V_3 1 "VALID" 0 "INVALID" ;
VAL_ 154 OBJ_Angle_Side_STD_V_3 1 "VALID" 0 "INVALID" ;
VAL_ 154 OBJ_Angle_Mid_V_3 1 "VALID" 0 "INVALID" ;
VAL_ 154 OBJ_Angle_Mid_STD_V_3 1 "VALID" 0 "INVALID" ;
VAL_ 154 OBJ_Angle_Bottom_V_3 1 "VALID" 0 "INVALID" ;
VAL_ 154 OBJ_Angle_Bottom_STD_V_3 1 "VALID" 0 "INVALID" ;
VAL_ 154 OBJ_Visibility_Side_V_3 1 "VALID" 0 "INVALID" ;
VAL_ 154 OBJ_Visibility_Side_3 2 "REAR" 1 "FRONT" 0 "NOT_VISIBLE" ;
VAL_ 154 OBJ_Is_In_Drivable_Area_3 1 "TRUE" 0 "FALSE" ;
VAL_ 154 OBJ_Is_In_Drivable_Area_V_3 1 "VALID" 0 "INVALID" ;
VAL_ 154 OBJ_Is_VeryClose_3 1 "TRUE" 0 "FALSE" ;
VAL_ 154 OBJ_Is_VeryClose_V_3 1 "VALID" 0 "INVALID" ;
VAL_ 154 OBJ_Occlusion_RL_3 2 "OCCLUDED" 1 "NOT_OCCLUDED" 0 "NOT_RELEVANT" ;
VAL_ 154 OBJ_Occlusion_RR_3 2 "OCCLUDED" 1 "NOT_OCCLUDED" 0 "NOT_RELEVANT" ;
VAL_ 154 OBJ_Occlusion_FR_3 2 "OCCLUDED" 1 "NOT_OCCLUDED" 0 "NOT_RELEVANT" ;
VAL_ 154 OBJ_Occlusion_FL_3 2 "OCCLUDED" 1 "NOT_OCCLUDED" 0 "NOT_RELEVANT" ;
VAL_ 154 OBJ_Triggered_SDM_4 2 "NOT_TRIGGERED" 1 "TRIGGERED" 0 "NOT_AVAILABLE" ;
VAL_ 154 OBJ_Motion_Category_4 13 "ONCOMING" 12 "PRECEEDING" 11 "MOVING" 10 "RTAP" 9 "LTAP" 8 "CROSSING" 7 "MOVING_OUT" 6 "MOVING_IN" 5 "CLOSE_CUT_IN" 4 "PASSING_OUT" 3 "PASSING_IN" 2 "PASSING" 1 "UNDEFINED" 0 "UNFILLED" ;
VAL_ 154 OBJ_Measuring_Status_4 2 "(BIT_2)NOT_VALID_OR_VALID" 1 "(BIT_1)PREDICTED_OR_MEASURED" 0 "(BIT_0)OLD_OR_NEW" ;
VAL_ 154 OBJ_Object_Class_4 8 "UNCERTAIN_VCL" 7 "ANIMAL" 6 "GENERAL_OBJECT" 5 "PEDESTRIAN" 4 "BICYCLE" 3 "MOTORBIKE" 2 "TRUCK" 1 "CAR" 0 "UNFILLED" ;
VAL_ 154 OBJ_Camera_Source_4 11 "PARKING_RIGHT" 10 "PARKING_LEFT" 9 "PARKING_REAR" 8 "PARKING_FRONT" 7 "FRONT_CORNER_RIGHT" 6 "FRONT_CORNER_LEFT" 5 "REAR_CORNER_RIGHT" 4 "REAR_CORNER_LEFT" 3 "REAR" 2 "FRONT_FISHEYE" 1 "FRONT_NARROW" 0 "FRONT_MAIN" ;
VAL_ 154 OBJ_Motion_Status_4 5 "MOVING_SLOWLY" 4 "STOPPED" 3 "STATIONARY" 2 "MOVING" 1 "UNKNOWN" 0 "INVALID" ;
VAL_ 154 OBJ_Motion_Orientation_4 13 "UNKNOWN" 12 "PRECEEDING" 11 "DRIFTING_LEFT" 9 "CROSSING_LEFT" 7 "OC_DRIFTING_LEFT" 6 "ONCOMING" 5 "OC_DRIFTING_RIGHT" 3 "CROSSING_RIGHT" 1 "DRIFTING_RIGHT" 0 "INVALID" ;
VAL_ 154 OBJ_Has_Cut_Lane_4 1 "TRUE" 0 "FALSE" ;
VAL_ 154 OBJ_Has_Cut_Path_4 1 "TRUE" 0 "FALSE" ;
VAL_ 154 OBJ_Brake_Light_4 1 "TRUE" 0 "FALSE" ;
VAL_ 154 OBJ_Turn_Indicator_Right_4 1 "TRUE" 0 "FALSE" ;
VAL_ 154 OBJ_Turn_Indicator_Left_4 1 "TRUE" 0 "FALSE" ;
VAL_ 154 OBJ_Light_Indicator_Validity_4 1 "TRUE" 0 "FALSE" ;
VAL_ 154 OBJ_Right_Out_Of_Image_4 1 "TRUE" 0 "FALSE" ;
VAL_ 154 OBJ_Left_Out_Of_Image_4 1 "TRUE" 0 "FALSE" ;
VAL_ 154 OBJ_Right_Out_Of_Image_V_4 1 "TRUE" 0 "FALSE" ;
VAL_ 154 OBJ_Left_Out_Of_Image_V_4 1 "TRUE" 0 "FALSE" ;
VAL_ 154 OBJ_Top_Out_Of_Image_4 1 "TRUE" 0 "FALSE" ;
VAL_ 154 OBJ_Bottom_Out_Of_Image_4 1 "TRUE" 0 "FALSE" ;
VAL_ 154 OBJ_Top_Out_Of_Image_V_4 1 "VALID" 0 "INVALID" ;
VAL_ 154 OBJ_Bottom_Out_Of_Image_V_4 1 "VALID" 0 "INVALID" ;
VAL_ 154 OBJ_Lane_Assignment_4 5 "RIGHT_RIGHT" 4 "RIGHT" 3 "HOST" 2 "LEFT" 1 "LEFT_LEFT" 0 "UNKNOWN" ;
VAL_ 154 OBJ_Lane_Assignment_V_4 1 "VALID" 0 "INVALID" ;
VAL_ 154 OBJ_Age_Seconds_V_4 1 "VALID" 0 "INVALID" ;
VAL_ 154 OBJ_Width_V_4 1 "VALID" 0 "INVALID" ;
VAL_ 154 OBJ_Width_STD_V_4 1 "VALID" 0 "INVALID" ;
VAL_ 154 OBJ_Length_V_4 1 "VALID" 0 "INVALID" ;
VAL_ 154 OBJ_Length_STD_V_4 1 "VALID" 0 "INVALID" ;
VAL_ 154 OBJ_Height_V_4 1 "VALID" 0 "INVALID" ;
VAL_ 154 OBJ_Height_STD_V_4 1 "VALID" 0 "INVALID" ;
VAL_ 154 OBJ_Abs_Long_Velocity_V_4 1 "VALID" 0 "INVALID" ;
VAL_ 154 OBJ_Abs_Long_Vel_STD_V_4 1 "VALID" 0 "INVALID" ;
VAL_ 154 OBJ_Abs_Lat_Velocity_V_4 1 "VALID" 0 "INVALID" ;
VAL_ 154 OBJ_Abs_Lat_Vel_STD_V_4 1 "VALID" 0 "INVALID" ;
VAL_ 154 OBJ_Abs_Long_Acc_V_4 1 "VALID" 0 "INVALID" ;
VAL_ 154 OBJ_Abs_Long_Acc_STD_V_4 1 "VALID" 0 "INVALID" ;
VAL_ 154 OBJ_Abs_Lat_Acc_V_4 1 "VALID" 0 "INVALID" ;
VAL_ 154 OBJ_Abs_Lat_Acc_STD_V_4 1 "VALID" 0 "INVALID" ;
VAL_ 154 OBJ_Abs_Acceleration_V_4 1 "VALID" 0 "INVALID" ;
VAL_ 154 OBJ_Abs_Acc_STD_V_4 1 "VALID" 0 "INVALID" ;
VAL_ 154 OBJ_Inv_TTC_V_4 1 "VALID" 0 "INVALID" ;
VAL_ 154 OBJ_Inv_TTC_STD_V_4 1 "VALID" 0 "INVALID" ;
VAL_ 154 OBJ_Relative_Long_Acc_V_4 1 "VALID" 0 "INVALID" ;
VAL_ 154 OBJ_Rel_Long_Acc_STD_V_4 1 "VALID" 0 "INVALID" ;
VAL_ 154 OBJ_Relative_Long_Velocity_V_4 1 "VALID" 0 "INVALID" ;
VAL_ 154 OBJ_Rel_Long_Vel_STD_V_4 1 "VALID" 0 "INVALID" ;
VAL_ 154 OBJ_Relative_Lat_Velocity_V_4 1 "VALID" 0 "INVALID" ;
VAL_ 154 OBJ_Rel_Lat_Vel_STD_V_4 1 "VALID" 0 "INVALID" ;
VAL_ 154 OBJ_Long_Distance_V_4 1 "VALID" 0 "INVALID" ;
VAL_ 154 OBJ_Long_Distance_STD_V_4 1 "VALID" 0 "INVALID" ;
VAL_ 154 OBJ_Lat_Distance_V_4 1 "VALID" 0 "INVALID" ;
VAL_ 154 OBJ_Lat_Distance_STD_V_4 1 "VALID" 0 "INVALID" ;
VAL_ 154 OBJ_Absolute_Speed_V_4 1 "VALID" 0 "INVALID" ;
VAL_ 154 OBJ_Absolute_Speed_STD_V_4 1 "VALID" 0 "INVALID" ;
VAL_ 154 OBJ_Heading_V_4 1 "VALID" 0 "INVALID" ;
VAL_ 154 OBJ_Heading_STD_V_4 1 "VALID" 0 "INVALID" ;
VAL_ 154 OBJ_Angle_Rate_STD_V_4 1 "VALID" 0 "INVALID" ;
VAL_ 154 OBJ_Angle_Rate_V_4 1 "VALID" 0 "INVALID" ;
VAL_ 154 OBJ_Angle_Right_V_4 1 "VALID" 0 "INVALID" ;
VAL_ 154 OBJ_Angle_Right_STD_V_4 1 "VALID" 0 "INVALID" ;
VAL_ 154 OBJ_Angle_Left_V_4 1 "VALID" 0 "INVALID" ;
VAL_ 154 OBJ_Angle_Left_STD_V_4 1 "VALID" 0 "INVALID" ;
VAL_ 154 OBJ_Angle_Side_V_4 1 "VALID" 0 "INVALID" ;
VAL_ 154 OBJ_Angle_Side_STD_V_4 1 "VALID" 0 "INVALID" ;
VAL_ 154 OBJ_Angle_Mid_V_4 1 "VALID" 0 "INVALID" ;
VAL_ 154 OBJ_Angle_Mid_STD_V_4 1 "VALID" 0 "INVALID" ;
VAL_ 154 OBJ_Angle_Bottom_V_4 1 "VALID" 0 "INVALID" ;
VAL_ 154 OBJ_Angle_Bottom_STD_V_4 1 "VALID" 0 "INVALID" ;
VAL_ 154 OBJ_Visibility_Side_V_4 1 "VALID" 0 "INVALID" ;
VAL_ 154 OBJ_Visibility_Side_4 2 "REAR" 1 "FRONT" 0 "NOT_VISIBLE" ;
VAL_ 154 OBJ_Is_In_Drivable_Area_4 1 "TRUE" 0 "FALSE" ;
VAL_ 154 OBJ_Is_In_Drivable_Area_V_4 1 "VALID" 0 "INVALID" ;
VAL_ 154 OBJ_Is_VeryClose_4 1 "TRUE" 0 "FALSE" ;
VAL_ 154 OBJ_Is_VeryClose_V_4 1 "VALID" 0 "INVALID" ;
VAL_ 154 OBJ_Occlusion_RL_4 2 "OCCLUDED" 1 "NOT_OCCLUDED" 0 "NOT_RELEVANT" ;
VAL_ 154 OBJ_Occlusion_RR_4 2 "OCCLUDED" 1 "NOT_OCCLUDED" 0 "NOT_RELEVANT" ;
VAL_ 154 OBJ_Occlusion_FR_4 2 "OCCLUDED" 1 "NOT_OCCLUDED" 0 "NOT_RELEVANT" ;
VAL_ 154 OBJ_Occlusion_FL_4 2 "OCCLUDED" 1 "NOT_OCCLUDED" 0 "NOT_RELEVANT" ;
VAL_ 154 OBJ_Triggered_SDM_5 2 "NOT_TRIGGERED" 1 "TRIGGERED" 0 "NOT_AVAILABLE" ;
VAL_ 154 OBJ_Motion_Category_5 13 "ONCOMING" 12 "PRECEEDING" 11 "MOVING" 10 "RTAP" 9 "LTAP" 8 "CROSSING" 7 "MOVING_OUT" 6 "MOVING_IN" 5 "CLOSE_CUT_IN" 4 "PASSING_OUT" 3 "PASSING_IN" 2 "PASSING" 1 "UNDEFINED" 0 "UNFILLED" ;
VAL_ 154 OBJ_Measuring_Status_5 2 "(BIT_2)NOT_VALID_OR_VALID" 1 "(BIT_1)PREDICTED_OR_MEASURED" 0 "(BIT_0)OLD_OR_NEW" ;
VAL_ 154 OBJ_Object_Class_5 8 "UNCERTAIN_VCL" 7 "ANIMAL" 6 "GENERAL_OBJECT" 5 "PEDESTRIAN" 4 "BICYCLE" 3 "MOTORBIKE" 2 "TRUCK" 1 "CAR" 0 "UNFILLED" ;
VAL_ 154 OBJ_Camera_Source_5 11 "PARKING_RIGHT" 10 "PARKING_LEFT" 9 "PARKING_REAR" 8 "PARKING_FRONT" 7 "FRONT_CORNER_RIGHT" 6 "FRONT_CORNER_LEFT" 5 "REAR_CORNER_RIGHT" 4 "REAR_CORNER_LEFT" 3 "REAR" 2 "FRONT_FISHEYE" 1 "FRONT_NARROW" 0 "FRONT_MAIN" ;
VAL_ 154 OBJ_Motion_Status_5 5 "MOVING_SLOWLY" 4 "STOPPED" 3 "STATIONARY" 2 "MOVING" 1 "UNKNOWN" 0 "INVALID" ;
VAL_ 154 OBJ_Motion_Orientation_5 13 "UNKNOWN" 12 "PRECEEDING" 11 "DRIFTING_LEFT" 9 "CROSSING_LEFT" 7 "OC_DRIFTING_LEFT" 6 "ONCOMING" 5 "OC_DRIFTING_RIGHT" 3 "CROSSING_RIGHT" 1 "DRIFTING_RIGHT" 0 "INVALID" ;
VAL_ 154 OBJ_Has_Cut_Lane_5 1 "TRUE" 0 "FALSE" ;
VAL_ 154 OBJ_Has_Cut_Path_5 1 "TRUE" 0 "FALSE" ;
VAL_ 154 OBJ_Brake_Light_5 1 "TRUE" 0 "FALSE" ;
VAL_ 154 OBJ_Turn_Indicator_Right_5 1 "TRUE" 0 "FALSE" ;
VAL_ 154 OBJ_Turn_Indicator_Left_5 1 "TRUE" 0 "FALSE" ;
VAL_ 154 OBJ_Light_Indicator_Validity_5 1 "TRUE" 0 "FALSE" ;
VAL_ 154 OBJ_Right_Out_Of_Image_5 1 "TRUE" 0 "FALSE" ;
VAL_ 154 OBJ_Left_Out_Of_Image_5 1 "TRUE" 0 "FALSE" ;
VAL_ 154 OBJ_Right_Out_Of_Image_V_5 1 "TRUE" 0 "FALSE" ;
VAL_ 154 OBJ_Left_Out_Of_Image_V_5 1 "TRUE" 0 "FALSE" ;
VAL_ 154 OBJ_Top_Out_Of_Image_5 1 "TRUE" 0 "FALSE" ;
VAL_ 154 OBJ_Bottom_Out_Of_Image_5 1 "TRUE" 0 "FALSE" ;
VAL_ 154 OBJ_Top_Out_Of_Image_V_5 1 "VALID" 0 "INVALID" ;
VAL_ 154 OBJ_Bottom_Out_Of_Image_V_5 1 "VALID" 0 "INVALID" ;
VAL_ 154 OBJ_Lane_Assignment_5 5 "RIGHT_RIGHT" 4 "RIGHT" 3 "HOST" 2 "LEFT" 1 "LEFT_LEFT" 0 "UNKNOWN" ;
VAL_ 154 OBJ_Lane_Assignment_V_5 1 "VALID" 0 "INVALID" ;
VAL_ 154 OBJ_Age_Seconds_V_5 1 "VALID" 0 "INVALID" ;
VAL_ 154 OBJ_Width_V_5 1 "VALID" 0 "INVALID" ;
VAL_ 154 OBJ_Width_STD_V_5 1 "VALID" 0 "INVALID" ;
VAL_ 154 OBJ_Length_V_5 1 "VALID" 0 "INVALID" ;
VAL_ 154 OBJ_Length_STD_V_5 1 "VALID" 0 "INVALID" ;
VAL_ 154 OBJ_Height_V_5 1 "VALID" 0 "INVALID" ;
VAL_ 154 OBJ_Height_STD_V_5 1 "VALID" 0 "INVALID" ;
VAL_ 154 OBJ_Abs_Long_Velocity_V_5 1 "VALID" 0 "INVALID" ;
VAL_ 154 OBJ_Abs_Long_Vel_STD_V_5 1 "VALID" 0 "INVALID" ;
VAL_ 154 OBJ_Abs_Lat_Velocity_V_5 1 "VALID" 0 "INVALID" ;
VAL_ 154 OBJ_Abs_Lat_Vel_STD_V_5 1 "VALID" 0 "INVALID" ;
VAL_ 154 OBJ_Abs_Long_Acc_V_5 1 "VALID" 0 "INVALID" ;
VAL_ 154 OBJ_Abs_Long_Acc_STD_V_5 1 "VALID" 0 "INVALID" ;
VAL_ 154 OBJ_Abs_Lat_Acc_V_5 1 "VALID" 0 "INVALID" ;
VAL_ 154 OBJ_Abs_Lat_Acc_STD_V_5 1 "VALID" 0 "INVALID" ;
VAL_ 154 OBJ_Abs_Acceleration_V_5 1 "VALID" 0 "INVALID" ;
VAL_ 154 OBJ_Abs_Acc_STD_V_5 1 "VALID" 0 "INVALID" ;
VAL_ 154 OBJ_Inv_TTC_V_5 1 "VALID" 0 "INVALID" ;
VAL_ 154 OBJ_Inv_TTC_STD_V_5 1 "VALID" 0 "INVALID" ;
VAL_ 154 OBJ_Relative_Long_Acc_V_5 1 "VALID" 0 "INVALID" ;
VAL_ 154 OBJ_Rel_Long_Acc_STD_V_5 1 "VALID" 0 "INVALID" ;
VAL_ 154 OBJ_Relative_Long_Velocity_V_5 1 "VALID" 0 "INVALID" ;
VAL_ 154 OBJ_Rel_Long_Vel_STD_V_5 1 "VALID" 0 "INVALID" ;
VAL_ 154 OBJ_Relative_Lat_Velocity_V_5 1 "VALID" 0 "INVALID" ;
VAL_ 154 OBJ_Rel_Lat_Vel_STD_V_5 1 "VALID" 0 "INVALID" ;
VAL_ 154 OBJ_Long_Distance_V_5 1 "VALID" 0 "INVALID" ;
VAL_ 154 OBJ_Long_Distance_STD_V_5 1 "VALID" 0 "INVALID" ;
VAL_ 154 OBJ_Lat_Distance_V_5 1 "VALID" 0 "INVALID" ;
VAL_ 154 OBJ_Lat_Distance_STD_V_5 1 "VALID" 0 "INVALID" ;
VAL_ 154 OBJ_Absolute_Speed_V_5 1 "VALID" 0 "INVALID" ;
VAL_ 154 OBJ_Absolute_Speed_STD_V_5 1 "VALID" 0 "INVALID" ;
VAL_ 154 OBJ_Heading_V_5 1 "VALID" 0 "INVALID" ;
VAL_ 154 OBJ_Heading_STD_V_5 1 "VALID" 0 "INVALID" ;
VAL_ 154 OBJ_Angle_Rate_STD_V_5 1 "VALID" 0 "INVALID" ;
VAL_ 154 OBJ_Angle_Rate_V_5 1 "VALID" 0 "INVALID" ;
VAL_ 154 OBJ_Angle_Right_V_5 1 "VALID" 0 "INVALID" ;
VAL_ 154 OBJ_Angle_Right_STD_V_5 1 "VALID" 0 "INVALID" ;
VAL_ 154 OBJ_Angle_Left_V_5 1 "VALID" 0 "INVALID" ;
VAL_ 154 OBJ_Angle_Left_STD_V_5 1 "VALID" 0 "INVALID" ;
VAL_ 154 OBJ_Angle_Side_V_5 1 "VALID" 0 "INVALID" ;
VAL_ 154 OBJ_Angle_Side_STD_V_5 1 "VALID" 0 "INVALID" ;
VAL_ 154 OBJ_Angle_Mid_V_5 1 "VALID" 0 "INVALID" ;
VAL_ 154 OBJ_Angle_Mid_STD_V_5 1 "VALID" 0 "INVALID" ;
VAL_ 154 OBJ_Angle_Bottom_V_5 1 "VALID" 0 "INVALID" ;
VAL_ 154 OBJ_Angle_Bottom_STD_V_5 1 "VALID" 0 "INVALID" ;
VAL_ 154 OBJ_Visibility_Side_V_5 1 "VALID" 0 "INVALID" ;
VAL_ 154 OBJ_Visibility_Side_5 2 "REAR" 1 "FRONT" 0 "NOT_VISIBLE" ;
VAL_ 154 OBJ_Is_In_Drivable_Area_5 1 "TRUE" 0 "FALSE" ;
VAL_ 154 OBJ_Is_In_Drivable_Area_V_5 1 "VALID" 0 "INVALID" ;
VAL_ 154 OBJ_Is_VeryClose_5 1 "TRUE" 0 "FALSE" ;
VAL_ 154 OBJ_Is_VeryClose_V_5 1 "VALID" 0 "INVALID" ;
VAL_ 154 OBJ_Occlusion_RL_5 2 "OCCLUDED" 1 "NOT_OCCLUDED" 0 "NOT_RELEVANT" ;
VAL_ 154 OBJ_Occlusion_RR_5 2 "OCCLUDED" 1 "NOT_OCCLUDED" 0 "NOT_RELEVANT" ;
VAL_ 154 OBJ_Occlusion_FR_5 2 "OCCLUDED" 1 "NOT_OCCLUDED" 0 "NOT_RELEVANT" ;
VAL_ 154 OBJ_Occlusion_FL_5 2 "OCCLUDED" 1 "NOT_OCCLUDED" 0 "NOT_RELEVANT" ;
VAL_ 154 OBJ_Triggered_SDM_6 2 "NOT_TRIGGERED" 1 "TRIGGERED" 0 "NOT_AVAILABLE" ;
VAL_ 154 OBJ_Motion_Category_6 13 "ONCOMING" 12 "PRECEEDING" 11 "MOVING" 10 "RTAP" 9 "LTAP" 8 "CROSSING" 7 "MOVING_OUT" 6 "MOVING_IN" 5 "CLOSE_CUT_IN" 4 "PASSING_OUT" 3 "PASSING_IN" 2 "PASSING" 1 "UNDEFINED" 0 "UNFILLED" ;
VAL_ 154 OBJ_Measuring_Status_6 2 "(BIT_2)NOT_VALID_OR_VALID" 1 "(BIT_1)PREDICTED_OR_MEASURED" 0 "(BIT_0)OLD_OR_NEW" ;
VAL_ 154 OBJ_Object_Class_6 8 "UNCERTAIN_VCL" 7 "ANIMAL" 6 "GENERAL_OBJECT" 5 "PEDESTRIAN" 4 "BICYCLE" 3 "MOTORBIKE" 2 "TRUCK" 1 "CAR" 0 "UNFILLED" ;
VAL_ 154 OBJ_Camera_Source_6 11 "PARKING_RIGHT" 10 "PARKING_LEFT" 9 "PARKING_REAR" 8 "PARKING_FRONT" 7 "FRONT_CORNER_RIGHT" 6 "FRONT_CORNER_LEFT" 5 "REAR_CORNER_RIGHT" 4 "REAR_CORNER_LEFT" 3 "REAR" 2 "FRONT_FISHEYE" 1 "FRONT_NARROW" 0 "FRONT_MAIN" ;
VAL_ 154 OBJ_Motion_Status_6 5 "MOVING_SLOWLY" 4 "STOPPED" 3 "STATIONARY" 2 "MOVING" 1 "UNKNOWN" 0 "INVALID" ;
VAL_ 154 OBJ_Motion_Orientation_6 13 "UNKNOWN" 12 "PRECEEDING" 11 "DRIFTING_LEFT" 9 "CROSSING_LEFT" 7 "OC_DRIFTING_LEFT" 6 "ONCOMING" 5 "OC_DRIFTING_RIGHT" 3 "CROSSING_RIGHT" 1 "DRIFTING_RIGHT" 0 "INVALID" ;
VAL_ 154 OBJ_Has_Cut_Lane_6 1 "TRUE" 0 "FALSE" ;
VAL_ 154 OBJ_Has_Cut_Path_6 1 "TRUE" 0 "FALSE" ;
VAL_ 154 OBJ_Brake_Light_6 1 "TRUE" 0 "FALSE" ;
VAL_ 154 OBJ_Turn_Indicator_Right_6 1 "TRUE" 0 "FALSE" ;
VAL_ 154 OBJ_Turn_Indicator_Left_6 1 "TRUE" 0 "FALSE" ;
VAL_ 154 OBJ_Light_Indicator_Validity_6 1 "TRUE" 0 "FALSE" ;
VAL_ 154 OBJ_Right_Out_Of_Image_6 1 "TRUE" 0 "FALSE" ;
VAL_ 154 OBJ_Left_Out_Of_Image_6 1 "TRUE" 0 "FALSE" ;
VAL_ 154 OBJ_Right_Out_Of_Image_V_6 1 "TRUE" 0 "FALSE" ;
VAL_ 154 OBJ_Left_Out_Of_Image_V_6 1 "TRUE" 0 "FALSE" ;
VAL_ 154 OBJ_Top_Out_Of_Image_6 1 "TRUE" 0 "FALSE" ;
VAL_ 154 OBJ_Bottom_Out_Of_Image_6 1 "TRUE" 0 "FALSE" ;
VAL_ 154 OBJ_Top_Out_Of_Image_V_6 1 "VALID" 0 "INVALID" ;
VAL_ 154 OBJ_Bottom_Out_Of_Image_V_6 1 "VALID" 0 "INVALID" ;
VAL_ 154 OBJ_Lane_Assignment_6 5 "RIGHT_RIGHT" 4 "RIGHT" 3 "HOST" 2 "LEFT" 1 "LEFT_LEFT" 0 "UNKNOWN" ;
VAL_ 154 OBJ_Lane_Assignment_V_6 1 "VALID" 0 "INVALID" ;
VAL_ 154 OBJ_Age_Seconds_V_6 1 "VALID" 0 "INVALID" ;
VAL_ 154 OBJ_Width_V_6 1 "VALID" 0 "INVALID" ;
VAL_ 154 OBJ_Width_STD_V_6 1 "VALID" 0 "INVALID" ;
VAL_ 154 OBJ_Length_V_6 1 "VALID" 0 "INVALID" ;
VAL_ 154 OBJ_Length_STD_V_6 1 "VALID" 0 "INVALID" ;
VAL_ 154 OBJ_Height_V_6 1 "VALID" 0 "INVALID" ;
VAL_ 154 OBJ_Height_STD_V_6 1 "VALID" 0 "INVALID" ;
VAL_ 154 OBJ_Abs_Long_Velocity_V_6 1 "VALID" 0 "INVALID" ;
VAL_ 154 OBJ_Abs_Long_Vel_STD_V_6 1 "VALID" 0 "INVALID" ;
VAL_ 154 OBJ_Abs_Lat_Velocity_V_6 1 "VALID" 0 "INVALID" ;
VAL_ 154 OBJ_Abs_Lat_Vel_STD_V_6 1 "VALID" 0 "INVALID" ;
VAL_ 154 OBJ_Abs_Long_Acc_V_6 1 "VALID" 0 "INVALID" ;
VAL_ 154 OBJ_Abs_Long_Acc_STD_V_6 1 "VALID" 0 "INVALID" ;
VAL_ 154 OBJ_Abs_Lat_Acc_V_6 1 "VALID" 0 "INVALID" ;
VAL_ 154 OBJ_Abs_Lat_Acc_STD_V_6 1 "VALID" 0 "INVALID" ;
VAL_ 154 OBJ_Abs_Acceleration_V_6 1 "VALID" 0 "INVALID" ;
VAL_ 154 OBJ_Abs_Acc_STD_V_6 1 "VALID" 0 "INVALID" ;
VAL_ 154 OBJ_Inv_TTC_V_6 1 "VALID" 0 "INVALID" ;
VAL_ 154 OBJ_Inv_TTC_STD_V_6 1 "VALID" 0 "INVALID" ;
VAL_ 154 OBJ_Relative_Long_Acc_V_6 1 "VALID" 0 "INVALID" ;
VAL_ 154 OBJ_Rel_Long_Acc_STD_V_6 1 "VALID" 0 "INVALID" ;
VAL_ 154 OBJ_Relative_Long_Velocity_V_6 1 "VALID" 0 "INVALID" ;
VAL_ 154 OBJ_Rel_Long_Vel_STD_V_6 1 "VALID" 0 "INVALID" ;
VAL_ 154 OBJ_Relative_Lat_Velocity_V_6 1 "VALID" 0 "INVALID" ;
VAL_ 154 OBJ_Rel_Lat_Vel_STD_V_6 1 "VALID" 0 "INVALID" ;
VAL_ 154 OBJ_Long_Distance_V_6 1 "VALID" 0 "INVALID" ;
VAL_ 154 OBJ_Long_Distance_STD_V_6 1 "VALID" 0 "INVALID" ;
VAL_ 154 OBJ_Lat_Distance_V_6 1 "VALID" 0 "INVALID" ;
VAL_ 154 OBJ_Lat_Distance_STD_V_6 1 "VALID" 0 "INVALID" ;
VAL_ 154 OBJ_Absolute_Speed_V_6 1 "VALID" 0 "INVALID" ;
