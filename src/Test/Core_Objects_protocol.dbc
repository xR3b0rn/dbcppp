VERSION "8"

NS_ :

BS_:

BU_: EyeQ4 MCU

BO_ 154 Core_Objects_protocol: 1940 EyeQ4
 SG_ OBJ_Abs_Lat_Acc_13 : 10442|9@1+ (0.05,-10.3) [-10.3|7.3] "MPS2" MCU
 SG_ OBJ_Abs_Lat_Acc_V_13 : 10451|1@1+ (1,0) [0|1] "bool" MCU
 SG_ OBJ_Abs_Lat_Acc_STD_13 : 10452|8@1+ (0.05,0) [0|7.3] "MPS2" MCU
 SG_ OBJ_Abs_Lat_Acc_STD_V_13 : 10460|1@1+ (1,0) [0|1] "bool" MCU
 SG_ Reserved_7_13 : 10461|3@1+ (1,0) [0|0] "NA" MCU
 SG_ OBJ_Abs_Acceleration_13 : 10464|9@1+ (0.05,-10.3) [-10.3|7.3] "MPS2" MCU
 SG_ OBJ_Abs_Acceleration_V_13 : 10473|1@1+ (1,0) [0|1] "bool" MCU
 SG_ OBJ_Abs_Acc_STD_13 : 10474|8@1+ (0.05,0) [0|7.3] "MPS2" MCU
 SG_ OBJ_Abs_Acc_STD_V_13 : 10482|1@1+ (1,0) [0|1] "bool" MCU
 SG_ OBJ_Inv_TTC_13 : 10483|11@1+ (0.01,-8) [-8|8] "INV(s)" MCU
 SG_ OBJ_Inv_TTC_V_13 : 10494|1@1+ (1,0) [0|1] "bool" MCU
 SG_ Reserved_8_13 : 10495|1@1+ (1,0) [0|0] "NA" MCU
 SG_ OBJ_Inv_TTC_STD_13 : 10496|11@1+ (0.01,0) [0|4] "INV(s)" MCU
 SG_ OBJ_Inv_TTC_STD_V_13 : 10507|1@1+ (1,0) [0|1] "bool" MCU
 SG_ OBJ_Relative_Long_Acc_13 : 10508|9@1+ (0.05,-10.3) [-10.3|7.3] "MPS2" MCU
 SG_ OBJ_Relative_Long_Acc_V_13 : 10517|1@1+ (1,0) [0|1] "bool" MCU
 SG_ OBJ_Relative_Long_Acc_STD_13 : 10518|8@1+ (0.05,0) [0|7.3] "MPS2" MCU
 SG_ OBJ_Rel_Long_Acc_STD_V_13 : 10526|1@1+ (1,0) [0|1] "bool" MCU
 SG_ Reserved_9_13 : 10527|1@1+ (1,0) [0|0] "NA" MCU
 SG_ OBJ_Relative_Long_Velocity_13 : 10528|13@1+ (0.05,-120) [-120|130] "MPS" MCU
 SG_ OBJ_Relative_Long_Velocity_V_13 : 10541|1@1+ (1,0) [0|1] "bool" MCU
 SG_ OBJ_Relative_Long_Vel_STD_13 : 10542|12@1+ (0.05,0) [0|130] "MPS" MCU
 SG_ OBJ_Rel_Long_Vel_STD_V_13 : 10554|1@1+ (1,0) [0|1] "bool" MCU
 SG_ Reserved_10_13 : 10555|5@1+ (1,0) [0|0] "NA" MCU
 SG_ OBJ_Relative_Lat_Velocity_13 : 10560|11@1+ (0.05,-50) [-50|50] "MPS" MCU
 SG_ OBJ_Relative_Lat_Velocity_V_13 : 10571|1@1+ (1,0) [0|1] "bool" MCU
 SG_ OBJ_Relative_Lat_Velocity_STD_13 : 10572|10@1+ (0.05,0) [0|50] "MPS" MCU
 SG_ OBJ_Rel_Lat_Vel_STD_V_13 : 10582|1@1+ (1,0) [0|1] "bool" MCU
 SG_ Reserved_11_13 : 10583|9@1+ (1,0) [0|0] "NA" MCU
 SG_ OBJ_Long_Distance_13 : 10592|14@1+ (0.05,-200) [-200|250] "m" MCU
 SG_ OBJ_Long_Distance_V_13 : 10606|1@1+ (1,0) [0|1] "bool" MCU
 SG_ OBJ_Long_Distance_STD_13 : 10607|13@1+ (0.05,0) [0|250] "m" MCU
 SG_ OBJ_Long_Distance_STD_V_13 : 10620|1@1+ (1,0) [0|1] "bool" MCU
 SG_ Reserved_12_13 : 10621|3@1+ (1,0) [0|0] "NA" MCU
 SG_ OBJ_Lat_Distance_13 : 10624|12@1+ (0.05,-100) [-100|100] "m" MCU
 SG_ OBJ_Lat_Distance_V_13 : 10636|1@1+ (1,0) [0|1] "bool" MCU
 SG_ OBJ_Lat_Distance_STD_13 : 10637|11@1+ (0.05,0) [0|100] "m" MCU
 SG_ OBJ_Lat_Distance_STD_V_13 : 10648|1@1+ (1,0) [0|1] "bool" MCU
 SG_ Reserved_13_13 : 10649|7@1+ (1,0) [0|0] "NA" MCU
 SG_ OBJ_Absolute_Speed_13 : 10656|12@1+ (0.05,-65) [-65|65] "MPS" MCU
 SG_ OBJ_Absolute_Speed_V_13 : 10668|1@1+ (1,0) [0|1] "bool" MCU
 SG_ OBJ_Absolute_Speed_STD_13 : 10669|11@1+ (0.05,0) [0|65] "MPS" MCU
 SG_ OBJ_Absolute_Speed_STD_V_13 : 10680|1@1+ (1,0) [0|1] "bool" MCU
 SG_ Reserved_14_13 : 10681|7@1+ (1,0) [0|0] "NA" MCU
 SG_ OBJ_Heading_13 : 10688|10@1+ (0.01,-3.14) [-3.14|3.14] "rad" MCU
 SG_ OBJ_Heading_V_13 : 10698|1@1+ (1,0) [0|1] "bool" MCU
 SG_ OBJ_Heading_STD_13 : 10699|9@1+ (0.01,0) [0|3.14] "rad" MCU
 SG_ OBJ_Heading_STD_V_13 : 10708|1@1+ (1,0) [0|1] "bool" MCU
 SG_ OBJ_Angle_Rate_STD_13 : 10709|11@1+ (0.002,0) [0|2.2318] "RPS" MCU
 SG_ OBJ_Angle_Rate_STD_V_13 : 10720|1@1+ (1,0) [0|1] "bool" MCU
 SG_ OBJ_Angle_Rate_13 : 10721|12@1+ (0.002,-2.234) [-2.234|2.2318] "RPS" MCU
 SG_ OBJ_Angle_Rate_V_13 : 10733|1@1+ (1,0) [0|1] "bool" MCU
 SG_ OBJ_Angle_Right_13 : 10734|14@1+ (0.0002,-1.571) [-1.571|1.571] "rad " MCU
 SG_ OBJ_Angle_Right_V_13 : 10748|1@1+ (1,0) [0|1] "bool" MCU
 SG_ Reserved_15_13 : 10749|3@1+ (1,0) [0|0] "NA" MCU
 SG_ OBJ_Angle_Right_STD_13 : 10752|13@1+ (0.0002,0) [0|1.571] "rad " MCU
 SG_ OBJ_Angle_Right_STD_V_13 : 10765|1@1+ (1,0) [0|1] "bool" MCU
 SG_ OBJ_Angle_Left_13 : 10766|14@1+ (0.0002,-1.571) [-1.571|1.571] "rad " MCU
 SG_ OBJ_Angle_Left_V_13 : 10780|1@1+ (1,0) [0|1] "bool" MCU
 SG_ Reserved_16_13 : 10781|3@1+ (1,0) [0|0] "NA" MCU
 SG_ OBJ_Angle_Left_STD_13 : 10784|13@1+ (0.0002,0) [0|1.571] "rad" MCU
 SG_ OBJ_Angle_Left_STD_V_13 : 10797|1@1+ (1,0) [0|1] "bool" MCU
 SG_ OBJ_Angle_Side_13 : 10798|14@1+ (0.0002,-1.571) [-1.571|1.571] "rad" MCU
 SG_ OBJ_Angle_Side_V_13 : 10812|1@1+ (1,0) [0|1] "bool" MCU
 SG_ Reserved_17_13 : 10813|3@1+ (1,0) [0|0] "NA" MCU
 SG_ OBJ_Angle_Side_STD_13 : 10816|13@1+ (0.0002,0) [0|1.571] "rad" MCU
 SG_ OBJ_Angle_Side_STD_V_13 : 10829|1@1+ (1,0) [0|1] "bool" MCU
 SG_ OBJ_Angle_Mid_V_13 : 10830|1@1+ (1,0) [0|1] "bool" MCU
 SG_ OBJ_Angle_Mid_13 : 10831|14@1+ (0.0002,-1.571) [-1.571|1.571] "rad" MCU
 SG_ Reserved_18_13 : 10845|3@1+ (1,0) [0|0] "NA" MCU
 SG_ OBJ_Angle_Mid_STD_13 : 10848|13@1+ (0.0002,0) [0|1.571] "rad" MCU
 SG_ OBJ_Angle_Mid_STD_V_13 : 10861|1@1+ (1,0) [0|1] "bool" MCU
 SG_ OBJ_Angle_Bottom_V_13 : 10862|1@1+ (1,0) [0|1] "bool" MCU
 SG_ OBJ_Angle_Bottom_13 : 10863|14@1+ (0.0002,-1.571) [-1.571|1.571] "rad" MCU
 SG_ Reserved_19_13 : 10877|3@1+ (1,0) [0|0] "NA" MCU
 SG_ OBJ_Angle_Bottom_STD_13 : 10880|13@1+ (0.0002,0) [0|1.571] "rad" MCU
 SG_ OBJ_Angle_Bottom_STD_V_13 : 10893|1@1+ (1,0) [0|1] "bool" MCU
 SG_ OBJ_Visibility_Side_V_13 : 10894|1@1+ (1,0) [0|1] "Bool" MCU
 SG_ OBJ_Visibility_Side_13 : 10895|2@1+ (1,0) [0|2] "ENUM" MCU
 SG_ OBJ_Is_In_Drivable_Area_13 : 10897|1@1+ (1,0) [0|1] "bool" MCU
 SG_ OBJ_Is_In_Drivable_Area_V_13 : 10898|1@1+ (1,0) [0|1] "bool" MCU
 SG_ OBJ_Is_VeryClose_13 : 10899|1@1+ (1,0) [0|1] "bool" MCU
 SG_ OBJ_Is_VeryClose_V_13 : 10900|1@1+ (1,0) [0|1] "bool" MCU
 SG_ OBJ_Occlusion_RL_13 : 10901|2@1+ (1,0) [0|2] "ENUM" MCU
 SG_ OBJ_Occlusion_RR_13 : 10903|2@1+ (1,0) [0|2] "ENUM" MCU
 SG_ OBJ_Occlusion_FR_13 : 10905|2@1+ (1,0) [0|2] "ENUM" MCU
 SG_ OBJ_Occlusion_FL_13 : 10907|2@1+ (1,0) [0|2] "ENUM" MCU
 SG_ OBJ_Buffer_13 : 10909|3@1+ (1,0) [0|0] "NA" MCU
 SG_ OBJ_CRC_14 : 10912|32@1+ (1,0) [0|4294967295] "NA" MCU
 SG_ OBJ_ID_14 : 10944|8@1+ (1,0) [0|255] "counter" MCU
 SG_ OBJ_Existence_Probability_14 : 10952|8@1+ (0.01,0) [0|1] "NA" MCU
 SG_ OBJ_Fusion_Source_14 : 10960|16@1+ (1,0) [0|65535] "BITWIZE" MCU
 SG_ OBJ_Triggered_SDM_14 : 10976|2@1+ (1,0) [0|2] "ENUM " MCU
 SG_ OBJ_Motion_Category_14 : 10978|4@1+ (1,0) [0|13] "ENUM " MCU
 SG_ OBJ_Buffer_C0_14 : 10982|7@1+ (1,0) [0|127] "NA" MCU
 SG_ OBJ_Object_Age_14 : 10989|11@1+ (1,0) [0|2047] "Frames" MCU
 SG_ OBJ_Measuring_Status_14 : 11000|3@1+ (1,0) [0|7] "BITWIZE" MCU
 SG_ OBJ_Object_Class_14 : 11003|4@1+ (1,0) [0|8] "ENUM" MCU
 SG_ Reserved_3_14 : 11007|1@1+ (1,0) [0|0] "NA" MCU
 SG_ OBJ_Class_Probability_14 : 11008|7@1+ (0.01,0) [0|1] "NA" MCU
 SG_ OBJ_Buffer_C1_14 : 11015|7@1+ (1,0) [0|127] "NA" MCU
 SG_ OBJ_Buffer_C2_14 : 11022|7@1+ (1,0) [0|127] "NA" MCU
 SG_ OBJ_Buffer_C3_14 : 11029|7@1+ (1,0) [0|127] "NA" MCU
 SG_ OBJ_Camera_Source_14 : 11036|4@1+ (1,0) [0|15] "ENUM" MCU
 SG_ OBJ_Motion_Status_14 : 11040|3@1+ (1,0) [0|5] "ENUM " MCU
 SG_ OBJ_Motion_Orientation_14 : 11043|4@1+ (1,0) [0|13] "ENUM " MCU
 SG_ OBJ_Has_Cut_Lane_14 : 11047|1@1+ (1,0) [0|1] "bool" MCU
 SG_ OBJ_Has_Cut_Path_14 : 11048|1@1+ (1,0) [0|1] "bool" MCU
 SG_ OBJ_Brake_Light_14 : 11049|1@1+ (1,0) [0|1] "bool" MCU
 SG_ OBJ_Turn_Indicator_Right_14 : 11050|1@1+ (1,0) [0|1] "bool" MCU
 SG_ OBJ_Turn_Indicator_Left_14 : 11051|1@1+ (1,0) [0|1] "bool" MCU
 SG_ OBJ_Light_Indicator_Validity_14 : 11052|1@1+ (1,0) [0|1] "bool" MCU
 SG_ OBJ_Right_Out_Of_Image_14 : 11053|1@1+ (1,0) [0|1] "bool" MCU
 SG_ OBJ_Left_Out_Of_Image_14 : 11054|1@1+ (1,0) [0|1] "bool" MCU
 SG_ OBJ_Right_Out_Of_Image_V_14 : 11055|1@1+ (1,0) [0|1] "bool" MCU
 SG_ OBJ_Left_Out_Of_Image_V_14 : 11056|1@1+ (1,0) [0|1] "bool" MCU
 SG_ OBJ_Top_Out_Of_Image_14 : 11057|1@1+ (1,0) [0|1] "bool" MCU
 SG_ OBJ_Bottom_Out_Of_Image_14 : 11058|1@1+ (1,0) [0|1] "bool" MCU
 SG_ OBJ_Top_Out_Of_Image_V_14 : 11059|1@1+ (1,0) [0|1] "bool" MCU
 SG_ OBJ_Bottom_Out_Of_Image_V_14 : 11060|1@1+ (1,0) [0|1] "bool" MCU
 SG_ OBJ_Lane_Assignment_14 : 11061|3@1+ (1,0) [0|5] "ENUM" MCU
 SG_ OBJ_Lane_Assignment_V_14 : 11064|1@1+ (1,0) [0|1] "bool" MCU
 SG_ OBJ_Age_Seconds_14 : 11065|7@1+ (1,0) [0|100] "s" MCU
 SG_ OBJ_Age_Seconds_V_14 : 11072|1@1+ (1,0) [0|1] "bool" MCU
 SG_ OBJ_Width_14 : 11073|9@1+ (0.01,0) [0.4|2.95] "m" MCU
 SG_ OBJ_Width_V_14 : 11082|1@1+ (1,0) [0|1] "bool" MCU
 SG_ OBJ_Width_STD_14 : 11083|8@1+ (0.01,0) [0|2] "m" MCU
 SG_ OBJ_Width_STD_V_14 : 11091|1@1+ (1,0) [0|1] "bool" MCU
 SG_ OBJ_Length_14 : 11092|9@1+ (0.05,0) [1.2|21] "m" MCU
 SG_ OBJ_Length_V_14 : 11101|1@1+ (1,0) [0|1] "bool" MCU
 SG_ Reserved_4_14 : 11102|2@1+ (1,0) [0|0] "NA" MCU
 SG_ OBJ_Length_STD_14 : 11104|8@1+ (0.05,0) [0|10] "m" MCU
 SG_ OBJ_Length_STD_V_14 : 11112|1@1+ (1,0) [0|1] "bool" MCU
 SG_ OBJ_Height_14 : 11113|9@1+ (0.01,0) [0|2.95] "m" MCU
 SG_ OBJ_Height_V_14 : 11122|1@1+ (1,0) [0|1] "bool" MCU
 SG_ OBJ_Height_STD_14 : 11123|8@1+ (0.01,0) [0|2] "m" MCU
 SG_ OBJ_Height_STD_V_14 : 11131|1@1+ (1,0) [0|1] "bool" MCU
 SG_ Reserved_5_14 : 11132|4@1+ (1,0) [0|0] "NA" MCU
 SG_ OBJ_Abs_Long_Velocity_14 : 11136|12@1+ (0.05,-30) [-30|100] "MPS" MCU
 SG_ OBJ_Abs_Long_Velocity_V_14 : 11148|1@1+ (1,0) [0|1] "bool" MCU
 SG_ OBJ_Abs_Long_Velocity_STD_14 : 11149|11@1+ (0.05,0) [0|65] "MPS" MCU
 SG_ OBJ_Abs_Long_Vel_STD_V_14 : 11160|1@1+ (1,0) [0|1] "bool" MCU
 SG_ Reserved_6_14 : 11161|7@1+ (1,0) [0|0] "NA" MCU
 SG_ OBJ_Abs_Lat_Velocity_14 : 11168|11@1+ (0.05,-50) [-50|50] "MPS" MCU
 SG_ OBJ_Abs_Lat_Velocity_V_14 : 11179|1@1+ (1,0) [0|1] "bool" MCU
 SG_ OBJ_Abs_Lat_Velocity_STD_14 : 11180|10@1+ (0.05,0) [0|50] "MPS" MCU
 SG_ OBJ_Abs_Lat_Vel_STD_V_14 : 11190|1@1+ (1,0) [0|1] "bool" MCU
 SG_ OBJ_Abs_Long_Acc_14 : 11191|9@1+ (0.05,-10.3) [-10.3|7.3] "MPS2" MCU
 SG_ OBJ_Abs_Long_Acc_V_14 : 11200|1@1+ (1,0) [0|1] "bool" MCU
 SG_ OBJ_Abs_Long_Acc_STD_14 : 11201|8@1+ (0.05,0) [0|7.3] "MPS2" MCU
 SG_ OBJ_Abs_Long_Acc_STD_V_14 : 11209|1@1+ (1,0) [0|1] "bool" MCU
 SG_ OBJ_Abs_Lat_Acc_14 : 11210|9@1+ (0.05,-10.3) [-10.3|7.3] "MPS2" MCU
 SG_ OBJ_Abs_Lat_Acc_V_14 : 11219|1@1+ (1,0) [0|1] "bool" MCU
 SG_ OBJ_Abs_Lat_Acc_STD_14 : 11220|8@1+ (0.05,0) [0|7.3] "MPS2" MCU
 SG_ OBJ_Abs_Lat_Acc_STD_V_14 : 11228|1@1+ (1,0) [0|1] "bool" MCU
 SG_ Reserved_7_14 : 11229|3@1+ (1,0) [0|0] "NA" MCU
 SG_ OBJ_Abs_Acceleration_14 : 11232|9@1+ (0.05,-10.3) [-10.3|7.3] "MPS2" MCU
 SG_ OBJ_Abs_Acceleration_V_14 : 11241|1@1+ (1,0) [0|1] "bool" MCU
 SG_ OBJ_Abs_Acc_STD_14 : 11242|8@1+ (0.05,0) [0|7.3] "MPS2" MCU
 SG_ OBJ_Abs_Acc_STD_V_14 : 11250|1@1+ (1,0) [0|1] "bool" MCU
 SG_ OBJ_Inv_TTC_14 : 11251|11@1+ (0.01,-8) [-8|8] "INV(s)" MCU
 SG_ OBJ_Inv_TTC_V_14 : 11262|1@1+ (1,0) [0|1] "bool" MCU
 SG_ Reserved_8_14 : 11263|1@1+ (1,0) [0|0] "NA" MCU
 SG_ OBJ_Inv_TTC_STD_14 : 11264|11@1+ (0.01,0) [0|4] "INV(s)" MCU
 SG_ OBJ_Inv_TTC_STD_V_14 : 11275|1@1+ (1,0) [0|1] "bool" MCU
 SG_ OBJ_Relative_Long_Acc_14 : 11276|9@1+ (0.05,-10.3) [-10.3|7.3] "MPS2" MCU
 SG_ OBJ_Relative_Long_Acc_V_14 : 11285|1@1+ (1,0) [0|1] "bool" MCU
 SG_ OBJ_Relative_Long_Acc_STD_14 : 11286|8@1+ (0.05,0) [0|7.3] "MPS2" MCU
 SG_ OBJ_Rel_Long_Acc_STD_V_14 : 11294|1@1+ (1,0) [0|1] "bool" MCU
 SG_ Reserved_9_14 : 11295|1@1+ (1,0) [0|0] "NA" MCU
 SG_ OBJ_Relative_Long_Velocity_14 : 11296|13@1+ (0.05,-120) [-120|130] "MPS" MCU
 SG_ OBJ_Relative_Long_Velocity_V_14 : 11309|1@1+ (1,0) [0|1] "bool" MCU
 SG_ OBJ_Relative_Long_Vel_STD_14 : 11310|12@1+ (0.05,0) [0|130] "MPS" MCU
 SG_ OBJ_Rel_Long_Vel_STD_V_14 : 11322|1@1+ (1,0) [0|1] "bool" MCU
 SG_ Reserved_10_14 : 11323|5@1+ (1,0) [0|0] "NA" MCU
 SG_ OBJ_Relative_Lat_Velocity_14 : 11328|11@1+ (0.05,-50) [-50|50] "MPS" MCU
 SG_ OBJ_Relative_Lat_Velocity_V_14 : 11339|1@1+ (1,0) [0|1] "bool" MCU
 SG_ OBJ_Relative_Lat_Velocity_STD_14 : 11340|10@1+ (0.05,0) [0|50] "MPS" MCU
 SG_ OBJ_Rel_Lat_Vel_STD_V_14 : 11350|1@1+ (1,0) [0|1] "bool" MCU
 SG_ Reserved_11_14 : 11351|9@1+ (1,0) [0|0] "NA" MCU
 SG_ OBJ_Long_Distance_14 : 11360|14@1+ (0.05,-200) [-200|250] "m" MCU
 SG_ OBJ_Long_Distance_V_14 : 11374|1@1+ (1,0) [0|1] "bool" MCU
 SG_ OBJ_Long_Distance_STD_14 : 11375|13@1+ (0.05,0) [0|250] "m" MCU
 SG_ OBJ_Long_Distance_STD_V_14 : 11388|1@1+ (1,0) [0|1] "bool" MCU
 SG_ Reserved_12_14 : 11389|3@1+ (1,0) [0|0] "NA" MCU
 SG_ OBJ_Lat_Distance_14 : 11392|12@1+ (0.05,-100) [-100|100] "m" MCU
 SG_ OBJ_Lat_Distance_V_14 : 11404|1@1+ (1,0) [0|1] "bool" MCU
 SG_ OBJ_Lat_Distance_STD_14 : 11405|11@1+ (0.05,0) [0|100] "m" MCU
 SG_ OBJ_Lat_Distance_STD_V_14 : 11416|1@1+ (1,0) [0|1] "bool" MCU
 SG_ Reserved_13_14 : 11417|7@1+ (1,0) [0|0] "NA" MCU
 SG_ OBJ_Absolute_Speed_14 : 11424|12@1+ (0.05,-65) [-65|65] "MPS" MCU
 SG_ OBJ_Absolute_Speed_V_14 : 11436|1@1+ (1,0) [0|1] "bool" MCU
 SG_ OBJ_Absolute_Speed_STD_14 : 11437|11@1+ (0.05,0) [0|65] "MPS" MCU
 SG_ OBJ_Absolute_Speed_STD_V_14 : 11448|1@1+ (1,0) [0|1] "bool" MCU
 SG_ Reserved_14_14 : 11449|7@1+ (1,0) [0|0] "NA" MCU
 SG_ OBJ_Heading_14 : 11456|10@1+ (0.01,-3.14) [-3.14|3.14] "rad" MCU
 SG_ OBJ_Heading_V_14 : 11466|1@1+ (1,0) [0|1] "bool" MCU
 SG_ OBJ_Heading_STD_14 : 11467|9@1+ (0.01,0) [0|3.14] "rad" MCU
 SG_ OBJ_Heading_STD_V_14 : 11476|1@1+ (1,0) [0|1] "bool" MCU
 SG_ OBJ_Angle_Rate_STD_14 : 11477|11@1+ (0.002,0) [0|2.2318] "RPS" MCU
 SG_ OBJ_Angle_Rate_STD_V_14 : 11488|1@1+ (1,0) [0|1] "bool" MCU
 SG_ OBJ_Angle_Rate_14 : 11489|12@1+ (0.002,-2.234) [-2.234|2.2318] "RPS" MCU
 SG_ OBJ_Angle_Rate_V_14 : 11501|1@1+ (1,0) [0|1] "bool" MCU
 SG_ OBJ_Angle_Right_14 : 11502|14@1+ (0.0002,-1.571) [-1.571|1.571] "rad " MCU
 SG_ OBJ_Angle_Right_V_14 : 11516|1@1+ (1,0) [0|1] "bool" MCU
 SG_ Reserved_15_14 : 11517|3@1+ (1,0) [0|0] "NA" MCU
 SG_ OBJ_Angle_Right_STD_14 : 11520|13@1+ (0.0002,0) [0|1.571] "rad " MCU
 SG_ OBJ_Angle_Right_STD_V_14 : 11533|1@1+ (1,0) [0|1] "bool" MCU
 SG_ OBJ_Angle_Left_14 : 11534|14@1+ (0.0002,-1.571) [-1.571|1.571] "rad " MCU
 SG_ OBJ_Angle_Left_V_14 : 11548|1@1+ (1,0) [0|1] "bool" MCU
 SG_ Reserved_16_14 : 11549|3@1+ (1,0) [0|0] "NA" MCU
 SG_ OBJ_Angle_Left_STD_14 : 11552|13@1+ (0.0002,0) [0|1.571] "rad" MCU
 SG_ OBJ_Angle_Left_STD_V_14 : 11565|1@1+ (1,0) [0|1] "bool" MCU
 SG_ OBJ_Angle_Side_14 : 11566|14@1+ (0.0002,-1.571) [-1.571|1.571] "rad" MCU
 SG_ OBJ_Angle_Side_V_14 : 11580|1@1+ (1,0) [0|1] "bool" MCU
 SG_ Reserved_17_14 : 11581|3@1+ (1,0) [0|0] "NA" MCU
 SG_ OBJ_Angle_Side_STD_14 : 11584|13@1+ (0.0002,0) [0|1.571] "rad" MCU
 SG_ OBJ_Angle_Side_STD_V_14 : 11597|1@1+ (1,0) [0|1] "bool" MCU
 SG_ OBJ_Angle_Mid_V_14 : 11598|1@1+ (1,0) [0|1] "bool" MCU
 SG_ OBJ_Angle_Mid_14 : 11599|14@1+ (0.0002,-1.571) [-1.571|1.571] "rad" MCU
 SG_ Reserved_18_14 : 11613|3@1+ (1,0) [0|0] "NA" MCU
 SG_ OBJ_Angle_Mid_STD_14 : 11616|13@1+ (0.0002,0) [0|1.571] "rad" MCU
 SG_ OBJ_Angle_Mid_STD_V_14 : 11629|1@1+ (1,0) [0|1] "bool" MCU
 SG_ OBJ_Angle_Bottom_V_14 : 11630|1@1+ (1,0) [0|1] "bool" MCU
 SG_ OBJ_Angle_Bottom_14 : 11631|14@1+ (0.0002,-1.571) [-1.571|1.571] "rad" MCU
 SG_ Reserved_19_14 : 11645|3@1+ (1,0) [0|0] "NA" MCU
 SG_ OBJ_Angle_Bottom_STD_14 : 11648|13@1+ (0.0002,0) [0|1.571] "rad" MCU
 SG_ OBJ_Angle_Bottom_STD_V_14 : 11661|1@1+ (1,0) [0|1] "bool" MCU
 SG_ OBJ_Visibility_Side_V_14 : 11662|1@1+ (1,0) [0|1] "Bool" MCU
 SG_ OBJ_Visibility_Side_14 : 11663|2@1+ (1,0) [0|2] "ENUM" MCU
 SG_ OBJ_Is_In_Drivable_Area_14 : 11665|1@1+ (1,0) [0|1] "bool" MCU
 SG_ OBJ_Is_In_Drivable_Area_V_14 : 11666|1@1+ (1,0) [0|1] "bool" MCU
 SG_ OBJ_Is_VeryClose_14 : 11667|1@1+ (1,0) [0|1] "bool" MCU
 SG_ OBJ_Is_VeryClose_V_14 : 11668|1@1+ (1,0) [0|1] "bool" MCU
 SG_ OBJ_Occlusion_RL_14 : 11669|2@1+ (1,0) [0|2] "ENUM" MCU
 SG_ OBJ_Occlusion_RR_14 : 11671|2@1+ (1,0) [0|2] "ENUM" MCU
 SG_ OBJ_Occlusion_FR_14 : 11673|2@1+ (1,0) [0|2] "ENUM" MCU
 SG_ OBJ_Occlusion_FL_14 : 11675|2@1+ (1,0) [0|2] "ENUM" MCU
 SG_ OBJ_Buffer_14 : 11677|3@1+ (1,0) [0|0] "NA" MCU
 SG_ OBJ_CRC_15 : 11680|32@1+ (1,0) [0|4294967295] "NA" MCU
 SG_ OBJ_ID_15 : 11712|8@1+ (1,0) [0|255] "counter" MCU
 SG_ OBJ_Existence_Probability_15 : 11720|8@1+ (0.01,0) [0|1] "NA" MCU
 SG_ OBJ_Fusion_Source_15 : 11728|16@1+ (1,0) [0|65535] "BITWIZE" MCU
 SG_ OBJ_Triggered_SDM_15 : 11744|2@1+ (1,0) [0|2] "ENUM " MCU
 SG_ OBJ_Motion_Category_15 : 11746|4@1+ (1,0) [0|13] "ENUM " MCU
 SG_ OBJ_Buffer_C0_15 : 11750|7@1+ (1,0) [0|127] "NA" MCU
 SG_ OBJ_Object_Age_15 : 11757|11@1+ (1,0) [0|2047] "Frames" MCU
 SG_ OBJ_Measuring_Status_15 : 11768|3@1+ (1,0) [0|7] "BITWIZE" MCU
 SG_ OBJ_Object_Class_15 : 11771|4@1+ (1,0) [0|8] "ENUM" MCU
 SG_ Reserved_3_15 : 11775|1@1+ (1,0) [0|0] "NA" MCU
 SG_ OBJ_Class_Probability_15 : 11776|7@1+ (0.01,0) [0|1] "NA" MCU
 SG_ OBJ_Buffer_C1_15 : 11783|7@1+ (1,0) [0|127] "NA" MCU
 SG_ OBJ_Buffer_C2_15 : 11790|7@1+ (1,0) [0|127] "NA" MCU
 SG_ OBJ_Buffer_C3_15 : 11797|7@1+ (1,0) [0|127] "NA" MCU
 SG_ OBJ_Camera_Source_15 : 11804|4@1+ (1,0) [0|15] "ENUM" MCU
 SG_ OBJ_Motion_Status_15 : 11808|3@1+ (1,0) [0|5] "ENUM " MCU
 SG_ OBJ_Motion_Orientation_15 : 11811|4@1+ (1,0) [0|13] "ENUM " MCU
 SG_ OBJ_Has_Cut_Lane_15 : 11815|1@1+ (1,0) [0|1] "bool" MCU
 SG_ OBJ_Has_Cut_Path_15 : 11816|1@1+ (1,0) [0|1] "bool" MCU
 SG_ OBJ_Brake_Light_15 : 11817|1@1+ (1,0) [0|1] "bool" MCU
 SG_ OBJ_Turn_Indicator_Right_15 : 11818|1@1+ (1,0) [0|1] "bool" MCU
 SG_ OBJ_Turn_Indicator_Left_15 : 11819|1@1+ (1,0) [0|1] "bool" MCU
 SG_ OBJ_Light_Indicator_Validity_15 : 11820|1@1+ (1,0) [0|1] "bool" MCU
 SG_ OBJ_Right_Out_Of_Image_15 : 11821|1@1+ (1,0) [0|1] "bool" MCU
 SG_ OBJ_Left_Out_Of_Image_15 : 11822|1@1+ (1,0) [0|1] "bool" MCU
 SG_ OBJ_Right_Out_Of_Image_V_15 : 11823|1@1+ (1,0) [0|1] "bool" MCU
 SG_ OBJ_Left_Out_Of_Image_V_15 : 11824|1@1+ (1,0) [0|1] "bool" MCU
 SG_ OBJ_Top_Out_Of_Image_15 : 11825|1@1+ (1,0) [0|1] "bool" MCU
 SG_ OBJ_Bottom_Out_Of_Image_15 : 11826|1@1+ (1,0) [0|1] "bool" MCU
 SG_ OBJ_Top_Out_Of_Image_V_15 : 11827|1@1+ (1,0) [0|1] "bool" MCU
 SG_ OBJ_Bottom_Out_Of_Image_V_15 : 11828|1@1+ (1,0) [0|1] "bool" MCU
 SG_ OBJ_Lane_Assignment_15 : 11829|3@1+ (1,0) [0|5] "ENUM" MCU
 SG_ OBJ_Lane_Assignment_V_15 : 11832|1@1+ (1,0) [0|1] "bool" MCU
 SG_ OBJ_Age_Seconds_15 : 11833|7@1+ (1,0) [0|100] "s" MCU
 SG_ OBJ_Age_Seconds_V_15 : 11840|1@1+ (1,0) [0|1] "bool" MCU
 SG_ OBJ_Width_15 : 11841|9@1+ (0.01,0) [0.4|2.95] "m" MCU
 SG_ OBJ_Width_V_15 : 11850|1@1+ (1,0) [0|1] "bool" MCU
 SG_ OBJ_Width_STD_15 : 11851|8@1+ (0.01,0) [0|2] "m" MCU
 SG_ OBJ_Width_STD_V_15 : 11859|1@1+ (1,0) [0|1] "bool" MCU
 SG_ OBJ_Length_15 : 11860|9@1+ (0.05,0) [1.2|21] "m" MCU
 SG_ OBJ_Length_V_15 : 11869|1@1+ (1,0) [0|1] "bool" MCU
 SG_ Reserved_4_15 : 11870|2@1+ (1,0) [0|0] "NA" MCU
 SG_ OBJ_Length_STD_15 : 11872|8@1+ (0.05,0) [0|10] "m" MCU
 SG_ OBJ_Length_STD_V_15 : 11880|1@1+ (1,0) [0|1] "bool" MCU
 SG_ OBJ_Height_15 : 11881|9@1+ (0.01,0) [0|2.95] "m" MCU
 SG_ OBJ_Height_V_15 : 11890|1@1+ (1,0) [0|1] "bool" MCU
 SG_ OBJ_Height_STD_15 : 11891|8@1+ (0.01,0) [0|2] "m" MCU
 SG_ OBJ_Height_STD_V_15 : 11899|1@1+ (1,0) [0|1] "bool" MCU
 SG_ Reserved_5_15 : 11900|4@1+ (1,0) [0|0] "NA" MCU
 SG_ OBJ_Abs_Long_Velocity_15 : 11904|12@1+ (0.05,-30) [-30|100] "MPS" MCU
 SG_ OBJ_Abs_Long_Velocity_V_15 : 11916|1@1+ (1,0) [0|1] "bool" MCU
 SG_ OBJ_Abs_Long_Velocity_STD_15 : 11917|11@1+ (0.05,0) [0|65] "MPS" MCU
 SG_ OBJ_Abs_Long_Vel_STD_V_15 : 11928|1@1+ (1,0) [0|1] "bool" MCU
 SG_ Reserved_6_15 : 11929|7@1+ (1,0) [0|0] "NA" MCU
 SG_ OBJ_Abs_Lat_Velocity_15 : 11936|11@1+ (0.05,-50) [-50|50] "MPS" MCU
 SG_ OBJ_Abs_Lat_Velocity_V_15 : 11947|1@1+ (1,0) [0|1] "bool" MCU
 SG_ OBJ_Abs_Lat_Velocity_STD_15 : 11948|10@1+ (0.05,0) [0|50] "MPS" MCU
 SG_ OBJ_Abs_Lat_Vel_STD_V_15 : 11958|1@1+ (1,0) [0|1] "bool" MCU
 SG_ OBJ_Abs_Long_Acc_15 : 11959|9@1+ (0.05,-10.3) [-10.3|7.3] "MPS2" MCU
 SG_ OBJ_Abs_Long_Acc_V_15 : 11968|1@1+ (1,0) [0|1] "bool" MCU
 SG_ OBJ_Abs_Long_Acc_STD_15 : 11969|8@1+ (0.05,0) [0|7.3] "MPS2" MCU
 SG_ OBJ_Abs_Long_Acc_STD_V_15 : 11977|1@1+ (1,0) [0|1] "bool" MCU
 SG_ OBJ_Abs_Lat_Acc_15 : 11978|9@1+ (0.05,-10.3) [-10.3|7.3] "MPS2" MCU
 SG_ OBJ_Abs_Lat_Acc_V_15 : 11987|1@1+ (1,0) [0|1] "bool" MCU
 SG_ OBJ_Abs_Lat_Acc_STD_15 : 11988|8@1+ (0.05,0) [0|7.3] "MPS2" MCU
 SG_ OBJ_Abs_Lat_Acc_STD_V_15 : 11996|1@1+ (1,0) [0|1] "bool" MCU
 SG_ Reserved_7_15 : 11997|3@1+ (1,0) [0|0] "NA" MCU
 SG_ OBJ_Abs_Acceleration_15 : 12000|9@1+ (0.05,-10.3) [-10.3|7.3] "MPS2" MCU
 SG_ OBJ_Abs_Acceleration_V_15 : 12009|1@1+ (1,0) [0|1] "bool" MCU
 SG_ OBJ_Abs_Acc_STD_15 : 12010|8@1+ (0.05,0) [0|7.3] "MPS2" MCU
 SG_ OBJ_Abs_Acc_STD_V_15 : 12018|1@1+ (1,0) [0|1] "bool" MCU
 SG_ OBJ_Inv_TTC_15 : 12019|11@1+ (0.01,-8) [-8|8] "INV(s)" MCU
 SG_ OBJ_Inv_TTC_V_15 : 12030|1@1+ (1,0) [0|1] "bool" MCU
 SG_ Reserved_8_15 : 12031|1@1+ (1,0) [0|0] "NA" MCU
 SG_ OBJ_Inv_TTC_STD_15 : 12032|11@1+ (0.01,0) [0|4] "INV(s)" MCU
 SG_ OBJ_Inv_TTC_STD_V_15 : 12043|1@1+ (1,0) [0|1] "bool" MCU
 SG_ OBJ_Relative_Long_Acc_15 : 12044|9@1+ (0.05,-10.3) [-10.3|7.3] "MPS2" MCU
 SG_ OBJ_Relative_Long_Acc_V_15 : 12053|1@1+ (1,0) [0|1] "bool" MCU
 SG_ OBJ_Relative_Long_Acc_STD_15 : 12054|8@1+ (0.05,0) [0|7.3] "MPS2" MCU
 SG_ OBJ_Rel_Long_Acc_STD_V_15 : 12062|1@1+ (1,0) [0|1] "bool" MCU
 SG_ Reserved_9_15 : 12063|1@1+ (1,0) [0|0] "NA" MCU
 SG_ OBJ_Relative_Long_Velocity_15 : 12064|13@1+ (0.05,-120) [-120|130] "MPS" MCU
 SG_ OBJ_Relative_Long_Velocity_V_15 : 12077|1@1+ (1,0) [0|1] "bool" MCU
 SG_ OBJ_Relative_Long_Vel_STD_15 : 12078|12@1+ (0.05,0) [0|130] "MPS" MCU
 SG_ OBJ_Rel_Long_Vel_STD_V_15 : 12090|1@1+ (1,0) [0|1] "bool" MCU
 SG_ Reserved_10_15 : 12091|5@1+ (1,0) [0|0] "NA" MCU
 SG_ OBJ_Relative_Lat_Velocity_15 : 12096|11@1+ (0.05,-50) [-50|50] "MPS" MCU
 SG_ OBJ_Relative_Lat_Velocity_V_15 : 12107|1@1+ (1,0) [0|1] "bool" MCU
 SG_ OBJ_Relative_Lat_Velocity_STD_15 : 12108|10@1+ (0.05,0) [0|50] "MPS" MCU
 SG_ OBJ_Rel_Lat_Vel_STD_V_15 : 12118|1@1+ (1,0) [0|1] "bool" MCU
 SG_ Reserved_11_15 : 12119|9@1+ (1,0) [0|0] "NA" MCU
 SG_ OBJ_Long_Distance_15 : 12128|14@1+ (0.05,-200) [-200|250] "m" MCU
 SG_ OBJ_Long_Distance_V_15 : 12142|1@1+ (1,0) [0|1] "bool" MCU
 SG_ OBJ_Long_Distance_STD_15 : 12143|13@1+ (0.05,0) [0|250] "m" MCU
 SG_ OBJ_Long_Distance_STD_V_15 : 12156|1@1+ (1,0) [0|1] "bool" MCU
 SG_ Reserved_12_15 : 12157|3@1+ (1,0) [0|0] "NA" MCU
 SG_ OBJ_Lat_Distance_15 : 12160|12@1+ (0.05,-100) [-100|100] "m" MCU
 SG_ OBJ_Lat_Distance_V_15 : 12172|1@1+ (1,0) [0|1] "bool" MCU
 SG_ OBJ_Lat_Distance_STD_15 : 12173|11@1+ (0.05,0) [0|100] "m" MCU
 SG_ OBJ_Lat_Distance_STD_V_15 : 12184|1@1+ (1,0) [0|1] "bool" MCU
 SG_ Reserved_13_15 : 12185|7@1+ (1,0) [0|0] "NA" MCU
 SG_ OBJ_Absolute_Speed_15 : 12192|12@1+ (0.05,-65) [-65|65] "MPS" MCU
 SG_ OBJ_Absolute_Speed_V_15 : 12204|1@1+ (1,0) [0|1] "bool" MCU
 SG_ OBJ_Absolute_Speed_STD_15 : 12205|11@1+ (0.05,0) [0|65] "MPS" MCU
 SG_ OBJ_Absolute_Speed_STD_V_15 : 12216|1@1+ (1,0) [0|1] "bool" MCU
 SG_ Reserved_14_15 : 12217|7@1+ (1,0) [0|0] "NA" MCU
 SG_ OBJ_Heading_15 : 12224|10@1+ (0.01,-3.14) [-3.14|3.14] "rad" MCU
 SG_ OBJ_Heading_V_15 : 12234|1@1+ (1,0) [0|1] "bool" MCU
 SG_ OBJ_Heading_STD_15 : 12235|9@1+ (0.01,0) [0|3.14] "rad" MCU
 SG_ OBJ_Heading_STD_V_15 : 12244|1@1+ (1,0) [0|1] "bool" MCU
 SG_ OBJ_Angle_Rate_STD_15 : 12245|11@1+ (0.002,0) [0|2.2318] "RPS" MCU
 SG_ OBJ_Angle_Rate_STD_V_15 : 12256|1@1+ (1,0) [0|1] "bool" MCU
 SG_ OBJ_Angle_Rate_15 : 12257|12@1+ (0.002,-2.234) [-2.234|2.2318] "RPS" MCU
 SG_ OBJ_Angle_Rate_V_15 : 12269|1@1+ (1,0) [0|1] "bool" MCU
 SG_ OBJ_Angle_Right_15 : 12270|14@1+ (0.0002,-1.571) [-1.571|1.571] "rad " MCU
 SG_ OBJ_Angle_Right_V_15 : 12284|1@1+ (1,0) [0|1] "bool" MCU
 SG_ Reserved_15_15 : 12285|3@1+ (1,0) [0|0] "NA" MCU
 SG_ OBJ_Angle_Right_STD_15 : 12288|13@1+ (0.0002,0) [0|1.571] "rad " MCU
 SG_ OBJ_Angle_Right_STD_V_15 : 12301|1@1+ (1,0) [0|1] "bool" MCU
 SG_ OBJ_Angle_Left_15 : 12302|14@1+ (0.0002,-1.571) [-1.571|1.571] "rad " MCU
 SG_ OBJ_Angle_Left_V_15 : 12316|1@1+ (1,0) [0|1] "bool" MCU
 SG_ Reserved_16_15 : 12317|3@1+ (1,0) [0|0] "NA" MCU
 SG_ OBJ_Angle_Left_STD_15 : 12320|13@1+ (0.0002,0) [0|1.571] "rad" MCU
 SG_ OBJ_Angle_Left_STD_V_15 : 12333|1@1+ (1,0) [0|1] "bool" MCU
 SG_ OBJ_Angle_Side_15 : 12334|14@1+ (0.0002,-1.571) [-1.571|1.571] "rad" MCU
 SG_ OBJ_Angle_Side_V_15 : 12348|1@1+ (1,0) [0|1] "bool" MCU
 SG_ Reserved_17_15 : 12349|3@1+ (1,0) [0|0] "NA" MCU
 SG_ OBJ_Angle_Side_STD_15 : 12352|13@1+ (0.0002,0) [0|1.571] "rad" MCU
 SG_ OBJ_Angle_Side_STD_V_15 : 12365|1@1+ (1,0) [0|1] "bool" MCU
 SG_ OBJ_Angle_Mid_V_15 : 12366|1@1+ (1,0) [0|1] "bool" MCU
 SG_ OBJ_Angle_Mid_15 : 12367|14@1+ (0.0002,-1.571) [-1.571|1.571] "rad" MCU
 SG_ Reserved_18_15 : 12381|3@1+ (1,0) [0|0] "NA" MCU
 SG_ OBJ_Angle_Mid_STD_15 : 12384|13@1+ (0.0002,0) [0|1.571] "rad" MCU
 SG_ OBJ_Angle_Mid_STD_V_15 : 12397|1@1+ (1,0) [0|1] "bool" MCU
 SG_ OBJ_Angle_Bottom_V_15 : 12398|1@1+ (1,0) [0|1] "bool" MCU
 SG_ OBJ_Angle_Bottom_15 : 12399|14@1+ (0.0002,-1.571) [-1.571|1.571] "rad" MCU
 SG_ Reserved_19_15 : 12413|3@1+ (1,0) [0|0] "NA" MCU
 SG_ OBJ_Angle_Bottom_STD_15 : 12416|13@1+ (0.0002,0) [0|1.571] "rad" MCU
 SG_ OBJ_Angle_Bottom_STD_V_15 : 12429|1@1+ (1,0) [0|1] "bool" MCU
 SG_ OBJ_Visibility_Side_V_15 : 12430|1@1+ (1,0) [0|1] "Bool" MCU
 SG_ OBJ_Visibility_Side_15 : 12431|2@1+ (1,0) [0|2] "ENUM" MCU
 SG_ OBJ_Is_In_Drivable_Area_15 : 12433|1@1+ (1,0) [0|1] "bool" MCU
 SG_ OBJ_Is_In_Drivable_Area_V_15 : 12434|1@1+ (1,0) [0|1] "bool" MCU
 SG_ OBJ_Is_VeryClose_15 : 12435|1@1+ (1,0) [0|1] "bool" MCU
 SG_ OBJ_Is_VeryClose_V_15 : 12436|1@1+ (1,0) [0|1] "bool" MCU
 SG_ OBJ_Occlusion_RL_15 : 12437|2@1+ (1,0) [0|2] "ENUM" MCU
 SG_ OBJ_Occlusion_RR_15 : 12439|2@1+ (1,0) [0|2] "ENUM" MCU
 SG_ OBJ_Occlusion_FR_15 : 12441|2@1+ (1,0) [0|2] "ENUM" MCU
 SG_ OBJ_Occlusion_FL_15 : 12443|2@1+ (1,0) [0|2] "ENUM" MCU
 SG_ OBJ_Buffer_15 : 12445|3@1+ (1,0) [0|0] "NA" MCU
 SG_ OBJ_CRC_16 : 12448|32@1+ (1,0) [0|4294967295] "NA" MCU
 SG_ OBJ_ID_16 : 12480|8@1+ (1,0) [0|255] "counter" MCU
 SG_ OBJ_Existence_Probability_16 : 12488|8@1+ (0.01,0) [0|1] "NA" MCU
 SG_ OBJ_Fusion_Source_16 : 12496|16@1+ (1,0) [0|65535] "BITWIZE" MCU
 SG_ OBJ_Triggered_SDM_16 : 12512|2@1+ (1,0) [0|2] "ENUM " MCU
 SG_ OBJ_Motion_Category_16 : 12514|4@1+ (1,0) [0|13] "ENUM " MCU
 SG_ OBJ_Buffer_C0_16 : 12518|7@1+ (1,0) [0|127] "NA" MCU
 SG_ OBJ_Object_Age_16 : 12525|11@1+ (1,0) [0|2047] "Frames" MCU
 SG_ OBJ_Measuring_Status_16 : 12536|3@1+ (1,0) [0|7] "BITWIZE" MCU
 SG_ OBJ_Object_Class_16 : 12539|4@1+ (1,0) [0|8] "ENUM" MCU
 SG_ Reserved_3_16 : 12543|1@1+ (1,0) [0|0] "NA" MCU
 SG_ OBJ_Class_Probability_16 : 12544|7@1+ (0.01,0) [0|1] "NA" MCU
 SG_ OBJ_Buffer_C1_16 : 12551|7@1+ (1,0) [0|127] "NA" MCU
 SG_ OBJ_Buffer_C2_16 : 12558|7@1+ (1,0) [0|127] "NA" MCU
 SG_ OBJ_Buffer_C3_16 : 12565|7@1+ (1,0) [0|127] "NA" MCU
 SG_ OBJ_Camera_Source_16 : 12572|4@1+ (1,0) [0|15] "ENUM" MCU
 SG_ OBJ_Motion_Status_16 : 12576|3@1+ (1,0) [0|5] "ENUM " MCU
 SG_ OBJ_Motion_Orientation_16 : 12579|4@1+ (1,0) [0|13] "ENUM " MCU
 SG_ OBJ_Has_Cut_Lane_16 : 12583|1@1+ (1,0) [0|1] "bool" MCU
 SG_ OBJ_Has_Cut_Path_16 : 12584|1@1+ (1,0) [0|1] "bool" MCU
 SG_ OBJ_Brake_Light_16 : 12585|1@1+ (1,0) [0|1] "bool" MCU
 SG_ OBJ_Turn_Indicator_Right_16 : 12586|1@1+ (1,0) [0|1] "bool" MCU
 SG_ OBJ_Turn_Indicator_Left_16 : 12587|1@1+ (1,0) [0|1] "bool" MCU
 SG_ OBJ_Light_Indicator_Validity_16 : 12588|1@1+ (1,0) [0|1] "bool" MCU
 SG_ OBJ_Right_Out_Of_Image_16 : 12589|1@1+ (1,0) [0|1] "bool" MCU
 SG_ OBJ_Left_Out_Of_Image_16 : 12590|1@1+ (1,0) [0|1] "bool" MCU
 SG_ OBJ_Right_Out_Of_Image_V_16 : 12591|1@1+ (1,0) [0|1] "bool" MCU
 SG_ OBJ_Left_Out_Of_Image_V_16 : 12592|1@1+ (1,0) [0|1] "bool" MCU
 SG_ OBJ_Top_Out_Of_Image_16 : 12593|1@1+ (1,0) [0|1] "bool" MCU
 SG_ OBJ_Bottom_Out_Of_Image_16 : 12594|1@1+ (1,0) [0|1] "bool" MCU
 SG_ OBJ_Top_Out_Of_Image_V_16 : 12595|1@1+ (1,0) [0|1] "bool" MCU
 SG_ OBJ_Bottom_Out_Of_Image_V_16 : 12596|1@1+ (1,0) [0|1] "bool" MCU
 SG_ OBJ_Lane_Assignment_16 : 12597|3@1+ (1,0) [0|5] "ENUM" MCU
 SG_ OBJ_Lane_Assignment_V_16 : 12600|1@1+ (1,0) [0|1] "bool" MCU
 SG_ OBJ_Age_Seconds_16 : 12601|7@1+ (1,0) [0|100] "s" MCU
 SG_ OBJ_Age_Seconds_V_16 : 12608|1@1+ (1,0) [0|1] "bool" MCU
 SG_ OBJ_Width_16 : 12609|9@1+ (0.01,0) [0.4|2.95] "m" MCU
 SG_ OBJ_Width_V_16 : 12618|1@1+ (1,0) [0|1] "bool" MCU
 SG_ OBJ_Width_STD_16 : 12619|8@1+ (0.01,0) [0|2] "m" MCU
 SG_ OBJ_Width_STD_V_16 : 12627|1@1+ (1,0) [0|1] "bool" MCU
 SG_ OBJ_Length_16 : 12628|9@1+ (0.05,0) [1.2|21] "m" MCU
 SG_ OBJ_Length_V_16 : 12637|1@1+ (1,0) [0|1] "bool" MCU
 SG_ Reserved_4_16 : 12638|2@1+ (1,0) [0|0] "NA" MCU
 SG_ OBJ_Length_STD_16 : 12640|8@1+ (0.05,0) [0|10] "m" MCU
 SG_ OBJ_Length_STD_V_16 : 12648|1@1+ (1,0) [0|1] "bool" MCU
 SG_ OBJ_Height_16 : 12649|9@1+ (0.01,0) [0|2.95] "m" MCU
 SG_ OBJ_Height_V_16 : 12658|1@1+ (1,0) [0|1] "bool" MCU
 SG_ OBJ_Height_STD_16 : 12659|8@1+ (0.01,0) [0|2] "m" MCU
 SG_ OBJ_Height_STD_V_16 : 12667|1@1+ (1,0) [0|1] "bool" MCU
 SG_ Reserved_5_16 : 12668|4@1+ (1,0) [0|0] "NA" MCU
 SG_ OBJ_Abs_Long_Velocity_16 : 12672|12@1+ (0.05,-30) [-30|100] "MPS" MCU
 SG_ OBJ_Abs_Long_Velocity_V_16 : 12684|1@1+ (1,0) [0|1] "bool" MCU
 SG_ OBJ_Abs_Long_Velocity_STD_16 : 12685|11@1+ (0.05,0) [0|65] "MPS" MCU
 SG_ OBJ_Abs_Long_Vel_STD_V_16 : 12696|1@1+ (1,0) [0|1] "bool" MCU
 SG_ Reserved_6_16 : 12697|7@1+ (1,0) [0|0] "NA" MCU
 SG_ OBJ_Abs_Lat_Velocity_16 : 12704|11@1+ (0.05,-50) [-50|50] "MPS" MCU
 SG_ OBJ_Abs_Lat_Velocity_V_16 : 12715|1@1+ (1,0) [0|1] "bool" MCU
 SG_ OBJ_Abs_Lat_Velocity_STD_16 : 12716|10@1+ (0.05,0) [0|50] "MPS" MCU
 SG_ OBJ_Abs_Lat_Vel_STD_V_16 : 12726|1@1+ (1,0) [0|1] "bool" MCU
 SG_ OBJ_Abs_Long_Acc_16 : 12727|9@1+ (0.05,-10.3) [-10.3|7.3] "MPS2" MCU
 SG_ OBJ_Abs_Long_Acc_V_16 : 12736|1@1+ (1,0) [0|1] "bool" MCU
 SG_ OBJ_Abs_Long_Acc_STD_16 : 12737|8@1+ (0.05,0) [0|7.3] "MPS2" MCU
 SG_ OBJ_Abs_Long_Acc_STD_V_16 : 12745|1@1+ (1,0) [0|1] "bool" MCU
 SG_ OBJ_Abs_Lat_Acc_16 : 12746|9@1+ (0.05,-10.3) [-10.3|7.3] "MPS2" MCU
 SG_ OBJ_Abs_Lat_Acc_V_16 : 12755|1@1+ (1,0) [0|1] "bool" MCU
 SG_ OBJ_Abs_Lat_Acc_STD_16 : 12756|8@1+ (0.05,0) [0|7.3] "MPS2" MCU
 SG_ OBJ_Abs_Lat_Acc_STD_V_16 : 12764|1@1+ (1,0) [0|1] "bool" MCU
 SG_ Reserved_7_16 : 12765|3@1+ (1,0) [0|0] "NA" MCU
 SG_ OBJ_Abs_Acceleration_16 : 12768|9@1+ (0.05,-10.3) [-10.3|7.3] "MPS2" MCU
 SG_ OBJ_Abs_Acceleration_V_16 : 12777|1@1+ (1,0) [0|1] "bool" MCU
 SG_ OBJ_Abs_Acc_STD_16 : 12778|8@1+ (0.05,0) [0|7.3] "MPS2" MCU
 SG_ OBJ_Abs_Acc_STD_V_16 : 12786|1@1+ (1,0) [0|1] "bool" MCU
 SG_ OBJ_Inv_TTC_16 : 12787|11@1+ (0.01,-8) [-8|8] "INV(s)" MCU
 SG_ OBJ_Inv_TTC_V_16 : 12798|1@1+ (1,0) [0|1] "bool" MCU
 SG_ Reserved_8_16 : 12799|1@1+ (1,0) [0|0] "NA" MCU
 SG_ OBJ_Inv_TTC_STD_16 : 12800|11@1+ (0.01,0) [0|4] "INV(s)" MCU
 SG_ OBJ_Inv_TTC_STD_V_16 : 12811|1@1+ (1,0) [0|1] "bool" MCU
 SG_ OBJ_Relative_Long_Acc_16 : 12812|9@1+ (0.05,-10.3) [-10.3|7.3] "MPS2" MCU
 SG_ OBJ_Relative_Long_Acc_V_16 : 12821|1@1+ (1,0) [0|1] "bool" MCU
 SG_ OBJ_Relative_Long_Acc_STD_16 : 12822|8@1+ (0.05,0) [0|7.3] "MPS2" MCU
 SG_ OBJ_Rel_Long_Acc_STD_V_16 : 12830|1@1+ (1,0) [0|1] "bool" MCU
 SG_ Reserved_9_16 : 12831|1@1+ (1,0) [0|0] "NA" MCU
 SG_ OBJ_Relative_Long_Velocity_16 : 12832|13@1+ (0.05,-120) [-120|130] "MPS" MCU
 SG_ OBJ_Relative_Long_Velocity_V_16 : 12845|1@1+ (1,0) [0|1] "bool" MCU
 SG_ OBJ_Relative_Long_Vel_STD_16 : 12846|12@1+ (0.05,0) [0|130] "MPS" MCU
 SG_ OBJ_Rel_Long_Vel_STD_V_16 : 12858|1@1+ (1,0) [0|1] "bool" MCU
 SG_ Reserved_10_16 : 12859|5@1+ (1,0) [0|0] "NA" MCU
 SG_ OBJ_Relative_Lat_Velocity_16 : 12864|11@1+ (0.05,-50) [-50|50] "MPS" MCU
 SG_ OBJ_Relative_Lat_Velocity_V_16 : 12875|1@1+ (1,0) [0|1] "bool" MCU
 SG_ OBJ_Relative_Lat_Velocity_STD_16 : 12876|10@1+ (0.05,0) [0|50] "MPS" MCU
 SG_ OBJ_Rel_Lat_Vel_STD_V_16 : 12886|1@1+ (1,0) [0|1] "bool" MCU
 SG_ Reserved_11_16 : 12887|9@1+ (1,0) [0|0] "NA" MCU
 SG_ OBJ_Long_Distance_16 : 12896|14@1+ (0.05,-200) [-200|250] "m" MCU
 SG_ OBJ_Long_Distance_V_16 : 12910|1@1+ (1,0) [0|1] "bool" MCU
 SG_ OBJ_Long_Distance_STD_16 : 12911|13@1+ (0.05,0) [0|250] "m" MCU
 SG_ OBJ_Long_Distance_STD_V_16 : 12924|1@1+ (1,0) [0|1] "bool" MCU
 SG_ Reserved_12_16 : 12925|3@1+ (1,0) [0|0] "NA" MCU
 SG_ OBJ_Lat_Distance_16 : 12928|12@1+ (0.05,-100) [-100|100] "m" MCU
 SG_ OBJ_Lat_Distance_V_16 : 12940|1@1+ (1,0) [0|1] "bool" MCU
 SG_ OBJ_Lat_Distance_STD_16 : 12941|11@1+ (0.05,0) [0|100] "m" MCU
 SG_ OBJ_Lat_Distance_STD_V_16 : 12952|1@1+ (1,0) [0|1] "bool" MCU
 SG_ Reserved_13_16 : 12953|7@1+ (1,0) [0|0] "NA" MCU
 SG_ OBJ_Absolute_Speed_16 : 12960|12@1+ (0.05,-65) [-65|65] "MPS" MCU
 SG_ OBJ_Absolute_Speed_V_16 : 12972|1@1+ (1,0) [0|1] "bool" MCU
 SG_ OBJ_Absolute_Speed_STD_16 : 12973|11@1+ (0.05,0) [0|65] "MPS" MCU
 SG_ OBJ_Absolute_Speed_STD_V_16 : 12984|1@1+ (1,0) [0|1] "bool" MCU
 SG_ Reserved_14_16 : 12985|7@1+ (1,0) [0|0] "NA" MCU
 SG_ OBJ_Heading_16 : 12992|10@1+ (0.01,-3.14) [-3.14|3.14] "rad" MCU
 SG_ OBJ_Heading_V_16 : 13002|1@1+ (1,0) [0|1] "bool" MCU
 SG_ OBJ_Heading_STD_16 : 13003|9@1+ (0.01,0) [0|3.14] "rad" MCU
 SG_ OBJ_Heading_STD_V_16 : 13012|1@1+ (1,0) [0|1] "bool" MCU
 SG_ OBJ_Angle_Rate_STD_16 : 13013|11@1+ (0.002,0) [0|2.2318] "RPS" MCU
 SG_ OBJ_Angle_Rate_STD_V_16 : 13024|1@1+ (1,0) [0|1] "bool" MCU
 SG_ OBJ_Angle_Rate_16 : 13025|12@1+ (0.002,-2.234) [-2.234|2.2318] "RPS" MCU
 SG_ OBJ_Angle_Rate_V_16 : 13037|1@1+ (1,0) [0|1] "bool" MCU
 SG_ OBJ_Angle_Right_16 : 13038|14@1+ (0.0002,-1.571) [-1.571|1.571] "rad " MCU
 SG_ OBJ_Angle_Right_V_16 : 13052|1@1+ (1,0) [0|1] "bool" MCU
 SG_ Reserved_15_16 : 13053|3@1+ (1,0) [0|0] "NA" MCU
 SG_ OBJ_Angle_Right_STD_16 : 13056|13@1+ (0.0002,0) [0|1.571] "rad " MCU
 SG_ OBJ_Angle_Right_STD_V_16 : 13069|1@1+ (1,0) [0|1] "bool" MCU
 SG_ OBJ_Angle_Left_16 : 13070|14@1+ (0.0002,-1.571) [-1.571|1.571] "rad " MCU
 SG_ OBJ_Angle_Left_V_16 : 13084|1@1+ (1,0) [0|1] "bool" MCU
 SG_ Reserved_16_16 : 13085|3@1+ (1,0) [0|0] "NA" MCU
 SG_ OBJ_Angle_Left_STD_16 : 13088|13@1+ (0.0002,0) [0|1.571] "rad" MCU
 SG_ OBJ_Angle_Left_STD_V_16 : 13101|1@1+ (1,0) [0|1] "bool" MCU
 SG_ OBJ_Angle_Side_16 : 13102|14@1+ (0.0002,-1.571) [-1.571|1.571] "rad" MCU
 SG_ OBJ_Angle_Side_V_16 : 13116|1@1+ (1,0) [0|1] "bool" MCU
 SG_ Reserved_17_16 : 13117|3@1+ (1,0) [0|0] "NA" MCU
 SG_ OBJ_Angle_Side_STD_16 : 13120|13@1+ (0.0002,0) [0|1.571] "rad" MCU
 SG_ OBJ_Angle_Side_STD_V_16 : 13133|1@1+ (1,0) [0|1] "bool" MCU
 SG_ OBJ_Angle_Mid_V_16 : 13134|1@1+ (1,0) [0|1] "bool" MCU
 SG_ OBJ_Angle_Mid_16 : 13135|14@1+ (0.0002,-1.571) [-1.571|1.571] "rad" MCU
 SG_ Reserved_18_16 : 13149|3@1+ (1,0) [0|0] "NA" MCU
 SG_ OBJ_Angle_Mid_STD_16 : 13152|13@1+ (0.0002,0) [0|1.571] "rad" MCU
 SG_ OBJ_Angle_Mid_STD_V_16 : 13165|1@1+ (1,0) [0|1] "bool" MCU
 SG_ OBJ_Angle_Bottom_V_16 : 13166|1@1+ (1,0) [0|1] "bool" MCU
 SG_ OBJ_Angle_Bottom_16 : 13167|14@1+ (0.0002,-1.571) [-1.571|1.571] "rad" MCU
 SG_ Reserved_19_16 : 13181|3@1+ (1,0) [0|0] "NA" MCU
 SG_ OBJ_Angle_Bottom_STD_16 : 13184|13@1+ (0.0002,0) [0|1.571] "rad" MCU
 SG_ OBJ_Angle_Bottom_STD_V_16 : 13197|1@1+ (1,0) [0|1] "bool" MCU
 SG_ OBJ_Visibility_Side_V_16 : 13198|1@1+ (1,0) [0|1] "Bool" MCU
 SG_ OBJ_Visibility_Side_16 : 13199|2@1+ (1,0) [0|2] "ENUM" MCU
 SG_ OBJ_Is_In_Drivable_Area_16 : 13201|1@1+ (1,0) [0|1] "bool" MCU
 SG_ OBJ_Is_In_Drivable_Area_V_16 : 13202|1@1+ (1,0) [0|1] "bool" MCU
 SG_ OBJ_Is_VeryClose_16 : 13203|1@1+ (1,0) [0|1] "bool" MCU
 SG_ OBJ_Is_VeryClose_V_16 : 13204|1@1+ (1,0) [0|1] "bool" MCU
 SG_ OBJ_Occlusion_RL_16 : 13205|2@1+ (1,0) [0|2] "ENUM" MCU
 SG_ OBJ_Occlusion_RR_16 : 13207|2@1+ (1,0) [0|2] "ENUM" MCU
 SG_ OBJ_Occlusion_FR_16 : 13209|2@1+ (1,0) [0|2] "ENUM" MCU
 SG_ OBJ_Occlusion_FL_16 : 13211|2@1+ (1,0) [0|2] "ENUM" MCU
 SG_ OBJ_Buffer_16 : 13213|3@1+ (1,0) [0|0] "NA" MCU
 SG_ OBJ_CRC_17 : 13216|32@1+ (1,0) [0|4294967295] "NA" MCU
 SG_ OBJ_ID_17 : 13248|8@1+ (1,0) [0|255] "counter" MCU
 SG_ OBJ_Existence_Probability_17 : 13256|8@1+ (0.01,0) [0|1] "NA" MCU
 SG_ OBJ_Fusion_Source_17 : 13264|16@1+ (1,0) [0|65535] "BITWIZE" MCU
 SG_ OBJ_Triggered_SDM_17 : 13280|2@1+ (1,0) [0|2] "ENUM " MCU
 SG_ OBJ_Motion_Category_17 : 13282|4@1+ (1,0) [0|13] "ENUM " MCU
 SG_ OBJ_Buffer_C0_17 : 13286|7@1+ (1,0) [0|127] "NA" MCU
 SG_ OBJ_Object_Age_17 : 13293|11@1+ (1,0) [0|2047] "Frames" MCU
 SG_ OBJ_Measuring_Status_17 : 13304|3@1+ (1,0) [0|7] "BITWIZE" MCU
 SG_ OBJ_Object_Class_17 : 13307|4@1+ (1,0) [0|8] "ENUM" MCU
 SG_ Reserved_3_17 : 13311|1@1+ (1,0) [0|0] "NA" MCU
 SG_ OBJ_Class_Probability_17 : 13312|7@1+ (0.01,0) [0|1] "NA" MCU
 SG_ OBJ_Buffer_C1_17 : 13319|7@1+ (1,0) [0|127] "NA" MCU
 SG_ OBJ_Buffer_C2_17 : 13326|7@1+ (1,0) [0|127] "NA" MCU
 SG_ OBJ_Buffer_C3_17 : 13333|7@1+ (1,0) [0|127] "NA" MCU
 SG_ OBJ_Camera_Source_17 : 13340|4@1+ (1,0) [0|15] "ENUM" MCU
 SG_ OBJ_Motion_Status_17 : 13344|3@1+ (1,0) [0|5] "ENUM " MCU
 SG_ OBJ_Motion_Orientation_17 : 13347|4@1+ (1,0) [0|13] "ENUM " MCU
 SG_ OBJ_Has_Cut_Lane_17 : 13351|1@1+ (1,0) [0|1] "bool" MCU
 SG_ OBJ_Has_Cut_Path_17 : 13352|1@1+ (1,0) [0|1] "bool" MCU
 SG_ OBJ_Brake_Light_17 : 13353|1@1+ (1,0) [0|1] "bool" MCU
 SG_ OBJ_Turn_Indicator_Right_17 : 13354|1@1+ (1,0) [0|1] "bool" MCU
 SG_ OBJ_Turn_Indicator_Left_17 : 13355|1@1+ (1,0) [0|1] "bool" MCU
 SG_ OBJ_Light_Indicator_Validity_17 : 13356|1@1+ (1,0) [0|1] "bool" MCU
 SG_ OBJ_Right_Out_Of_Image_17 : 13357|1@1+ (1,0) [0|1] "bool" MCU
 SG_ OBJ_Left_Out_Of_Image_17 : 13358|1@1+ (1,0) [0|1] "bool" MCU
 SG_ OBJ_Right_Out_Of_Image_V_17 : 13359|1@1+ (1,0) [0|1] "bool" MCU
 SG_ OBJ_Left_Out_Of_Image_V_17 : 13360|1@1+ (1,0) [0|1] "bool" MCU
 SG_ OBJ_Top_Out_Of_Image_17 : 13361|1@1+ (1,0) [0|1] "bool" MCU
 SG_ OBJ_Bottom_Out_Of_Image_17 : 13362|1@1+ (1,0) [0|1] "bool" MCU
 SG_ OBJ_Top_Out_Of_Image_V_17 : 13363|1@1+ (1,0) [0|1] "bool" MCU
 SG_ OBJ_Bottom_Out_Of_Image_V_17 : 13364|1@1+ (1,0) [0|1] "bool" MCU
 SG_ OBJ_Lane_Assignment_17 : 13365|3@1+ (1,0) [0|5] "ENUM" MCU
 SG_ OBJ_Lane_Assignment_V_17 : 13368|1@1+ (1,0) [0|1] "bool" MCU
 SG_ OBJ_Age_Seconds_17 : 13369|7@1+ (1,0) [0|100] "s" MCU
 SG_ OBJ_Age_Seconds_V_17 : 13376|1@1+ (1,0) [0|1] "bool" MCU
 SG_ OBJ_Width_17 : 13377|9@1+ (0.01,0) [0.4|2.95] "m" MCU
 SG_ OBJ_Width_V_17 : 13386|1@1+ (1,0) [0|1] "bool" MCU
 SG_ OBJ_Width_STD_17 : 13387|8@1+ (0.01,0) [0|2] "m" MCU
 SG_ OBJ_Width_STD_V_17 : 13395|1@1+ (1,0) [0|1] "bool" MCU
 SG_ OBJ_Length_17 : 13396|9@1+ (0.05,0) [1.2|21] "m" MCU
 SG_ OBJ_Length_V_17 : 13405|1@1+ (1,0) [0|1] "bool" MCU
 SG_ Reserved_4_17 : 13406|2@1+ (1,0) [0|0] "NA" MCU
 SG_ OBJ_Length_STD_17 : 13408|8@1+ (0.05,0) [0|10] "m" MCU
 SG_ OBJ_Length_STD_V_17 : 13416|1@1+ (1,0) [0|1] "bool" MCU
 SG_ OBJ_Height_17 : 13417|9@1+ (0.01,0) [0|2.95] "m" MCU
 SG_ OBJ_Height_V_17 : 13426|1@1+ (1,0) [0|1] "bool" MCU
 SG_ OBJ_Height_STD_17 : 13427|8@1+ (0.01,0) [0|2] "m" MCU
 SG_ OBJ_Height_STD_V_17 : 13435|1@1+ (1,0) [0|1] "bool" MCU
 SG_ Reserved_5_17 : 13436|4@1+ (1,0) [0|0] "NA" MCU
 SG_ OBJ_Abs_Long_Velocity_17 : 13440|12@1+ (0.05,-30) [-30|100] "MPS" MCU
 SG_ OBJ_Abs_Long_Velocity_V_17 : 13452|1@1+ (1,0) [0|1] "bool" MCU
 SG_ OBJ_Abs_Long_Velocity_STD_17 : 13453|11@1+ (0.05,0) [0|65] "MPS" MCU
 SG_ OBJ_Abs_Long_Vel_STD_V_17 : 13464|1@1+ (1,0) [0|1] "bool" MCU
 SG_ Reserved_6_17 : 13465|7@1+ (1,0) [0|0] "NA" MCU
 SG_ OBJ_Abs_Lat_Velocity_17 : 13472|11@1+ (0.05,-50) [-50|50] "MPS" MCU
 SG_ OBJ_Abs_Lat_Velocity_V_17 : 13483|1@1+ (1,0) [0|1] "bool" MCU
 SG_ OBJ_Abs_Lat_Velocity_STD_17 : 13484|10@1+ (0.05,0) [0|50] "MPS" MCU
 SG_ OBJ_Abs_Lat_Vel_STD_V_17 : 13494|1@1+ (1,0) [0|1] "bool" MCU
 SG_ OBJ_Abs_Long_Acc_17 : 13495|9@1+ (0.05,-10.3) [-10.3|7.3] "MPS2" MCU
 SG_ OBJ_Abs_Long_Acc_V_17 : 13504|1@1+ (1,0) [0|1] "bool" MCU
 SG_ OBJ_Abs_Long_Acc_STD_17 : 13505|8@1+ (0.05,0) [0|7.3] "MPS2" MCU
 SG_ OBJ_Abs_Long_Acc_STD_V_17 : 13513|1@1+ (1,0) [0|1] "bool" MCU
 SG_ OBJ_Abs_Lat_Acc_17 : 13514|9@1+ (0.05,-10.3) [-10.3|7.3] "MPS2" MCU
 SG_ OBJ_Abs_Lat_Acc_V_17 : 13523|1@1+ (1,0) [0|1] "bool" MCU
 SG_ OBJ_Abs_Lat_Acc_STD_17 : 13524|8@1+ (0.05,0) [0|7.3] "MPS2" MCU
 SG_ OBJ_Abs_Lat_Acc_STD_V_17 : 13532|1@1+ (1,0) [0|1] "bool" MCU
 SG_ Reserved_7_17 : 13533|3@1+ (1,0) [0|0] "NA" MCU
 SG_ OBJ_Abs_Acceleration_17 : 13536|9@1+ (0.05,-10.3) [-10.3|7.3] "MPS2" MCU
 SG_ OBJ_Abs_Acceleration_V_17 : 13545|1@1+ (1,0) [0|1] "bool" MCU
 SG_ OBJ_Abs_Acc_STD_17 : 13546|8@1+ (0.05,0) [0|7.3] "MPS2" MCU
 SG_ OBJ_Abs_Acc_STD_V_17 : 13554|1@1+ (1,0) [0|1] "bool" MCU
 SG_ OBJ_Inv_TTC_17 : 13555|11@1+ (0.01,-8) [-8|8] "INV(s)" MCU
 SG_ OBJ_Inv_TTC_V_17 : 13566|1@1+ (1,0) [0|1] "bool" MCU
 SG_ Reserved_8_17 : 13567|1@1+ (1,0) [0|0] "NA" MCU
 SG_ OBJ_Inv_TTC_STD_17 : 13568|11@1+ (0.01,0) [0|4] "INV(s)" MCU
 SG_ OBJ_Inv_TTC_STD_V_17 : 13579|1@1+ (1,0) [0|1] "bool" MCU
 SG_ OBJ_Relative_Long_Acc_17 : 13580|9@1+ (0.05,-10.3) [-10.3|7.3] "MPS2" MCU
 SG_ OBJ_Relative_Long_Acc_V_17 : 13589|1@1+ (1,0) [0|1] "bool" MCU
 SG_ OBJ_Relative_Long_Acc_STD_17 : 13590|8@1+ (0.05,0) [0|7.3] "MPS2" MCU
 SG_ OBJ_Rel_Long_Acc_STD_V_17 : 13598|1@1+ (1,0) [0|1] "bool" MCU
 SG_ Reserved_9_17 : 13599|1@1+ (1,0) [0|0] "NA" MCU
 SG_ OBJ_Relative_Long_Velocity_17 : 13600|13@1+ (0.05,-120) [-120|130] "MPS" MCU
 SG_ OBJ_Relative_Long_Velocity_V_17 : 13613|1@1+ (1,0) [0|1] "bool" MCU
 SG_ OBJ_Relative_Long_Vel_STD_17 : 13614|12@1+ (0.05,0) [0|130] "MPS" MCU
 SG_ OBJ_Rel_Long_Vel_STD_V_17 : 13626|1@1+ (1,0) [0|1] "bool" MCU
 SG_ Reserved_10_17 : 13627|5@1+ (1,0) [0|0] "NA" MCU
 SG_ OBJ_Relative_Lat_Velocity_17 : 13632|11@1+ (0.05,-50) [-50|50] "MPS" MCU
 SG_ OBJ_Relative_Lat_Velocity_V_17 : 13643|1@1+ (1,0) [0|1] "bool" MCU
 SG_ OBJ_Relative_Lat_Velocity_STD_17 : 13644|10@1+ (0.05,0) [0|50] "MPS" MCU
 SG_ OBJ_Rel_Lat_Vel_STD_V_17 : 13654|1@1+ (1,0) [0|1] "bool" MCU
 SG_ Reserved_11_17 : 13655|9@1+ (1,0) [0|0] "NA" MCU
 SG_ OBJ_Long_Distance_17 : 13664|14@1+ (0.05,-200) [-200|250] "m" MCU
 SG_ OBJ_Long_Distance_V_17 : 13678|1@1+ (1,0) [0|1] "bool" MCU
 SG_ OBJ_Long_Distance_STD_17 : 13679|13@1+ (0.05,0) [0|250] "m" MCU
 SG_ OBJ_Long_Distance_STD_V_17 : 13692|1@1+ (1,0) [0|1] "bool" MCU
 SG_ Reserved_12_17 : 13693|3@1+ (1,0) [0|0] "NA" MCU
 SG_ OBJ_Lat_Distance_17 : 13696|12@1+ (0.05,-100) [-100|100] "m" MCU
 SG_ OBJ_Lat_Distance_V_17 : 13708|1@1+ (1,0) [0|1] "bool" MCU
 SG_ OBJ_Lat_Distance_STD_17 : 13709|11@1+ (0.05,0) [0|100] "m" MCU
 SG_ OBJ_Lat_Distance_STD_V_17 : 13720|1@1+ (1,0) [0|1] "bool" MCU
 SG_ Reserved_13_17 : 13721|7@1+ (1,0) [0|0] "NA" MCU
 SG_ OBJ_Absolute_Speed_17 : 13728|12@1+ (0.05,-65) [-65|65] "MPS" MCU
 SG_ OBJ_Absolute_Speed_V_17 : 13740|1@1+ (1,0) [0|1] "bool" MCU
 SG_ OBJ_Absolute_Speed_STD_17 : 13741|11@1+ (0.05,0) [0|65] "MPS" MCU
 SG_ OBJ_Absolute_Speed_STD_V_17 : 13752|1@1+ (1,0) [0|1] "bool" MCU
 SG_ Reserved_14_17 : 13753|7@1+ (1,0) [0|0] "NA" MCU
 SG_ OBJ_Heading_17 : 13760|10@1+ (0.01,-3.14) [-3.14|3.14] "rad" MCU
 SG_ OBJ_Heading_V_17 : 13770|1@1+ (1,0) [0|1] "bool" MCU
 SG_ OBJ_Heading_STD_17 : 13771|9@1+ (0.01,0) [0|3.14] "rad" MCU
 SG_ OBJ_Heading_STD_V_17 : 13780|1@1+ (1,0) [0|1] "bool" MCU
 SG_ OBJ_Angle_Rate_STD_17 : 13781|11@1+ (0.002,0) [0|2.2318] "RPS" MCU
 SG_ OBJ_Angle_Rate_STD_V_17 : 13792|1@1+ (1,0) [0|1] "bool" MCU
 SG_ OBJ_Angle_Rate_17 : 13793|12@1+ (0.002,-2.234) [-2.234|2.2318] "RPS" MCU
 SG_ OBJ_Angle_Rate_V_17 : 13805|1@1+ (1,0) [0|1] "bool" MCU
 SG_ OBJ_Angle_Right_17 : 13806|14@1+ (0.0002,-1.571) [-1.571|1.571] "rad " MCU
 SG_ OBJ_Angle_Right_V_17 : 13820|1@1+ (1,0) [0|1] "bool" MCU
 SG_ Reserved_15_17 : 13821|3@1+ (1,0) [0|0] "NA" MCU
 SG_ OBJ_Angle_Right_STD_17 : 13824|13@1+ (0.0002,0) [0|1.571] "rad " MCU
 SG_ OBJ_Angle_Right_STD_V_17 : 13837|1@1+ (1,0) [0|1] "bool" MCU
 SG_ OBJ_Angle_Left_17 : 13838|14@1+ (0.0002,-1.571) [-1.571|1.571] "rad " MCU
 SG_ OBJ_Angle_Left_V_17 : 13852|1@1+ (1,0) [0|1] "bool" MCU
 SG_ Reserved_16_17 : 13853|3@1+ (1,0) [0|0] "NA" MCU
 SG_ OBJ_Angle_Left_STD_17 : 13856|13@1+ (0.0002,0) [0|1.571] "rad" MCU
 SG_ OBJ_Angle_Left_STD_V_17 : 13869|1@1+ (1,0) [0|1] "bool" MCU
 SG_ OBJ_Angle_Side_17 : 13870|14@1+ (0.0002,-1.571) [-1.571|1.571] "rad" MCU
 SG_ OBJ_Angle_Side_V_17 : 13884|1@1+ (1,0) [0|1] "bool" MCU
 SG_ Reserved_17_17 : 13885|3@1+ (1,0) [0|0] "NA" MCU
 SG_ OBJ_Angle_Side_STD_17 : 13888|13@1+ (0.0002,0) [0|1.571] "rad" MCU
 SG_ OBJ_Angle_Side_STD_V_17 : 13901|1@1+ (1,0) [0|1] "bool" MCU
 SG_ OBJ_Angle_Mid_V_17 : 13902|1@1+ (1,0) [0|1] "bool" MCU
 SG_ OBJ_Angle_Mid_17 : 13903|14@1+ (0.0002,-1.571) [-1.571|1.571] "rad" MCU
 SG_ Reserved_18_17 : 13917|3@1+ (1,0) [0|0] "NA" MCU
 SG_ OBJ_Angle_Mid_STD_17 : 13920|13@1+ (0.0002,0) [0|1.571] "rad" MCU
 SG_ OBJ_Angle_Mid_STD_V_17 : 13933|1@1+ (1,0) [0|1] "bool" MCU
 SG_ OBJ_Angle_Bottom_V_17 : 13934|1@1+ (1,0) [0|1] "bool" MCU
 SG_ OBJ_Angle_Bottom_17 : 13935|14@1+ (0.0002,-1.571) [-1.571|1.571] "rad" MCU
 SG_ Reserved_19_17 : 13949|3@1+ (1,0) [0|0] "NA" MCU
 SG_ OBJ_Angle_Bottom_STD_17 : 13952|13@1+ (0.0002,0) [0|1.571] "rad" MCU
 SG_ OBJ_Angle_Bottom_STD_V_17 : 13965|1@1+ (1,0) [0|1] "bool" MCU
 SG_ OBJ_Visibility_Side_V_17 : 13966|1@1+ (1,0) [0|1] "Bool" MCU
 SG_ OBJ_Visibility_Side_17 : 13967|2@1+ (1,0) [0|2] "ENUM" MCU
 SG_ OBJ_Is_In_Drivable_Area_17 : 13969|1@1+ (1,0) [0|1] "bool" MCU
 SG_ OBJ_Is_In_Drivable_Area_V_17 : 13970|1@1+ (1,0) [0|1] "bool" MCU
 SG_ OBJ_Is_VeryClose_17 : 13971|1@1+ (1,0) [0|1] "bool" MCU
 SG_ OBJ_Is_VeryClose_V_17 : 13972|1@1+ (1,0) [0|1] "bool" MCU
 SG_ OBJ_Occlusion_RL_17 : 13973|2@1+ (1,0) [0|2] "ENUM" MCU
 SG_ OBJ_Occlusion_RR_17 : 13975|2@1+ (1,0) [0|2] "ENUM" MCU
 SG_ OBJ_Occlusion_FR_17 : 13977|2@1+ (1,0) [0|2] "ENUM" MCU
 SG_ OBJ_Occlusion_FL_17 : 13979|2@1+ (1,0) [0|2] "ENUM" MCU
 SG_ OBJ_Buffer_17 : 13981|3@1+ (1,0) [0|0] "NA" MCU
 SG_ OBJ_CRC_18 : 13984|32@1+ (1,0) [0|4294967295] "NA" MCU
 SG_ OBJ_ID_18 : 14016|8@1+ (1,0) [0|255] "counter" MCU
 SG_ OBJ_Existence_Probability_18 : 14024|8@1+ (0.01,0) [0|1] "NA" MCU
 SG_ OBJ_Fusion_Source_18 : 14032|16@1+ (1,0) [0|65535] "BITWIZE" MCU
 SG_ OBJ_Triggered_SDM_18 : 14048|2@1+ (1,0) [0|2] "ENUM " MCU
 SG_ OBJ_Motion_Category_18 : 14050|4@1+ (1,0) [0|13] "ENUM " MCU
 SG_ OBJ_Buffer_C0_18 : 14054|7@1+ (1,0) [0|127] "NA" MCU
 SG_ OBJ_Object_Age_18 : 14061|11@1+ (1,0) [0|2047] "Frames" MCU
 SG_ OBJ_Measuring_Status_18 : 14072|3@1+ (1,0) [0|7] "BITWIZE" MCU
 SG_ OBJ_Object_Class_18 : 14075|4@1+ (1,0) [0|8] "ENUM" MCU
 SG_ Reserved_3_18 : 14079|1@1+ (1,0) [0|0] "NA" MCU
 SG_ OBJ_Class_Probability_18 : 14080|7@1+ (0.01,0) [0|1] "NA" MCU
 SG_ OBJ_Buffer_C1_18 : 14087|7@1+ (1,0) [0|127] "NA" MCU
 SG_ OBJ_Buffer_C2_18 : 14094|7@1+ (1,0) [0|127] "NA" MCU
 SG_ OBJ_Buffer_C3_18 : 14101|7@1+ (1,0) [0|127] "NA" MCU
 SG_ OBJ_Camera_Source_18 : 14108|4@1+ (1,0) [0|15] "ENUM" MCU
 SG_ OBJ_Motion_Status_18 : 14112|3@1+ (1,0) [0|5] "ENUM " MCU
 SG_ OBJ_Motion_Orientation_18 : 14115|4@1+ (1,0) [0|13] "ENUM " MCU
 SG_ OBJ_Has_Cut_Lane_18 : 14119|1@1+ (1,0) [0|1] "bool" MCU
 SG_ OBJ_Has_Cut_Path_18 : 14120|1@1+ (1,0) [0|1] "bool" MCU
 SG_ OBJ_Brake_Light_18 : 14121|1@1+ (1,0) [0|1] "bool" MCU
 SG_ OBJ_Turn_Indicator_Right_18 : 14122|1@1+ (1,0) [0|1] "bool" MCU
 SG_ OBJ_Turn_Indicator_Left_18 : 14123|1@1+ (1,0) [0|1] "bool" MCU
 SG_ OBJ_Light_Indicator_Validity_18 : 14124|1@1+ (1,0) [0|1] "bool" MCU
 SG_ OBJ_Right_Out_Of_Image_18 : 14125|1@1+ (1,0) [0|1] "bool" MCU
 SG_ OBJ_Left_Out_Of_Image_18 : 14126|1@1+ (1,0) [0|1] "bool" MCU
 SG_ OBJ_Right_Out_Of_Image_V_18 : 14127|1@1+ (1,0) [0|1] "bool" MCU
 SG_ OBJ_Left_Out_Of_Image_V_18 : 14128|1@1+ (1,0) [0|1] "bool" MCU
 SG_ OBJ_Top_Out_Of_Image_18 : 14129|1@1+ (1,0) [0|1] "bool" MCU
 SG_ OBJ_Bottom_Out_Of_Image_18 : 14130|1@1+ (1,0) [0|1] "bool" MCU
 SG_ OBJ_Top_Out_Of_Image_V_18 : 14131|1@1+ (1,0) [0|1] "bool" MCU
 SG_ OBJ_Bottom_Out_Of_Image_V_18 : 14132|1@1+ (1,0) [0|1] "bool" MCU
 SG_ OBJ_Lane_Assignment_18 : 14133|3@1+ (1,0) [0|5] "ENUM" MCU
 SG_ OBJ_Lane_Assignment_V_18 : 14136|1@1+ (1,0) [0|1] "bool" MCU
 SG_ OBJ_Age_Seconds_18 : 14137|7@1+ (1,0) [0|100] "s" MCU
 SG_ OBJ_Age_Seconds_V_18 : 14144|1@1+ (1,0) [0|1] "bool" MCU
 SG_ OBJ_Width_18 : 14145|9@1+ (0.01,0) [0.4|2.95] "m" MCU
 SG_ OBJ_Width_V_18 : 14154|1@1+ (1,0) [0|1] "bool" MCU
 SG_ OBJ_Width_STD_18 : 14155|8@1+ (0.01,0) [0|2] "m" MCU
 SG_ OBJ_Width_STD_V_18 : 14163|1@1+ (1,0) [0|1] "bool" MCU
 SG_ OBJ_Length_18 : 14164|9@1+ (0.05,0) [1.2|21] "m" MCU
 SG_ OBJ_Length_V_18 : 14173|1@1+ (1,0) [0|1] "bool" MCU
 SG_ Reserved_4_18 : 14174|2@1+ (1,0) [0|0] "NA" MCU
 SG_ OBJ_Length_STD_18 : 14176|8@1+ (0.05,0) [0|10] "m" MCU
 SG_ OBJ_Length_STD_V_18 : 14184|1@1+ (1,0) [0|1] "bool" MCU
 SG_ OBJ_Height_18 : 14185|9@1+ (0.01,0) [0|2.95] "m" MCU
 SG_ OBJ_Height_V_18 : 14194|1@1+ (1,0) [0|1] "bool" MCU
 SG_ OBJ_Height_STD_18 : 14195|8@1+ (0.01,0) [0|2] "m" MCU
 SG_ OBJ_Height_STD_V_18 : 14203|1@1+ (1,0) [0|1] "bool" MCU
 SG_ Reserved_5_18 : 14204|4@1+ (1,0) [0|0] "NA" MCU
 SG_ OBJ_Abs_Long_Velocity_18 : 14208|12@1+ (0.05,-30) [-30|100] "MPS" MCU
 SG_ OBJ_Abs_Long_Velocity_V_18 : 14220|1@1+ (1,0) [0|1] "bool" MCU
 SG_ OBJ_Abs_Long_Velocity_STD_18 : 14221|11@1+ (0.05,0) [0|65] "MPS" MCU
 SG_ OBJ_Abs_Long_Vel_STD_V_18 : 14232|1@1+ (1,0) [0|1] "bool" MCU
 SG_ Reserved_6_18 : 14233|7@1+ (1,0) [0|0] "NA" MCU
 SG_ OBJ_Abs_Lat_Velocity_18 : 14240|11@1+ (0.05,-50) [-50|50] "MPS" MCU
 SG_ OBJ_Abs_Lat_Velocity_V_18 : 14251|1@1+ (1,0) [0|1] "bool" MCU
 SG_ OBJ_Abs_Lat_Velocity_STD_18 : 14252|10@1+ (0.05,0) [0|50] "MPS" MCU
 SG_ OBJ_Abs_Lat_Vel_STD_V_18 : 14262|1@1+ (1,0) [0|1] "bool" MCU
 SG_ OBJ_Abs_Long_Acc_18 : 14263|9@1+ (0.05,-10.3) [-10.3|7.3] "MPS2" MCU
 SG_ OBJ_Abs_Long_Acc_V_18 : 14272|1@1+ (1,0) [0|1] "bool" MCU
 SG_ OBJ_Abs_Long_Acc_STD_18 : 14273|8@1+ (0.05,0) [0|7.3] "MPS2" MCU
 SG_ OBJ_Abs_Long_Acc_STD_V_18 : 14281|1@1+ (1,0) [0|1] "bool" MCU
 SG_ OBJ_Abs_Lat_Acc_18 : 14282|9@1+ (0.05,-10.3) [-10.3|7.3] "MPS2" MCU
 SG_ OBJ_Abs_Lat_Acc_V_18 : 14291|1@1+ (1,0) [0|1] "bool" MCU
 SG_ OBJ_Abs_Lat_Acc_STD_18 : 14292|8@1+ (0.05,0) [0|7.3] "MPS2" MCU
 SG_ OBJ_Abs_Lat_Acc_STD_V_18 : 14300|1@1+ (1,0) [0|1] "bool" MCU
 SG_ Reserved_7_18 : 14301|3@1+ (1,0) [0|0] "NA" MCU
 SG_ OBJ_Abs_Acceleration_18 : 14304|9@1+ (0.05,-10.3) [-10.3|7.3] "MPS2" MCU
 SG_ OBJ_Abs_Acceleration_V_18 : 14313|1@1+ (1,0) [0|1] "bool" MCU
 SG_ OBJ_Abs_Acc_STD_18 : 14314|8@1+ (0.05,0) [0|7.3] "MPS2" MCU
 SG_ OBJ_Abs_Acc_STD_V_18 : 14322|1@1+ (1,0) [0|1] "bool" MCU
 SG_ OBJ_Inv_TTC_18 : 14323|11@1+ (0.01,-8) [-8|8] "INV(s)" MCU
 SG_ OBJ_Inv_TTC_V_18 : 14334|1@1+ (1,0) [0|1] "bool" MCU
 SG_ Reserved_8_18 : 14335|1@1+ (1,0) [0|0] "NA" MCU
 SG_ OBJ_Inv_TTC_STD_18 : 14336|11@1+ (0.01,0) [0|4] "INV(s)" MCU
 SG_ OBJ_Inv_TTC_STD_V_18 : 14347|1@1+ (1,0) [0|1] "bool" MCU
 SG_ OBJ_Relative_Long_Acc_18 : 14348|9@1+ (0.05,-10.3) [-10.3|7.3] "MPS2" MCU
 SG_ OBJ_Relative_Long_Acc_V_18 : 14357|1@1+ (1,0) [0|1] "bool" MCU
 SG_ OBJ_Relative_Long_Acc_STD_18 : 14358|8@1+ (0.05,0) [0|7.3] "MPS2" MCU
 SG_ OBJ_Rel_Long_Acc_STD_V_18 : 14366|1@1+ (1,0) [0|1] "bool" MCU
 SG_ Reserved_9_18 : 14367|1@1+ (1,0) [0|0] "NA" MCU
 SG_ OBJ_Relative_Long_Velocity_18 : 14368|13@1+ (0.05,-120) [-120|130] "MPS" MCU
 SG_ OBJ_Relative_Long_Velocity_V_18 : 14381|1@1+ (1,0) [0|1] "bool" MCU
 SG_ OBJ_Relative_Long_Vel_STD_18 : 14382|12@1+ (0.05,0) [0|130] "MPS" MCU
 SG_ OBJ_Rel_Long_Vel_STD_V_18 : 14394|1@1+ (1,0) [0|1] "bool" MCU
 SG_ Reserved_10_18 : 14395|5@1+ (1,0) [0|0] "NA" MCU
 SG_ OBJ_Relative_Lat_Velocity_18 : 14400|11@1+ (0.05,-50) [-50|50] "MPS" MCU
 SG_ OBJ_Relative_Lat_Velocity_V_18 : 14411|1@1+ (1,0) [0|1] "bool" MCU
 SG_ OBJ_Relative_Lat_Velocity_STD_18 : 14412|10@1+ (0.05,0) [0|50] "MPS" MCU
 SG_ OBJ_Rel_Lat_Vel_STD_V_18 : 14422|1@1+ (1,0) [0|1] "bool" MCU
 SG_ Reserved_11_18 : 14423|9@1+ (1,0) [0|0] "NA" MCU
 SG_ OBJ_Long_Distance_18 : 14432|14@1+ (0.05,-200) [-200|250] "m" MCU
 SG_ OBJ_Long_Distance_V_18 : 14446|1@1+ (1,0) [0|1] "bool" MCU
 SG_ OBJ_Long_Distance_STD_18 : 14447|13@1+ (0.05,0) [0|250] "m" MCU
 SG_ OBJ_Long_Distance_STD_V_18 : 14460|1@1+ (1,0) [0|1] "bool" MCU
 SG_ Reserved_12_18 : 14461|3@1+ (1,0) [0|0] "NA" MCU
 SG_ OBJ_Lat_Distance_18 : 14464|12@1+ (0.05,-100) [-100|100] "m" MCU
 SG_ OBJ_Lat_Distance_V_18 : 14476|1@1+ (1,0) [0|1] "bool" MCU
 SG_ OBJ_Lat_Distance_STD_18 : 14477|11@1+ (0.05,0) [0|100] "m" MCU
 SG_ OBJ_Lat_Distance_STD_V_18 : 14488|1@1+ (1,0) [0|1] "bool" MCU
 SG_ Reserved_13_18 : 14489|7@1+ (1,0) [0|0] "NA" MCU
 SG_ OBJ_Absolute_Speed_18 : 14496|12@1+ (0.05,-65) [-65|65] "MPS" MCU
 SG_ OBJ_Absolute_Speed_V_18 : 14508|1@1+ (1,0) [0|1] "bool" MCU
 SG_ OBJ_Absolute_Speed_STD_18 : 14509|11@1+ (0.05,0) [0|65] "MPS" MCU
 SG_ OBJ_Absolute_Speed_STD_V_18 : 14520|1@1+ (1,0) [0|1] "bool" MCU
 SG_ Reserved_14_18 : 14521|7@1+ (1,0) [0|0] "NA" MCU
 SG_ OBJ_Heading_18 : 14528|10@1+ (0.01,-3.14) [-3.14|3.14] "rad" MCU
 SG_ OBJ_Heading_V_18 : 14538|1@1+ (1,0) [0|1] "bool" MCU
 SG_ OBJ_Heading_STD_18 : 14539|9@1+ (0.01,0) [0|3.14] "rad" MCU
 SG_ OBJ_Heading_STD_V_18 : 14548|1@1+ (1,0) [0|1] "bool" MCU
 SG_ OBJ_Angle_Rate_STD_18 : 14549|11@1+ (0.002,0) [0|2.2318] "RPS" MCU
 SG_ OBJ_Angle_Rate_STD_V_18 : 14560|1@1+ (1,0) [0|1] "bool" MCU
 SG_ OBJ_Angle_Rate_18 : 14561|12@1+ (0.002,-2.234) [-2.234|2.2318] "RPS" MCU
 SG_ OBJ_Angle_Rate_V_18 : 14573|1@1+ (1,0) [0|1] "bool" MCU
 SG_ OBJ_Angle_Right_18 : 14574|14@1+ (0.0002,-1.571) [-1.571|1.571] "rad " MCU
 SG_ OBJ_Angle_Right_V_18 : 14588|1@1+ (1,0) [0|1] "bool" MCU
 SG_ Reserved_15_18 : 14589|3@1+ (1,0) [0|0] "NA" MCU
 SG_ OBJ_Angle_Right_STD_18 : 14592|13@1+ (0.0002,0) [0|1.571] "rad " MCU
 SG_ OBJ_Angle_Right_STD_V_18 : 14605|1@1+ (1,0) [0|1] "bool" MCU
 SG_ OBJ_Angle_Left_18 : 14606|14@1+ (0.0002,-1.571) [-1.571|1.571] "rad " MCU
 SG_ OBJ_Angle_Left_V_18 : 14620|1@1+ (1,0) [0|1] "bool" MCU
 SG_ Reserved_16_18 : 14621|3@1+ (1,0) [0|0] "NA" MCU
 SG_ OBJ_Angle_Left_STD_18 : 14624|13@1+ (0.0002,0) [0|1.571] "rad" MCU
 SG_ OBJ_Angle_Left_STD_V_18 : 14637|1@1+ (1,0) [0|1] "bool" MCU
 SG_ OBJ_Angle_Side_18 : 14638|14@1+ (0.0002,-1.571) [-1.571|1.571] "rad" MCU
 SG_ OBJ_Angle_Side_V_18 : 14652|1@1+ (1,0) [0|1] "bool" MCU
 SG_ Reserved_17_18 : 14653|3@1+ (1,0) [0|0] "NA" MCU
 SG_ OBJ_Angle_Side_STD_18 : 14656|13@1+ (0.0002,0) [0|1.571] "rad" MCU
 SG_ OBJ_Angle_Side_STD_V_18 : 14669|1@1+ (1,0) [0|1] "bool" MCU
 SG_ OBJ_Angle_Mid_V_18 : 14670|1@1+ (1,0) [0|1] "bool" MCU
 SG_ OBJ_Angle_Mid_18 : 14671|14@1+ (0.0002,-1.571) [-1.571|1.571] "rad" MCU
 SG_ Reserved_18_18 : 14685|3@1+ (1,0) [0|0] "NA" MCU
 SG_ OBJ_Angle_Mid_STD_18 : 14688|13@1+ (0.0002,0) [0|1.571] "rad" MCU
 SG_ OBJ_Angle_Mid_STD_V_18 : 14701|1@1+ (1,0) [0|1] "bool" MCU
 SG_ OBJ_Angle_Bottom_V_18 : 14702|1@1+ (1,0) [0|1] "bool" MCU
 SG_ OBJ_Angle_Bottom_18 : 14703|14@1+ (0.0002,-1.571) [-1.571|1.571] "rad" MCU
 SG_ Reserved_19_18 : 14717|3@1+ (1,0) [0|0] "NA" MCU
 SG_ OBJ_Angle_Bottom_STD_18 : 14720|13@1+ (0.0002,0) [0|1.571] "rad" MCU
 SG_ OBJ_Angle_Bottom_STD_V_18 : 14733|1@1+ (1,0) [0|1] "bool" MCU
 SG_ OBJ_Visibility_Side_V_18 : 14734|1@1+ (1,0) [0|1] "Bool" MCU
 SG_ OBJ_Visibility_Side_18 : 14735|2@1+ (1,0) [0|2] "ENUM" MCU
 SG_ OBJ_Is_In_Drivable_Area_18 : 14737|1@1+ (1,0) [0|1] "bool" MCU
 SG_ OBJ_Is_In_Drivable_Area_V_18 : 14738|1@1+ (1,0) [0|1] "bool" MCU
 SG_ OBJ_Is_VeryClose_18 : 14739|1@1+ (1,0) [0|1] "bool" MCU
 SG_ OBJ_Is_VeryClose_V_18 : 14740|1@1+ (1,0) [0|1] "bool" MCU
 SG_ OBJ_Occlusion_RL_18 : 14741|2@1+ (1,0) [0|2] "ENUM" MCU
 SG_ OBJ_Occlusion_RR_18 : 14743|2@1+ (1,0) [0|2] "ENUM" MCU
 SG_ OBJ_Occlusion_FR_18 : 14745|2@1+ (1,0) [0|2] "ENUM" MCU
 SG_ OBJ_Occlusion_FL_18 : 14747|2@1+ (1,0) [0|2] "ENUM" MCU
 SG_ OBJ_Buffer_18 : 14749|3@1+ (1,0) [0|0] "NA" MCU
 SG_ OBJ_CRC_19 : 14752|32@1+ (1,0) [0|4294967295] "NA" MCU
 SG_ OBJ_ID_19 : 14784|8@1+ (1,0) [0|255] "counter" MCU
 SG_ OBJ_Existence_Probability_19 : 14792|8@1+ (0.01,0) [0|1] "NA" MCU
 SG_ OBJ_Fusion_Source_19 : 14800|16@1+ (1,0) [0|65535] "BITWIZE" MCU
 SG_ OBJ_Triggered_SDM_19 : 14816|2@1+ (1,0) [0|2] "ENUM " MCU
 SG_ OBJ_Motion_Category_19 : 14818|4@1+ (1,0) [0|13] "ENUM " MCU
 SG_ OBJ_Buffer_C0_19 : 14822|7@1+ (1,0) [0|127] "NA" MCU
 SG_ OBJ_Object_Age_19 : 14829|11@1+ (1,0) [0|2047] "Frames" MCU
 SG_ OBJ_Measuring_Status_19 : 14840|3@1+ (1,0) [0|7] "BITWIZE" MCU
 SG_ OBJ_Object_Class_19 : 14843|4@1+ (1,0) [0|8] "ENUM" MCU
 SG_ Reserved_3_19 : 14847|1@1+ (1,0) [0|0] "NA" MCU
 SG_ OBJ_Class_Probability_19 : 14848|7@1+ (0.01,0) [0|1] "NA" MCU
 SG_ OBJ_Buffer_C1_19 : 14855|7@1+ (1,0) [0|127] "NA" MCU
 SG_ OBJ_Buffer_C2_19 : 14862|7@1+ (1,0) [0|127] "NA" MCU
 SG_ OBJ_Buffer_C3_19 : 14869|7@1+ (1,0) [0|127] "NA" MCU
 SG_ OBJ_Camera_Source_19 : 14876|4@1+ (1,0) [0|15] "ENUM" MCU
 SG_ OBJ_Motion_Status_19 : 14880|3@1+ (1,0) [0|5] "ENUM " MCU
 SG_ OBJ_Motion_Orientation_19 : 14883|4@1+ (1,0) [0|13] "ENUM " MCU
 SG_ OBJ_Has_Cut_Lane_19 : 14887|1@1+ (1,0) [0|1] "bool" MCU
 SG_ OBJ_Has_Cut_Path_19 : 14888|1@1+ (1,0) [0|1] "bool" MCU
 SG_ OBJ_Brake_Light_19 : 14889|1@1+ (1,0) [0|1] "bool" MCU
 SG_ OBJ_Turn_Indicator_Right_19 : 14890|1@1+ (1,0) [0|1] "bool" MCU
 SG_ OBJ_Turn_Indicator_Left_19 : 14891|1@1+ (1,0) [0|1] "bool" MCU
 SG_ OBJ_Light_Indicator_Validity_19 : 14892|1@1+ (1,0) [0|1] "bool" MCU
 SG_ OBJ_Right_Out_Of_Image_19 : 14893|1@1+ (1,0) [0|1] "bool" MCU
 SG_ OBJ_Left_Out_Of_Image_19 : 14894|1@1+ (1,0) [0|1] "bool" MCU
 SG_ OBJ_Right_Out_Of_Image_V_19 : 14895|1@1+ (1,0) [0|1] "bool" MCU
 SG_ OBJ_Left_Out_Of_Image_V_19 : 14896|1@1+ (1,0) [0|1] "bool" MCU
 SG_ OBJ_Top_Out_Of_Image_19 : 14897|1@1+ (1,0) [0|1] "bool" MCU
 SG_ OBJ_Bottom_Out_Of_Image_19 : 14898|1@1+ (1,0) [0|1] "bool" MCU
 SG_ OBJ_Top_Out_Of_Image_V_19 : 14899|1@1+ (1,0) [0|1] "bool" MCU
 SG_ OBJ_Bottom_Out_Of_Image_V_19 : 14900|1@1+ (1,0) [0|1] "bool" MCU
 SG_ OBJ_Lane_Assignment_19 : 14901|3@1+ (1,0) [0|5] "ENUM" MCU
 SG_ OBJ_Lane_Assignment_V_19 : 14904|1@1+ (1,0) [0|1] "bool" MCU
 SG_ OBJ_Age_Seconds_19 : 14905|7@1+ (1,0) [0|100] "s" MCU
 SG_ OBJ_Age_Seconds_V_19 : 14912|1@1+ (1,0) [0|1] "bool" MCU
 SG_ OBJ_Width_19 : 14913|9@1+ (0.01,0) [0.4|2.95] "m" MCU
 SG_ OBJ_Width_V_19 : 14922|1@1+ (1,0) [0|1] "bool" MCU
 SG_ OBJ_Width_STD_19 : 14923|8@1+ (0.01,0) [0|2] "m" MCU
 SG_ OBJ_Width_STD_V_19 : 14931|1@1+ (1,0) [0|1] "bool" MCU
 SG_ OBJ_Length_19 : 14932|9@1+ (0.05,0) [1.2|21] "m" MCU
 SG_ OBJ_Length_V_19 : 14941|1@1+ (1,0) [0|1] "bool" MCU
 SG_ Reserved_4_19 : 14942|2@1+ (1,0) [0|0] "NA" MCU
 SG_ OBJ_Length_STD_19 : 14944|8@1+ (0.05,0) [0|10] "m" MCU
 SG_ OBJ_Length_STD_V_19 : 14952|1@1+ (1,0) [0|1] "bool" MCU
 SG_ OBJ_Height_19 : 14953|9@1+ (0.01,0) [0|2.95] "m" MCU
 SG_ OBJ_Height_V_19 : 14962|1@1+ (1,0) [0|1] "bool" MCU
 SG_ OBJ_Height_STD_19 : 14963|8@1+ (0.01,0) [0|2] "m" MCU
 SG_ OBJ_Height_STD_V_19 : 14971|1@1+ (1,0) [0|1] "bool" MCU
 SG_ Reserved_5_19 : 14972|4@1+ (1,0) [0|0] "NA" MCU
 SG_ OBJ_Abs_Long_Velocity_19 : 14976|12@1+ (0.05,-30) [-30|100] "MPS" MCU
 SG_ OBJ_Abs_Long_Velocity_V_19 : 14988|1@1+ (1,0) [0|1] "bool" MCU
 SG_ OBJ_Abs_Long_Velocity_STD_19 : 14989|11@1+ (0.05,0) [0|65] "MPS" MCU
 SG_ OBJ_Abs_Long_Vel_STD_V_19 : 15000|1@1+ (1,0) [0|1] "bool" MCU
 SG_ Reserved_6_19 : 15001|7@1+ (1,0) [0|0] "NA" MCU
 SG_ OBJ_Abs_Lat_Velocity_19 : 15008|11@1+ (0.05,-50) [-50|50] "MPS" MCU
 SG_ OBJ_Abs_Lat_Velocity_V_19 : 15019|1@1+ (1,0) [0|1] "bool" MCU
 SG_ OBJ_Abs_Lat_Velocity_STD_19 : 15020|10@1+ (0.05,0) [0|50] "MPS" MCU
 SG_ OBJ_Abs_Lat_Vel_STD_V_19 : 15030|1@1+ (1,0) [0|1] "bool" MCU
 SG_ OBJ_Abs_Long_Acc_19 : 15031|9@1+ (0.05,-10.3) [-10.3|7.3] "MPS2" MCU
 SG_ OBJ_Abs_Long_Acc_V_19 : 15040|1@1+ (1,0) [0|1] "bool" MCU
 SG_ OBJ_Abs_Long_Acc_STD_19 : 15041|8@1+ (0.05,0) [0|7.3] "MPS2" MCU
 SG_ OBJ_Abs_Long_Acc_STD_V_19 : 15049|1@1+ (1,0) [0|1] "bool" MCU
 SG_ OBJ_Abs_Lat_Acc_19 : 15050|9@1+ (0.05,-10.3) [-10.3|7.3] "MPS2" MCU
 SG_ OBJ_Abs_Lat_Acc_V_19 : 15059|1@1+ (1,0) [0|1] "bool" MCU
 SG_ OBJ_Abs_Lat_Acc_STD_19 : 15060|8@1+ (0.05,0) [0|7.3] "MPS2" MCU
 SG_ OBJ_Abs_Lat_Acc_STD_V_19 : 15068|1@1+ (1,0) [0|1] "bool" MCU
 SG_ Reserved_7_19 : 15069|3@1+ (1,0) [0|0] "NA" MCU
 SG_ OBJ_Abs_Acceleration_19 : 15072|9@1+ (0.05,-10.3) [-10.3|7.3] "MPS2" MCU
 SG_ OBJ_Abs_Acceleration_V_19 : 15081|1@1+ (1,0) [0|1] "bool" MCU
 SG_ OBJ_Abs_Acc_STD_19 : 15082|8@1+ (0.05,0) [0|7.3] "MPS2" MCU
 SG_ OBJ_Abs_Acc_STD_V_19 : 15090|1@1+ (1,0) [0|1] "bool" MCU
 SG_ OBJ_Inv_TTC_19 : 15091|11@1+ (0.01,-8) [-8|8] "INV(s)" MCU
 SG_ OBJ_Inv_TTC_V_19 : 15102|1@1+ (1,0) [0|1] "bool" MCU
 SG_ Reserved_8_19 : 15103|1@1+ (1,0) [0|0] "NA" MCU
 SG_ OBJ_Inv_TTC_STD_19 : 15104|11@1+ (0.01,0) [0|4] "INV(s)" MCU
 SG_ OBJ_Inv_TTC_STD_V_19 : 15115|1@1+ (1,0) [0|1] "bool" MCU
 SG_ OBJ_Relative_Long_Acc_19 : 15116|9@1+ (0.05,-10.3) [-10.3|7.3] "MPS2" MCU
 SG_ OBJ_Relative_Long_Acc_V_19 : 15125|1@1+ (1,0) [0|1] "bool" MCU
 SG_ OBJ_Relative_Long_Acc_STD_19 : 15126|8@1+ (0.05,0) [0|7.3] "MPS2" MCU
 SG_ OBJ_Rel_Long_Acc_STD_V_19 : 15134|1@1+ (1,0) [0|1] "bool" MCU
 SG_ Reserved_9_19 : 15135|1@1+ (1,0) [0|0] "NA" MCU
 SG_ OBJ_Relative_Long_Velocity_19 : 15136|13@1+ (0.05,-120) [-120|130] "MPS" MCU
 SG_ OBJ_Relative_Long_Velocity_V_19 : 15149|1@1+ (1,0) [0|1] "bool" MCU
 SG_ OBJ_Relative_Long_Vel_STD_19 : 15150|12@1+ (0.05,0) [0|130] "MPS" MCU
 SG_ OBJ_Rel_Long_Vel_STD_V_19 : 15162|1@1+ (1,0) [0|1] "bool" MCU
 SG_ Reserved_10_19 : 15163|5@1+ (1,0) [0|0] "NA" MCU
 SG_ OBJ_Relative_Lat_Velocity_19 : 15168|11@1+ (0.05,-50) [-50|50] "MPS" MCU
 SG_ OBJ_Relative_Lat_Velocity_V_19 : 15179|1@1+ (1,0) [0|1] "bool" MCU
 SG_ OBJ_Relative_Lat_Velocity_STD_19 : 15180|10@1+ (0.05,0) [0|50] "MPS" MCU
 SG_ OBJ_Rel_Lat_Vel_STD_V_19 : 15190|1@1+ (1,0) [0|1] "bool" MCU
 SG_ Reserved_11_19 : 15191|9@1+ (1,0) [0|0] "NA" MCU
 SG_ OBJ_Long_Distance_19 : 15200|14@1+ (0.05,-200) [-200|250] "m" MCU
 SG_ OBJ_Long_Distance_V_19 : 15214|1@1+ (1,0) [0|1] "bool" MCU
 SG_ OBJ_Long_Distance_STD_19 : 15215|13@1+ (0.05,0) [0|250] "m" MCU
 SG_ OBJ_Long_Distance_STD_V_19 : 15228|1@1+ (1,0) [0|1] "bool" MCU
 SG_ Reserved_12_19 : 15229|3@1+ (1,0) [0|0] "NA" MCU
 SG_ OBJ_Lat_Distance_19 : 15232|12@1+ (0.05,-100) [-100|100] "m" MCU
 SG_ OBJ_Lat_Distance_V_19 : 15244|1@1+ (1,0) [0|1] "bool" MCU
 SG_ OBJ_Lat_Distance_STD_19 : 15245|11@1+ (0.05,0) [0|100] "m" MCU
 SG_ OBJ_Lat_Distance_STD_V_19 : 15256|1@1+ (1,0) [0|1] "bool" MCU
 SG_ Reserved_13_19 : 15257|7@1+ (1,0) [0|0] "NA" MCU
 SG_ OBJ_Absolute_Speed_19 : 15264|12@1+ (0.05,-65) [-65|65] "MPS" MCU
 SG_ OBJ_Absolute_Speed_V_19 : 15276|1@1+ (1,0) [0|1] "bool" MCU
 SG_ OBJ_Absolute_Speed_STD_19 : 15277|11@1+ (0.05,0) [0|65] "MPS" MCU
 SG_ OBJ_Absolute_Speed_STD_V_19 : 15288|1@1+ (1,0) [0|1] "bool" MCU
 SG_ Reserved_14_19 : 15289|7@1+ (1,0) [0|0] "NA" MCU
 SG_ OBJ_Heading_19 : 15296|10@1+ (0.01,-3.14) [-3.14|3.14] "rad" MCU
 SG_ OBJ_Heading_V_19 : 15306|1@1+ (1,0) [0|1] "bool" MCU
 SG_ OBJ_Heading_STD_19 : 15307|9@1+ (0.01,0) [0|3.14] "rad" MCU
 SG_ OBJ_Heading_STD_V_19 : 15316|1@1+ (1,0) [0|1] "bool" MCU
 SG_ OBJ_Angle_Rate_STD_19 : 15317|11@1+ (0.002,0) [0|2.2318] "RPS" MCU
 SG_ OBJ_Angle_Rate_STD_V_19 : 15328|1@1+ (1,0) [0|1] "bool" MCU
 SG_ OBJ_Angle_Rate_19 : 15329|12@1+ (0.002,-2.234) [-2.234|2.2318] "RPS" MCU
 SG_ OBJ_Angle_Rate_V_19 : 15341|1@1+ (1,0) [0|1] "bool" MCU
 SG_ OBJ_Angle_Right_19 : 15342|14@1+ (0.0002,-1.571) [-1.571|1.571] "rad " MCU
 SG_ OBJ_Angle_Right_V_19 : 15356|1@1+ (1,0) [0|1] "bool" MCU
 SG_ Reserved_15_19 : 15357|3@1+ (1,0) [0|0] "NA" MCU
 SG_ OBJ_Angle_Right_STD_19 : 15360|13@1+ (0.0002,0) [0|1.571] "rad " MCU
 SG_ OBJ_Angle_Right_STD_V_19 : 15373|1@1+ (1,0) [0|1] "bool" MCU
 SG_ OBJ_Angle_Left_19 : 15374|14@1+ (0.0002,-1.571) [-1.571|1.571] "rad " MCU
 SG_ OBJ_Angle_Left_V_19 : 15388|1@1+ (1,0) [0|1] "bool" MCU
 SG_ Reserved_16_19 : 15389|3@1+ (1,0) [0|0] "NA" MCU
 SG_ OBJ_Angle_Left_STD_19 : 15392|13@1+ (0.0002,0) [0|1.571] "rad" MCU
 SG_ OBJ_Angle_Left_STD_V_19 : 15405|1@1+ (1,0) [0|1] "bool" MCU
 SG_ OBJ_Angle_Side_19 : 15406|14@1+ (0.0002,-1.571) [-1.571|1.571] "rad" MCU
 SG_ OBJ_Angle_Side_V_19 : 15420|1@1+ (1,0) [0|1] "bool" MCU
 SG_ Reserved_17_19 : 15421|3@1+ (1,0) [0|0] "NA" MCU
 SG_ OBJ_Angle_Side_STD_19 : 15424|13@1+ (0.0002,0) [0|1.571] "rad" MCU
 SG_ OBJ_Angle_Side_STD_V_19 : 15437|1@1+ (1,0) [0|1] "bool" MCU
 SG_ OBJ_Angle_Mid_V_19 : 15438|1@1+ (1,0) [0|1] "bool" MCU
 SG_ OBJ_Angle_Mid_19 : 15439|14@1+ (0.0002,-1.571) [-1.571|1.571] "rad" MCU
 SG_ Reserved_18_19 : 15453|3@1+ (1,0) [0|0] "NA" MCU
 SG_ OBJ_Angle_Mid_STD_19 : 15456|13@1+ (0.0002,0) [0|1.571] "rad" MCU
 SG_ OBJ_Angle_Mid_STD_V_19 : 15469|1@1+ (1,0) [0|1] "bool" MCU
 SG_ OBJ_Angle_Bottom_V_19 : 15470|1@1+ (1,0) [0|1] "bool" MCU
 SG_ OBJ_Angle_Bottom_19 : 15471|14@1+ (0.0002,-1.571) [-1.571|1.571] "rad" MCU
 SG_ Reserved_19_19 : 15485|3@1+ (1,0) [0|0] "NA" MCU
 SG_ OBJ_Angle_Bottom_STD_19 : 15488|13@1+ (0.0002,0) [0|1.571] "rad" MCU
 SG_ OBJ_Angle_Bottom_STD_V_19 : 15501|1@1+ (1,0) [0|1] "bool" MCU
 SG_ OBJ_Visibility_Side_V_19 : 15502|1@1+ (1,0) [0|1] "Bool" MCU
 SG_ OBJ_Visibility_Side_19 : 15503|2@1+ (1,0) [0|2] "ENUM" MCU
 SG_ OBJ_Is_In_Drivable_Area_19 : 15505|1@1+ (1,0) [0|1] "bool" MCU
 SG_ OBJ_Is_In_Drivable_Area_V_19 : 15506|1@1+ (1,0) [0|1] "bool" MCU
 SG_ OBJ_Is_VeryClose_19 : 15507|1@1+ (1,0) [0|1] "bool" MCU
 SG_ OBJ_Is_VeryClose_V_19 : 15508|1@1+ (1,0) [0|1] "bool" MCU
 SG_ OBJ_Occlusion_RL_19 : 15509|2@1+ (1,0) [0|2] "ENUM" MCU
 SG_ OBJ_Occlusion_RR_19 : 15511|2@1+ (1,0) [0|2] "ENUM" MCU
 SG_ OBJ_Occlusion_FR_19 : 15513|2@1+ (1,0) [0|2] "ENUM" MCU
 SG_ OBJ_Occlusion_FL_19 : 15515|2@1+ (1,0) [0|2] "ENUM" MCU
 SG_ OBJ_Buffer_19 : 15517|3@1+ (1,0) [0|0] "NA" MCU

CM_ SG_ 154 OBJ_Abs_Lat_Acc_13 "The lateral ground acceleration of the object.";
CM_ SG_ 154 OBJ_Abs_Lat_Acc_V_13 "Validator for the lateral ground acceleration of the object.";
CM_ SG_ 154 OBJ_Abs_Lat_Acc_STD_13 "STD of the lateral ground acceleration of the object.";
CM_ SG_ 154 OBJ_Abs_Lat_Acc_STD_V_13 "Validator for the STD of the lateral ground acceleration of the object.";
CM_ SG_ 154 OBJ_Abs_Acceleration_13 "The absolute ground acceleration in the target's heading direction.";
CM_ SG_ 154 OBJ_Abs_Acceleration_V_13 "Validator for the absolute ground acceleration.";
CM_ SG_ 154 OBJ_Abs_Acc_STD_13 "STD of the absolute ground acceleration.";
CM_ SG_ 154 OBJ_Abs_Acc_STD_V_13 "Validator for the STD of the absolute ground acceleration.";
CM_ SG_ 154 OBJ_Inv_TTC_13 "Inverse TTC (time to collision).";
CM_ SG_ 154 OBJ_Inv_TTC_V_13 "Validator for Inverse TTC.";
CM_ SG_ 154 OBJ_Inv_TTC_STD_13 "STD for inverse TTC .";
CM_ SG_ 154 OBJ_Inv_TTC_STD_V_13 "Validator for the STD for inverse TTC .";
CM_ SG_ 154 OBJ_Relative_Long_Acc_13 "The relative lateral ground acceleration of the object.";
CM_ SG_ 154 OBJ_Relative_Long_Acc_V_13 "Validator for the relative lateral ground acceleration of the object.";
CM_ SG_ 154 OBJ_Relative_Long_Acc_STD_13 "STD of the relative lateral ground acceleration of the object.";
CM_ SG_ 154 OBJ_Rel_Long_Acc_STD_V_13 "Validator for the STD of the relative lateral ground acceleration.";
CM_ SG_ 154 OBJ_Relative_Long_Velocity_13 "The relative longtitudinal speed between the target and ego vehicle. ";
CM_ SG_ 154 OBJ_Relative_Long_Velocity_V_13 "Validator for the relative longtitudinal speed.";
CM_ SG_ 154 OBJ_Relative_Long_Vel_STD_13 "STD of the relative longtitudinal speed.";
CM_ SG_ 154 OBJ_Rel_Long_Vel_STD_V_13 "Validator for the STD of the relative longtitudinal speed.";
CM_ SG_ 154 OBJ_Relative_Lat_Velocity_13 "The relative lateral speed between the target and ego vehicle. ";
CM_ SG_ 154 OBJ_Relative_Lat_Velocity_V_13 "Validator for the relative lateral speed. ";
CM_ SG_ 154 OBJ_Relative_Lat_Velocity_STD_13 "STD of the relative lateral speed. ";
CM_ SG_ 154 OBJ_Rel_Lat_Vel_STD_V_13 "Validator for the STD of the relative lateral speed. ";
CM_ SG_ 154 OBJ_Long_Distance_13 "The longtitudinal distance from the object to the middle of the Rear-Left and Rear-Right corners of the host vehicle.  ";
CM_ SG_ 154 OBJ_Long_Distance_V_13 "Validator of the longtitudinal distance from the object to the middle of the rear-axle of the host.  ";
CM_ SG_ 154 OBJ_Long_Distance_STD_13 "STD of the  longtitudinal distance.";
CM_ SG_ 154 OBJ_Long_Distance_STD_V_13 "Validator for the STD of the  longtitudinal distance.";
CM_ SG_ 154 OBJ_Lat_Distance_13 "Lateral distance to the middle of the RL and RR corners.  ";
CM_ SG_ 154 OBJ_Lat_Distance_V_13 "Validator for the lateral distance of the object.";
CM_ SG_ 154 OBJ_Lat_Distance_STD_13 "STD of the lateral distance of the object.";
CM_ SG_ 154 OBJ_Lat_Distance_STD_V_13 "Validator for the STD of the lateral distance of the object.";
CM_ SG_ 154 OBJ_Absolute_Speed_13 "The absolute ground speed in the targets' heading direction.";
CM_ SG_ 154 OBJ_Absolute_Speed_V_13 "Validator for the absolute ground speed.";
CM_ SG_ 154 OBJ_Absolute_Speed_STD_13 "STD of the absolute ground speed.";
CM_ SG_ 154 OBJ_Absolute_Speed_STD_V_13 "Validator for the STD of the absolute ground speed.";
CM_ SG_ 154 OBJ_Heading_13 "The angle beetweenthe host longitudinal axis and target's heading (clockwise, e.g. PI/2 is a target crossing from left to right).";
CM_ SG_ 154 OBJ_Heading_V_13 "Validator for the object heading.";
CM_ SG_ 154 OBJ_Heading_STD_13 "STD of the object heading.";
CM_ SG_ 154 OBJ_Heading_STD_V_13 "Validator for the STD of the object heading.";
CM_ SG_ 154 OBJ_Angle_Rate_STD_13 "Standard deviation of the angular speed. (radians)";
CM_ SG_ 154 OBJ_Angle_Rate_STD_V_13 "Validator for the STD of the angular speed.";
CM_ SG_ 154 OBJ_Angle_Rate_13 "The momentary angular speed of the object. (radians)";
CM_ SG_ 154 OBJ_Angle_Rate_V_13 "Validator for the angular speed.";
CM_ SG_ 154 OBJ_Angle_Right_13 "The angle between the host longitudinal axis and the right side of the front / rear of the target (the visible one). The positive side is to the host's right.";
CM_ SG_ 154 OBJ_Angle_Right_V_13 "Validator for angleRight";
CM_ SG_ 154 OBJ_Angle_Right_STD_13 "Standard deviation of angleRight";
CM_ SG_ 154 OBJ_Angle_Right_STD_V_13 "Validator for the standard deviation of angleRight.";
CM_ SG_ 154 OBJ_Angle_Left_13 "The angle between the host longitudinal axis and the left side of the front / rear of the target (the visible one). The positive side is to the host's right.";
CM_ SG_ 154 OBJ_Angle_Left_V_13 "Validator for angleLeft.";
CM_ SG_ 154 OBJ_Angle_Left_STD_13 "Standard deviation of angleLeft.";
CM_ SG_ 154 OBJ_Angle_Left_STD_V_13 "Validator for the standard deviation of angleLeft.";
CM_ SG_ 154 OBJ_Angle_Side_13 "The angle between the host longitudinal axis and the far visible edge - the visible edge of the front / rear of the target that is not visible. Currently supported for vehicles only.";
CM_ SG_ 154 OBJ_Angle_Side_V_13 "Validator for angleSide.";
CM_ SG_ 154 OBJ_Angle_Side_STD_13 "Standard deviation of angleSide.";
CM_ SG_ 154 OBJ_Angle_Side_STD_V_13 "Validator for the STD of angleSide.";
CM_ SG_ 154 OBJ_Angle_Mid_V_13 "Validator for angleMid.";
CM_ SG_ 154 OBJ_Angle_Mid_13 "The angle between the host longitudinal axis and the middle of the front / rear of the target (the visible one). The positive side is to the host's right.";
CM_ SG_ 154 OBJ_Angle_Mid_STD_13 "Standard deviation of angleMid.";
CM_ SG_ 154 OBJ_Angle_Mid_STD_V_13 "Validator for the STD of angleMid.";
CM_ SG_ 154 OBJ_Angle_Bottom_V_13 "Validator for OBJAngle_Bottom. ";
CM_ SG_ 154 OBJ_Angle_Bottom_13 "The angle between the logitudinal axis and the Bottom of the front / rear of the target (the visible one). The positive side is to the hosts right";
CM_ SG_ 154 OBJ_Angle_Bottom_STD_13 "STD for OBJAngle_Bottom. ";
CM_ SG_ 154 OBJ_Angle_Bottom_STD_V_13 "Validator for OBJAngle_Bottom_STD. ";
CM_ SG_ 154 OBJ_Visibility_Side_V_13 "Currently Supported for VD only";
CM_ SG_ 154 OBJ_Visibility_Side_13 "From what car  side is the object visible";
CM_ SG_ 154 OBJ_Is_In_Drivable_Area_13 "Indicates whether the target is in a driveable area.";
CM_ SG_ 154 OBJ_Is_In_Drivable_Area_V_13 "Validator for OBJ_Is_In_Drivable_Area.";
CM_ SG_ 154 OBJ_Is_VeryClose_13 "Indicates whether the target is very close to the host such that it is hard to measure it's distance. Currently relevant for peds only. ";
CM_ SG_ 154 OBJ_Is_VeryClose_V_13 "Validator for OBJ_Is_VeryClose. ";
CM_ SG_ 154 OBJ_Occlusion_RL_13 "Was Rear left of the 3D detection of theobject occluded";
CM_ SG_ 154 OBJ_Occlusion_RR_13 "Was Rear Right of the 3D detection of theobject occluded";
CM_ SG_ 154 OBJ_Occlusion_FR_13 "Was front Right of the 3D detection of theobject occluded";
CM_ SG_ 154 OBJ_Occlusion_FL_13 "Was Front left of the 3D detection of theobject occluded";
CM_ SG_ 154 OBJ_CRC_14 "Calculated over each object signal";
CM_ SG_ 154 OBJ_ID_14 "The detected object ID. Range is 1-255, while 0 indicates that the field in unfilled.";
CM_ SG_ 154 OBJ_Existence_Probability_14 "The existence probability of the vehicle";
CM_ SG_ 154 OBJ_Fusion_Source_14 "sources ids used for fusion";
CM_ SG_ 154 OBJ_Triggered_SDM_14 "Indicates whether the object has trigered the SDM (Safety Diagnostic Manager) alert.";
CM_ SG_ 154 OBJ_Motion_Category_14 "Relevant for VD only. Full description of values can be found at the ACC guide.";
CM_ SG_ 154 OBJ_Object_Age_14 "The number of frames in which the object was recognized.";
CM_ SG_ 154 OBJ_Measuring_Status_14 "Measurment status. Old vs New marks if this is the first frame in which the object is reported. Predicted vs Measured marks if the report is raw or has been predicted forward in time using the measured dynamics and ego motion.";
CM_ SG_ 154 OBJ_Object_Class_14 "Indicates the object type. Uncertain is outputted in case the probability that a vehicle is a truck is very similar to the probability that it is a car. ";
CM_ SG_ 154 OBJ_Class_Probability_14 "The probability of this type classification.";
CM_ SG_ 154 OBJ_Camera_Source_14 "The camera in which this object was detected (best choice).";
CM_ SG_ 154 OBJ_Motion_Status_14 "MOVING - the object is moving STATIONARY - the object was never seen moving STOPPED -  the object was moving and has stopped MOVING_SLOWLY - the object is moving very slowly";
CM_ SG_ 154 OBJ_Motion_Orientation_14 "The direction of the target's heading compared to the host. ";
CM_ SG_ 154 OBJ_Has_Cut_Lane_14 "Indicates whether the object cut the host's (right or left) lane. In case there are no lanes, indicates whether the objects is at most 1 meters away from the host.";
CM_ SG_ 154 OBJ_Has_Cut_Path_14 "Indicates whether the object is in the host's path.";
CM_ SG_ 154 OBJ_Brake_Light_14 "Indication for brake lights ";
CM_ SG_ 154 OBJ_Turn_Indicator_Right_14 "Indication for blinking right light.";
CM_ SG_ 154 OBJ_Turn_Indicator_Left_14 "Indication for blinking left light ";
CM_ SG_ 154 OBJ_Light_Indicator_Validity_14 "Validator for light indicators";
CM_ SG_ 154 OBJ_Right_Out_Of_Image_14 "Indicates whether the measurment are predicted out of the right side of the image bounderies.";
CM_ SG_ 154 OBJ_Left_Out_Of_Image_14 "Indicates whether if measurment are predicted out of  the left side of the image bounderies";
CM_ SG_ 154 OBJ_Right_Out_Of_Image_V_14 "validator";
CM_ SG_ 154 OBJ_Left_Out_Of_Image_V_14 "validator";
CM_ SG_ 154 OBJ_Top_Out_Of_Image_14 "Indicates whether if measurment are predicted out of  the top of the image bounderies";
CM_ SG_ 154 OBJ_Bottom_Out_Of_Image_14 "validator";
CM_ SG_ 154 OBJ_Top_Out_Of_Image_V_14 "Indicates whether if measurment are predicted out of  the bottom of the image bounderies";
CM_ SG_ 154 OBJ_Bottom_Out_Of_Image_V_14 "validator";
CM_ SG_ 154 OBJ_Lane_Assignment_14 "The object's lane relative to the host lane.";
CM_ SG_ 154 OBJ_Lane_Assignment_V_14 "Validator for lane assignment";
CM_ SG_ 154 OBJ_Age_Seconds_14 "Time in seconds in which the object was recognized. Currently available for peds only. ";
CM_ SG_ 154 OBJ_Age_Seconds_V_14 "Validator for object age";
CM_ SG_ 154 OBJ_Width_14 "The width of the target vehicle in the world (not to be mistaken with the width of the visible part of the vehicle).";
CM_ SG_ 154 OBJ_Width_V_14 "Validator for object width";
CM_ SG_ 154 OBJ_Width_STD_14 "Standard deviation for object width";
CM_ SG_ 154 OBJ_Width_STD_V_14 "Validator for the standard deviation of object width";
CM_ SG_ 154 OBJ_Length_14 "The length of the vehicle in the world. For crossing bicycles it gives the viewed length of the bicycle.";
CM_ SG_ 154 OBJ_Length_V_14 "Validator for object length.";
CM_ SG_ 154 OBJ_Length_STD_14 "Standard deviation for object length.";
CM_ SG_ 154 OBJ_Length_STD_V_14 "Validator for the standard deviation of object length.";
CM_ SG_ 154 OBJ_Height_14 "The height of the object in the world. ";
CM_ SG_ 154 OBJ_Height_V_14 "Validator for object height.";
CM_ SG_ 154 OBJ_Height_STD_14 "Standard deviation for object height.";
CM_ SG_ 154 OBJ_Height_STD_V_14 "Validator for the standard deviation of object height.";
CM_ SG_ 154 OBJ_Abs_Long_Velocity_14 "Absolute longitudinal velocity.";
CM_ SG_ 154 OBJ_Abs_Long_Velocity_V_14 "Validator for absolute longitudinal velocity.";
CM_ SG_ 154 OBJ_Abs_Long_Velocity_STD_14 "Standard deviation of absolute longitudinal velocity.";
CM_ SG_ 154 OBJ_Abs_Long_Vel_STD_V_14 "Validator for the standard deviation of the absolute longitudinal velocity.";
CM_ SG_ 154 OBJ_Abs_Lat_Velocity_14 "The lateral ground speed of the object.";
CM_ SG_ 154 OBJ_Abs_Lat_Velocity_V_14 "Validator for the lateral ground speed of the object.";
CM_ SG_ 154 OBJ_Abs_Lat_Velocity_STD_14 "STD of the lateral ground speed of the object.";
CM_ SG_ 154 OBJ_Abs_Lat_Vel_STD_V_14 "Validator for the STD of the lateral ground speed of the object.";
CM_ SG_ 154 OBJ_Abs_Long_Acc_14 "The longitudinal ground acceleration of the object.";
CM_ SG_ 154 OBJ_Abs_Long_Acc_V_14 "Validator for the longitudinal ground acceleration of the object.";
CM_ SG_ 154 OBJ_Abs_Long_Acc_STD_14 "STD of the longitudinal ground acceleration of the object.";
CM_ SG_ 154 OBJ_Abs_Long_Acc_STD_V_14 "Validator for the STD of the longitudinal ground acceleration of the object.";
CM_ SG_ 154 OBJ_Abs_Lat_Acc_14 "The lateral ground acceleration of the object.";
CM_ SG_ 154 OBJ_Abs_Lat_Acc_V_14 "Validator for the lateral ground acceleration of the object.";
CM_ SG_ 154 OBJ_Abs_Lat_Acc_STD_14 "STD of the lateral ground acceleration of the object.";
CM_ SG_ 154 OBJ_Abs_Lat_Acc_STD_V_14 "Validator for the STD of the lateral ground acceleration of the object.";
CM_ SG_ 154 OBJ_Abs_Acceleration_14 "The absolute ground acceleration in the target's heading direction.";
CM_ SG_ 154 OBJ_Abs_Acceleration_V_14 "Validator for the absolute ground acceleration.";
CM_ SG_ 154 OBJ_Abs_Acc_STD_14 "STD of the absolute ground acceleration.";
CM_ SG_ 154 OBJ_Abs_Acc_STD_V_14 "Validator for the STD of the absolute ground acceleration.";
CM_ SG_ 154 OBJ_Inv_TTC_14 "Inverse TTC (time to collision).";
CM_ SG_ 154 OBJ_Inv_TTC_V_14 "Validator for Inverse TTC.";
CM_ SG_ 154 OBJ_Inv_TTC_STD_14 "STD for inverse TTC .";
CM_ SG_ 154 OBJ_Inv_TTC_STD_V_14 "Validator for the STD for inverse TTC .";
CM_ SG_ 154 OBJ_Relative_Long_Acc_14 "The relative lateral ground acceleration of the object.";
CM_ SG_ 154 OBJ_Relative_Long_Acc_V_14 "Validator for the relative lateral ground acceleration of the object.";
CM_ SG_ 154 OBJ_Relative_Long_Acc_STD_14 "STD of the relative lateral ground acceleration of the object.";
CM_ SG_ 154 OBJ_Rel_Long_Acc_STD_V_14 "Validator for the STD of the relative lateral ground acceleration.";
CM_ SG_ 154 OBJ_Relative_Long_Velocity_14 "The relative longtitudinal speed between the target and ego vehicle. ";
CM_ SG_ 154 OBJ_Relative_Long_Velocity_V_14 "Validator for the relative longtitudinal speed.";
CM_ SG_ 154 OBJ_Relative_Long_Vel_STD_14 "STD of the relative longtitudinal speed.";
CM_ SG_ 154 OBJ_Rel_Long_Vel_STD_V_14 "Validator for the STD of the relative longtitudinal speed.";
CM_ SG_ 154 OBJ_Relative_Lat_Velocity_14 "The relative lateral speed between the target and ego vehicle. ";
CM_ SG_ 154 OBJ_Relative_Lat_Velocity_V_14 "Validator for the relative lateral speed. ";
CM_ SG_ 154 OBJ_Relative_Lat_Velocity_STD_14 "STD of the relative lateral speed. ";
CM_ SG_ 154 OBJ_Rel_Lat_Vel_STD_V_14 "Validator for the STD of the relative lateral speed. ";
CM_ SG_ 154 OBJ_Long_Distance_14 "The longtitudinal distance from the object to the middle of the Rear-Left and Rear-Right corners of the host vehicle.  ";
CM_ SG_ 154 OBJ_Long_Distance_V_14 "Validator of the longtitudinal distance from the object to the middle of the rear-axle of the host.  ";
CM_ SG_ 154 OBJ_Long_Distance_STD_14 "STD of the  longtitudinal distance.";
CM_ SG_ 154 OBJ_Long_Distance_STD_V_14 "Validator for the STD of the  longtitudinal distance.";
CM_ SG_ 154 OBJ_Lat_Distance_14 "Lateral distance to the middle of the RL and RR corners.  ";
CM_ SG_ 154 OBJ_Lat_Distance_V_14 "Validator for the lateral distance of the object.";
CM_ SG_ 154 OBJ_Lat_Distance_STD_14 "STD of the lateral distance of the object.";
CM_ SG_ 154 OBJ_Lat_Distance_STD_V_14 "Validator for the STD of the lateral distance of the object.";
CM_ SG_ 154 OBJ_Absolute_Speed_14 "The absolute ground speed in the targets' heading direction.";
CM_ SG_ 154 OBJ_Absolute_Speed_V_14 "Validator for the absolute ground speed.";
CM_ SG_ 154 OBJ_Absolute_Speed_STD_14 "STD of the absolute ground speed.";
CM_ SG_ 154 OBJ_Absolute_Speed_STD_V_14 "Validator for the STD of the absolute ground speed.";
CM_ SG_ 154 OBJ_Heading_14 "The angle beetweenthe host longitudinal axis and target's heading (clockwise, e.g. PI/2 is a target crossing from left to right).";
CM_ SG_ 154 OBJ_Heading_V_14 "Validator for the object heading.";
CM_ SG_ 154 OBJ_Heading_STD_14 "STD of the object heading.";
CM_ SG_ 154 OBJ_Heading_STD_V_14 "Validator for the STD of the object heading.";
CM_ SG_ 154 OBJ_Angle_Rate_STD_14 "Standard deviation of the angular speed. (radians)";
CM_ SG_ 154 OBJ_Angle_Rate_STD_V_14 "Validator for the STD of the angular speed.";
CM_ SG_ 154 OBJ_Angle_Rate_14 "The momentary angular speed of the object. (radians)";
CM_ SG_ 154 OBJ_Angle_Rate_V_14 "Validator for the angular speed.";
CM_ SG_ 154 OBJ_Angle_Right_14 "The angle between the host longitudinal axis and the right side of the front / rear of the target (the visible one). The positive side is to the host's right.";
CM_ SG_ 154 OBJ_Angle_Right_V_14 "Validator for angleRight";
CM_ SG_ 154 OBJ_Angle_Right_STD_14 "Standard deviation of angleRight";
CM_ SG_ 154 OBJ_Angle_Right_STD_V_14 "Validator for the standard deviation of angleRight.";
CM_ SG_ 154 OBJ_Angle_Left_14 "The angle between the host longitudinal axis and the left side of the front / rear of the target (the visible one). The positive side is to the host's right.";
CM_ SG_ 154 OBJ_Angle_Left_V_14 "Validator for angleLeft.";
CM_ SG_ 154 OBJ_Angle_Left_STD_14 "Standard deviation of angleLeft.";
CM_ SG_ 154 OBJ_Angle_Left_STD_V_14 "Validator for the standard deviation of angleLeft.";
CM_ SG_ 154 OBJ_Angle_Side_14 "The angle between the host longitudinal axis and the far visible edge - the visible edge of the front / rear of the target that is not visible. Currently supported for vehicles only.";
CM_ SG_ 154 OBJ_Angle_Side_V_14 "Validator for angleSide.";
CM_ SG_ 154 OBJ_Angle_Side_STD_14 "Standard deviation of angleSide.";
CM_ SG_ 154 OBJ_Angle_Side_STD_V_14 "Validator for the STD of angleSide.";
CM_ SG_ 154 OBJ_Angle_Mid_V_14 "Validator for angleMid.";
CM_ SG_ 154 OBJ_Angle_Mid_14 "The angle between the host longitudinal axis and the middle of the front / rear of the target (the visible one). The positive side is to the host's right.";
CM_ SG_ 154 OBJ_Angle_Mid_STD_14 "Standard deviation of angleMid.";
CM_ SG_ 154 OBJ_Angle_Mid_STD_V_14 "Validator for the STD of angleMid.";
CM_ SG_ 154 OBJ_Angle_Bottom_V_14 "Validator for OBJAngle_Bottom. ";
CM_ SG_ 154 OBJ_Angle_Bottom_14 "The angle between the logitudinal axis and the Bottom of the front / rear of the target (the visible one). The positive side is to the hosts right";
CM_ SG_ 154 OBJ_Angle_Bottom_STD_14 "STD for OBJAngle_Bottom. ";
CM_ SG_ 154 OBJ_Angle_Bottom_STD_V_14 "Validator for OBJAngle_Bottom_STD. ";
CM_ SG_ 154 OBJ_Visibility_Side_V_14 "Currently Supported for VD only";
CM_ SG_ 154 OBJ_Visibility_Side_14 "From what car  side is the object visible";
CM_ SG_ 154 OBJ_Is_In_Drivable_Area_14 "Indicates whether the target is in a driveable area.";
CM_ SG_ 154 OBJ_Is_In_Drivable_Area_V_14 "Validator for OBJ_Is_In_Drivable_Area.";
CM_ SG_ 154 OBJ_Is_VeryClose_14 "Indicates whether the target is very close to the host such that it is hard to measure it's distance. Currently relevant for peds only. ";
CM_ SG_ 154 OBJ_Is_VeryClose_V_14 "Validator for OBJ_Is_VeryClose. ";
CM_ SG_ 154 OBJ_Occlusion_RL_14 "Was Rear left of the 3D detection of theobject occluded";
CM_ SG_ 154 OBJ_Occlusion_RR_14 "Was Rear Right of the 3D detection of theobject occluded";
CM_ SG_ 154 OBJ_Occlusion_FR_14 "Was front Right of the 3D detection of theobject occluded";
CM_ SG_ 154 OBJ_Occlusion_FL_14 "Was Front left of the 3D detection of theobject occluded";
CM_ SG_ 154 OBJ_CRC_15 "Calculated over each object signal";
CM_ SG_ 154 OBJ_ID_15 "The detected object ID. Range is 1-255, while 0 indicates that the field in unfilled.";
CM_ SG_ 154 OBJ_Existence_Probability_15 "The existence probability of the vehicle";
CM_ SG_ 154 OBJ_Fusion_Source_15 "sources ids used for fusion";
CM_ SG_ 154 OBJ_Triggered_SDM_15 "Indicates whether the object has trigered the SDM (Safety Diagnostic Manager) alert.";
CM_ SG_ 154 OBJ_Motion_Category_15 "Relevant for VD only. Full description of values can be found at the ACC guide.";
CM_ SG_ 154 OBJ_Object_Age_15 "The number of frames in which the object was recognized.";
CM_ SG_ 154 OBJ_Measuring_Status_15 "Measurment status. Old vs New marks if this is the first frame in which the object is reported. Predicted vs Measured marks if the report is raw or has been predicted forward in time using the measured dynamics and ego motion.";
CM_ SG_ 154 OBJ_Object_Class_15 "Indicates the object type. Uncertain is outputted in case the probability that a vehicle is a truck is very similar to the probability that it is a car. ";
CM_ SG_ 154 OBJ_Class_Probability_15 "The probability of this type classification.";
CM_ SG_ 154 OBJ_Camera_Source_15 "The camera in which this object was detected (best choice).";
CM_ SG_ 154 OBJ_Motion_Status_15 "MOVING - the object is moving STATIONARY - the object was never seen moving STOPPED -  the object was moving and has stopped MOVING_SLOWLY - the object is moving very slowly";
CM_ SG_ 154 OBJ_Motion_Orientation_15 "The direction of the target's heading compared to the host. ";
CM_ SG_ 154 OBJ_Has_Cut_Lane_15 "Indicates whether the object cut the host's (right or left) lane. In case there are no lanes, indicates whether the objects is at most 1 meters away from the host.";
CM_ SG_ 154 OBJ_Has_Cut_Path_15 "Indicates whether the object is in the host's path.";
CM_ SG_ 154 OBJ_Brake_Light_15 "Indication for brake lights ";
CM_ SG_ 154 OBJ_Turn_Indicator_Right_15 "Indication for blinking right light.";
CM_ SG_ 154 OBJ_Turn_Indicator_Left_15 "Indication for blinking left light ";
CM_ SG_ 154 OBJ_Light_Indicator_Validity_15 "Validator for light indicators";
CM_ SG_ 154 OBJ_Right_Out_Of_Image_15 "Indicates whether the measurment are predicted out of the right side of the image bounderies.";
CM_ SG_ 154 OBJ_Left_Out_Of_Image_15 "Indicates whether if measurment are predicted out of  the left side of the image bounderies";
CM_ SG_ 154 OBJ_Right_Out_Of_Image_V_15 "validator";
CM_ SG_ 154 OBJ_Left_Out_Of_Image_V_15 "validator";
CM_ SG_ 154 OBJ_Top_Out_Of_Image_15 "Indicates whether if measurment are predicted out of  the top of the image bounderies";
CM_ SG_ 154 OBJ_Bottom_Out_Of_Image_15 "validator";
CM_ SG_ 154 OBJ_Top_Out_Of_Image_V_15 "Indicates whether if measurment are predicted out of  the bottom of the image bounderies";
CM_ SG_ 154 OBJ_Bottom_Out_Of_Image_V_15 "validator";
CM_ SG_ 154 OBJ_Lane_Assignment_15 "The object's lane relative to the host lane.";
CM_ SG_ 154 OBJ_Lane_Assignment_V_15 "Validator for lane assignment";
CM_ SG_ 154 OBJ_Age_Seconds_15 "Time in seconds in which the object was recognized. Currently available for peds only. ";
CM_ SG_ 154 OBJ_Age_Seconds_V_15 "Validator for object age";
CM_ SG_ 154 OBJ_Width_15 "The width of the target vehicle in the world (not to be mistaken with the width of the visible part of the vehicle).";
CM_ SG_ 154 OBJ_Width_V_15 "Validator for object width";
CM_ SG_ 154 OBJ_Width_STD_15 "Standard deviation for object width";
CM_ SG_ 154 OBJ_Width_STD_V_15 "Validator for the standard deviation of object width";
CM_ SG_ 154 OBJ_Length_15 "The length of the vehicle in the world. For crossing bicycles it gives the viewed length of the bicycle.";
CM_ SG_ 154 OBJ_Length_V_15 "Validator for object length.";
CM_ SG_ 154 OBJ_Length_STD_15 "Standard deviation for object length.";
CM_ SG_ 154 OBJ_Length_STD_V_15 "Validator for the standard deviation of object length.";
CM_ SG_ 154 OBJ_Height_15 "The height of the object in the world. ";
CM_ SG_ 154 OBJ_Height_V_15 "Validator for object height.";
CM_ SG_ 154 OBJ_Height_STD_15 "Standard deviation for object height.";
CM_ SG_ 154 OBJ_Height_STD_V_15 "Validator for the standard deviation of object height.";
CM_ SG_ 154 OBJ_Abs_Long_Velocity_15 "Absolute longitudinal velocity.";
CM_ SG_ 154 OBJ_Abs_Long_Velocity_V_15 "Validator for absolute longitudinal velocity.";
CM_ SG_ 154 OBJ_Abs_Long_Velocity_STD_15 "Standard deviation of absolute longitudinal velocity.";
CM_ SG_ 154 OBJ_Abs_Long_Vel_STD_V_15 "Validator for the standard deviation of the absolute longitudinal velocity.";
CM_ SG_ 154 OBJ_Abs_Lat_Velocity_15 "The lateral ground speed of the object.";
CM_ SG_ 154 OBJ_Abs_Lat_Velocity_V_15 "Validator for the lateral ground speed of the object.";
CM_ SG_ 154 OBJ_Abs_Lat_Velocity_STD_15 "STD of the lateral ground speed of the object.";
CM_ SG_ 154 OBJ_Abs_Lat_Vel_STD_V_15 "Validator for the STD of the lateral ground speed of the object.";
CM_ SG_ 154 OBJ_Abs_Long_Acc_15 "The longitudinal ground acceleration of the object.";
CM_ SG_ 154 OBJ_Abs_Long_Acc_V_15 "Validator for the longitudinal ground acceleration of the object.";
CM_ SG_ 154 OBJ_Abs_Long_Acc_STD_15 "STD of the longitudinal ground acceleration of the object.";
CM_ SG_ 154 OBJ_Abs_Long_Acc_STD_V_15 "Validator for the STD of the longitudinal ground acceleration of the object.";
CM_ SG_ 154 OBJ_Abs_Lat_Acc_15 "The lateral ground acceleration of the object.";
CM_ SG_ 154 OBJ_Abs_Lat_Acc_V_15 "Validator for the lateral ground acceleration of the object.";
CM_ SG_ 154 OBJ_Abs_Lat_Acc_STD_15 "STD of the lateral ground acceleration of the object.";
CM_ SG_ 154 OBJ_Abs_Lat_Acc_STD_V_15 "Validator for the STD of the lateral ground acceleration of the object.";
CM_ SG_ 154 OBJ_Abs_Acceleration_15 "The absolute ground acceleration in the target's heading direction.";
CM_ SG_ 154 OBJ_Abs_Acceleration_V_15 "Validator for the absolute ground acceleration.";
CM_ SG_ 154 OBJ_Abs_Acc_STD_15 "STD of the absolute ground acceleration.";
CM_ SG_ 154 OBJ_Abs_Acc_STD_V_15 "Validator for the STD of the absolute ground acceleration.";
CM_ SG_ 154 OBJ_Inv_TTC_15 "Inverse TTC (time to collision).";
CM_ SG_ 154 OBJ_Inv_TTC_V_15 "Validator for Inverse TTC.";
CM_ SG_ 154 OBJ_Inv_TTC_STD_15 "STD for inverse TTC .";
CM_ SG_ 154 OBJ_Inv_TTC_STD_V_15 "Validator for the STD for inverse TTC .";
CM_ SG_ 154 OBJ_Relative_Long_Acc_15 "The relative lateral ground acceleration of the object.";
CM_ SG_ 154 OBJ_Relative_Long_Acc_V_15 "Validator for the relative lateral ground acceleration of the object.";
CM_ SG_ 154 OBJ_Relative_Long_Acc_STD_15 "STD of the relative lateral ground acceleration of the object.";
CM_ SG_ 154 OBJ_Rel_Long_Acc_STD_V_15 "Validator for the STD of the relative lateral ground acceleration.";
CM_ SG_ 154 OBJ_Relative_Long_Velocity_15 "The relative longtitudinal speed between the target and ego vehicle. ";
CM_ SG_ 154 OBJ_Relative_Long_Velocity_V_15 "Validator for the relative longtitudinal speed.";
CM_ SG_ 154 OBJ_Relative_Long_Vel_STD_15 "STD of the relative longtitudinal speed.";
CM_ SG_ 154 OBJ_Rel_Long_Vel_STD_V_15 "Validator for the STD of the relative longtitudinal speed.";
CM_ SG_ 154 OBJ_Relative_Lat_Velocity_15 "The relative lateral speed between the target and ego vehicle. ";
CM_ SG_ 154 OBJ_Relative_Lat_Velocity_V_15 "Validator for the relative lateral speed. ";
CM_ SG_ 154 OBJ_Relative_Lat_Velocity_STD_15 "STD of the relative lateral speed. ";
CM_ SG_ 154 OBJ_Rel_Lat_Vel_STD_V_15 "Validator for the STD of the relative lateral speed. ";
CM_ SG_ 154 OBJ_Long_Distance_15 "The longtitudinal distance from the object to the middle of the Rear-Left and Rear-Right corners of the host vehicle.  ";
CM_ SG_ 154 OBJ_Long_Distance_V_15 "Validator of the longtitudinal distance from the object to the middle of the rear-axle of the host.  ";
CM_ SG_ 154 OBJ_Long_Distance_STD_15 "STD of the  longtitudinal distance.";
CM_ SG_ 154 OBJ_Long_Distance_STD_V_15 "Validator for the STD of the  longtitudinal distance.";
CM_ SG_ 154 OBJ_Lat_Distance_15 "Lateral distance to the middle of the RL and RR corners.  ";
CM_ SG_ 154 OBJ_Lat_Distance_V_15 "Validator for the lateral distance of the object.";
CM_ SG_ 154 OBJ_Lat_Distance_STD_15 "STD of the lateral distance of the object.";
CM_ SG_ 154 OBJ_Lat_Distance_STD_V_15 "Validator for the STD of the lateral distance of the object.";
CM_ SG_ 154 OBJ_Absolute_Speed_15 "The absolute ground speed in the targets' heading direction.";
CM_ SG_ 154 OBJ_Absolute_Speed_V_15 "Validator for the absolute ground speed.";
CM_ SG_ 154 OBJ_Absolute_Speed_STD_15 "STD of the absolute ground speed.";
CM_ SG_ 154 OBJ_Absolute_Speed_STD_V_15 "Validator for the STD of the absolute ground speed.";
CM_ SG_ 154 OBJ_Heading_15 "The angle beetweenthe host longitudinal axis and target's heading (clockwise, e.g. PI/2 is a target crossing from left to right).";
CM_ SG_ 154 OBJ_Heading_V_15 "Validator for the object heading.";
CM_ SG_ 154 OBJ_Heading_STD_15 "STD of the object heading.";
CM_ SG_ 154 OBJ_Heading_STD_V_15 "Validator for the STD of the object heading.";
CM_ SG_ 154 OBJ_Angle_Rate_STD_15 "Standard deviation of the angular speed. (radians)";
CM_ SG_ 154 OBJ_Angle_Rate_STD_V_15 "Validator for the STD of the angular speed.";
CM_ SG_ 154 OBJ_Angle_Rate_15 "The momentary angular speed of the object. (radians)";
CM_ SG_ 154 OBJ_Angle_Rate_V_15 "Validator for the angular speed.";
CM_ SG_ 154 OBJ_Angle_Right_15 "The angle between the host longitudinal axis and the right side of the front / rear of the target (the visible one). The positive side is to the host's right.";
CM_ SG_ 154 OBJ_Angle_Right_V_15 "Validator for angleRight";
CM_ SG_ 154 OBJ_Angle_Right_STD_15 "Standard deviation of angleRight";
CM_ SG_ 154 OBJ_Angle_Right_STD_V_15 "Validator for the standard deviation of angleRight.";
CM_ SG_ 154 OBJ_Angle_Left_15 "The angle between the host longitudinal axis and the left side of the front / rear of the target (the visible one). The positive side is to the host's right.";
CM_ SG_ 154 OBJ_Angle_Left_V_15 "Validator for angleLeft.";
CM_ SG_ 154 OBJ_Angle_Left_STD_15 "Standard deviation of angleLeft.";
CM_ SG_ 154 OBJ_Angle_Left_STD_V_15 "Validator for the standard deviation of angleLeft.";
CM_ SG_ 154 OBJ_Angle_Side_15 "The angle between the host longitudinal axis and the far visible edge - the visible edge of the front / rear of the target that is not visible. Currently supported for vehicles only.";
CM_ SG_ 154 OBJ_Angle_Side_V_15 "Validator for angleSide.";
CM_ SG_ 154 OBJ_Angle_Side_STD_15 "Standard deviation of angleSide.";
CM_ SG_ 154 OBJ_Angle_Side_STD_V_15 "Validator for the STD of angleSide.";
CM_ SG_ 154 OBJ_Angle_Mid_V_15 "Validator for angleMid.";
CM_ SG_ 154 OBJ_Angle_Mid_15 "The angle between the host longitudinal axis and the middle of the front / rear of the target (the visible one). The positive side is to the host's right.";
CM_ SG_ 154 OBJ_Angle_Mid_STD_15 "Standard deviation of angleMid.";
CM_ SG_ 154 OBJ_Angle_Mid_STD_V_15 "Validator for the STD of angleMid.";
CM_ SG_ 154 OBJ_Angle_Bottom_V_15 "Validator for OBJAngle_Bottom. ";
CM_ SG_ 154 OBJ_Angle_Bottom_15 "The angle between the logitudinal axis and the Bottom of the front / rear of the target (the visible one). The positive side is to the hosts right";
CM_ SG_ 154 OBJ_Angle_Bottom_STD_15 "STD for OBJAngle_Bottom. ";
CM_ SG_ 154 OBJ_Angle_Bottom_STD_V_15 "Validator for OBJAngle_Bottom_STD. ";
CM_ SG_ 154 OBJ_Visibility_Side_V_15 "Currently Supported for VD only";
CM_ SG_ 154 OBJ_Visibility_Side_15 "From what car  side is the object visible";
CM_ SG_ 154 OBJ_Is_In_Drivable_Area_15 "Indicates whether the target is in a driveable area.";
CM_ SG_ 154 OBJ_Is_In_Drivable_Area_V_15 "Validator for OBJ_Is_In_Drivable_Area.";
CM_ SG_ 154 OBJ_Is_VeryClose_15 "Indicates whether the target is very close to the host such that it is hard to measure it's distance. Currently relevant for peds only. ";
CM_ SG_ 154 OBJ_Is_VeryClose_V_15 "Validator for OBJ_Is_VeryClose. ";
CM_ SG_ 154 OBJ_Occlusion_RL_15 "Was Rear left of the 3D detection of theobject occluded";
CM_ SG_ 154 OBJ_Occlusion_RR_15 "Was Rear Right of the 3D detection of theobject occluded";
CM_ SG_ 154 OBJ_Occlusion_FR_15 "Was front Right of the 3D detection of theobject occluded";
CM_ SG_ 154 OBJ_Occlusion_FL_15 "Was Front left of the 3D detection of theobject occluded";
CM_ SG_ 154 OBJ_CRC_16 "Calculated over each object signal";
CM_ SG_ 154 OBJ_ID_16 "The detected object ID. Range is 1-255, while 0 indicates that the field in unfilled.";
CM_ SG_ 154 OBJ_Existence_Probability_16 "The existence probability of the vehicle";
CM_ SG_ 154 OBJ_Fusion_Source_16 "sources ids used for fusion";
CM_ SG_ 154 OBJ_Triggered_SDM_16 "Indicates whether the object has trigered the SDM (Safety Diagnostic Manager) alert.";
CM_ SG_ 154 OBJ_Motion_Category_16 "Relevant for VD only. Full description of values can be found at the ACC guide.";
CM_ SG_ 154 OBJ_Object_Age_16 "The number of frames in which the object was recognized.";
CM_ SG_ 154 OBJ_Measuring_Status_16 "Measurment status. Old vs New marks if this is the first frame in which the object is reported. Predicted vs Measured marks if the report is raw or has been predicted forward in time using the measured dynamics and ego motion.";
CM_ SG_ 154 OBJ_Object_Class_16 "Indicates the object type. Uncertain is outputted in case the probability that a vehicle is a truck is very similar to the probability that it is a car. ";
CM_ SG_ 154 OBJ_Class_Probability_16 "The probability of this type classification.";
CM_ SG_ 154 OBJ_Camera_Source_16 "The camera in which this object was detected (best choice).";
CM_ SG_ 154 OBJ_Motion_Status_16 "MOVING - the object is moving STATIONARY - the object was never seen moving STOPPED -  the object was moving and has stopped MOVING_SLOWLY - the object is moving very slowly";
CM_ SG_ 154 OBJ_Motion_Orientation_16 "The direction of the target's heading compared to the host. ";
CM_ SG_ 154 OBJ_Has_Cut_Lane_16 "Indicates whether the object cut the host's (right or left) lane. In case there are no lanes, indicates whether the objects is at most 1 meters away from the host.";
CM_ SG_ 154 OBJ_Has_Cut_Path_16 "Indicates whether the object is in the host's path.";
CM_ SG_ 154 OBJ_Brake_Light_16 "Indication for brake lights ";
CM_ SG_ 154 OBJ_Turn_Indicator_Right_16 "Indication for blinking right light.";
CM_ SG_ 154 OBJ_Turn_Indicator_Left_16 "Indication for blinking left light ";
CM_ SG_ 154 OBJ_Light_Indicator_Validity_16 "Validator for light indicators";
CM_ SG_ 154 OBJ_Right_Out_Of_Image_16 "Indicates whether the measurment are predicted out of the right side of the image bounderies.";
CM_ SG_ 154 OBJ_Left_Out_Of_Image_16 "Indicates whether if measurment are predicted out of  the left side of the image bounderies";
CM_ SG_ 154 OBJ_Right_Out_Of_Image_V_16 "validator";
CM_ SG_ 154 OBJ_Left_Out_Of_Image_V_16 "validator";
CM_ SG_ 154 OBJ_Top_Out_Of_Image_16 "Indicates whether if measurment are predicted out of  the top of the image bounderies";
CM_ SG_ 154 OBJ_Bottom_Out_Of_Image_16 "validator";
CM_ SG_ 154 OBJ_Top_Out_Of_Image_V_16 "Indicates whether if measurment are predicted out of  the bottom of the image bounderies";
CM_ SG_ 154 OBJ_Bottom_Out_Of_Image_V_16 "validator";
CM_ SG_ 154 OBJ_Lane_Assignment_16 "The object's lane relative to the host lane.";
CM_ SG_ 154 OBJ_Lane_Assignment_V_16 "Validator for lane assignment";
CM_ SG_ 154 OBJ_Age_Seconds_16 "Time in seconds in which the object was recognized. Currently available for peds only. ";
CM_ SG_ 154 OBJ_Age_Seconds_V_16 "Validator for object age";
CM_ SG_ 154 OBJ_Width_16 "The width of the target vehicle in the world (not to be mistaken with the width of the visible part of the vehicle).";
CM_ SG_ 154 OBJ_Width_V_16 "Validator for object width";
CM_ SG_ 154 OBJ_Width_STD_16 "Standard deviation for object width";
CM_ SG_ 154 OBJ_Width_STD_V_16 "Validator for the standard deviation of object width";
CM_ SG_ 154 OBJ_Length_16 "The length of the vehicle in the world. For crossing bicycles it gives the viewed length of the bicycle.";
CM_ SG_ 154 OBJ_Length_V_16 "Validator for object length.";
CM_ SG_ 154 OBJ_Length_STD_16 "Standard deviation for object length.";
CM_ SG_ 154 OBJ_Length_STD_V_16 "Validator for the standard deviation of object length.";
CM_ SG_ 154 OBJ_Height_16 "The height of the object in the world. ";
CM_ SG_ 154 OBJ_Height_V_16 "Validator for object height.";
CM_ SG_ 154 OBJ_Height_STD_16 "Standard deviation for object height.";
CM_ SG_ 154 OBJ_Height_STD_V_16 "Validator for the standard deviation of object height.";
CM_ SG_ 154 OBJ_Abs_Long_Velocity_16 "Absolute longitudinal velocity.";
CM_ SG_ 154 OBJ_Abs_Long_Velocity_V_16 "Validator for absolute longitudinal velocity.";
CM_ SG_ 154 OBJ_Abs_Long_Velocity_STD_16 "Standard deviation of absolute longitudinal velocity.";
CM_ SG_ 154 OBJ_Abs_Long_Vel_STD_V_16 "Validator for the standard deviation of the absolute longitudinal velocity.";
CM_ SG_ 154 OBJ_Abs_Lat_Velocity_16 "The lateral ground speed of the object.";
CM_ SG_ 154 OBJ_Abs_Lat_Velocity_V_16 "Validator for the lateral ground speed of the object.";
CM_ SG_ 154 OBJ_Abs_Lat_Velocity_STD_16 "STD of the lateral ground speed of the object.";
CM_ SG_ 154 OBJ_Abs_Lat_Vel_STD_V_16 "Validator for the STD of the lateral ground speed of the object.";
CM_ SG_ 154 OBJ_Abs_Long_Acc_16 "The longitudinal ground acceleration of the object.";
CM_ SG_ 154 OBJ_Abs_Long_Acc_V_16 "Validator for the longitudinal ground acceleration of the object.";
CM_ SG_ 154 OBJ_Abs_Long_Acc_STD_16 "STD of the longitudinal ground acceleration of the object.";
CM_ SG_ 154 OBJ_Abs_Long_Acc_STD_V_16 "Validator for the STD of the longitudinal ground acceleration of the object.";
CM_ SG_ 154 OBJ_Abs_Lat_Acc_16 "The lateral ground acceleration of the object.";
CM_ SG_ 154 OBJ_Abs_Lat_Acc_V_16 "Validator for the lateral ground acceleration of the object.";
CM_ SG_ 154 OBJ_Abs_Lat_Acc_STD_16 "STD of the lateral ground acceleration of the object.";
CM_ SG_ 154 OBJ_Abs_Lat_Acc_STD_V_16 "Validator for the STD of the lateral ground acceleration of the object.";
CM_ SG_ 154 OBJ_Abs_Acceleration_16 "The absolute ground acceleration in the target's heading direction.";
CM_ SG_ 154 OBJ_Abs_Acceleration_V_16 "Validator for the absolute ground acceleration.";
CM_ SG_ 154 OBJ_Abs_Acc_STD_16 "STD of the absolute ground acceleration.";
CM_ SG_ 154 OBJ_Abs_Acc_STD_V_16 "Validator for the STD of the absolute ground acceleration.";
CM_ SG_ 154 OBJ_Inv_TTC_16 "Inverse TTC (time to collision).";
CM_ SG_ 154 OBJ_Inv_TTC_V_16 "Validator for Inverse TTC.";
CM_ SG_ 154 OBJ_Inv_TTC_STD_16 "STD for inverse TTC .";
CM_ SG_ 154 OBJ_Inv_TTC_STD_V_16 "Validator for the STD for inverse TTC .";
CM_ SG_ 154 OBJ_Relative_Long_Acc_16 "The relative lateral ground acceleration of the object.";
CM_ SG_ 154 OBJ_Relative_Long_Acc_V_16 "Validator for the relative lateral ground acceleration of the object.";
CM_ SG_ 154 OBJ_Relative_Long_Acc_STD_16 "STD of the relative lateral ground acceleration of the object.";
CM_ SG_ 154 OBJ_Rel_Long_Acc_STD_V_16 "Validator for the STD of the relative lateral ground acceleration.";
CM_ SG_ 154 OBJ_Relative_Long_Velocity_16 "The relative longtitudinal speed between the target and ego vehicle. ";
CM_ SG_ 154 OBJ_Relative_Long_Velocity_V_16 "Validator for the relative longtitudinal speed.";
CM_ SG_ 154 OBJ_Relative_Long_Vel_STD_16 "STD of the relative longtitudinal speed.";
CM_ SG_ 154 OBJ_Rel_Long_Vel_STD_V_16 "Validator for the STD of the relative longtitudinal speed.";
CM_ SG_ 154 OBJ_Relative_Lat_Velocity_16 "The relative lateral speed between the target and ego vehicle. ";
CM_ SG_ 154 OBJ_Relative_Lat_Velocity_V_16 "Validator for the relative lateral speed. ";
CM_ SG_ 154 OBJ_Relative_Lat_Velocity_STD_16 "STD of the relative lateral speed. ";
CM_ SG_ 154 OBJ_Rel_Lat_Vel_STD_V_16 "Validator for the STD of the relative lateral speed. ";
CM_ SG_ 154 OBJ_Long_Distance_16 "The longtitudinal distance from the object to the middle of the Rear-Left and Rear-Right corners of the host vehicle.  ";
CM_ SG_ 154 OBJ_Long_Distance_V_16 "Validator of the longtitudinal distance from the object to the middle of the rear-axle of the host.  ";
CM_ SG_ 154 OBJ_Long_Distance_STD_16 "STD of the  longtitudinal distance.";
CM_ SG_ 154 OBJ_Long_Distance_STD_V_16 "Validator for the STD of the  longtitudinal distance.";
CM_ SG_ 154 OBJ_Lat_Distance_16 "Lateral distance to the middle of the RL and RR corners.  ";
CM_ SG_ 154 OBJ_Lat_Distance_V_16 "Validator for the lateral distance of the object.";
CM_ SG_ 154 OBJ_Lat_Distance_STD_16 "STD of the lateral distance of the object.";
CM_ SG_ 154 OBJ_Lat_Distance_STD_V_16 "Validator for the STD of the lateral distance of the object.";
CM_ SG_ 154 OBJ_Absolute_Speed_16 "The absolute ground speed in the targets' heading direction.";
CM_ SG_ 154 OBJ_Absolute_Speed_V_16 "Validator for the absolute ground speed.";
CM_ SG_ 154 OBJ_Absolute_Speed_STD_16 "STD of the absolute ground speed.";
CM_ SG_ 154 OBJ_Absolute_Speed_STD_V_16 "Validator for the STD of the absolute ground speed.";
CM_ SG_ 154 OBJ_Heading_16 "The angle beetweenthe host longitudinal axis and target's heading (clockwise, e.g. PI/2 is a target crossing from left to right).";
CM_ SG_ 154 OBJ_Heading_V_16 "Validator for the object heading.";
CM_ SG_ 154 OBJ_Heading_STD_16 "STD of the object heading.";
CM_ SG_ 154 OBJ_Heading_STD_V_16 "Validator for the STD of the object heading.";
CM_ SG_ 154 OBJ_Angle_Rate_STD_16 "Standard deviation of the angular speed. (radians)";
CM_ SG_ 154 OBJ_Angle_Rate_STD_V_16 "Validator for the STD of the angular speed.";
CM_ SG_ 154 OBJ_Angle_Rate_16 "The momentary angular speed of the object. (radians)";
CM_ SG_ 154 OBJ_Angle_Rate_V_16 "Validator for the angular speed.";
CM_ SG_ 154 OBJ_Angle_Right_16 "The angle between the host longitudinal axis and the right side of the front / rear of the target (the visible one). The positive side is to the host's right.";
CM_ SG_ 154 OBJ_Angle_Right_V_16 "Validator for angleRight";
CM_ SG_ 154 OBJ_Angle_Right_STD_16 "Standard deviation of angleRight";
CM_ SG_ 154 OBJ_Angle_Right_STD_V_16 "Validator for the standard deviation of angleRight.";
CM_ SG_ 154 OBJ_Angle_Left_16 "The angle between the host longitudinal axis and the left side of the front / rear of the target (the visible one). The positive side is to the host's right.";
CM_ SG_ 154 OBJ_Angle_Left_V_16 "Validator for angleLeft.";
CM_ SG_ 154 OBJ_Angle_Left_STD_16 "Standard deviation of angleLeft.";
CM_ SG_ 154 OBJ_Angle_Left_STD_V_16 "Validator for the standard deviation of angleLeft.";
CM_ SG_ 154 OBJ_Angle_Side_16 "The angle between the host longitudinal axis and the far visible edge - the visible edge of the front / rear of the target that is not visible. Currently supported for vehicles only.";
CM_ SG_ 154 OBJ_Angle_Side_V_16 "Validator for angleSide.";
CM_ SG_ 154 OBJ_Angle_Side_STD_16 "Standard deviation of angleSide.";
CM_ SG_ 154 OBJ_Angle_Side_STD_V_16 "Validator for the STD of angleSide.";
CM_ SG_ 154 OBJ_Angle_Mid_V_16 "Validator for angleMid.";
CM_ SG_ 154 OBJ_Angle_Mid_16 "The angle between the host longitudinal axis and the middle of the front / rear of the target (the visible one). The positive side is to the host's right.";
CM_ SG_ 154 OBJ_Angle_Mid_STD_16 "Standard deviation of angleMid.";
CM_ SG_ 154 OBJ_Angle_Mid_STD_V_16 "Validator for the STD of angleMid.";
CM_ SG_ 154 OBJ_Angle_Bottom_V_16 "Validator for OBJAngle_Bottom. ";
CM_ SG_ 154 OBJ_Angle_Bottom_16 "The angle between the logitudinal axis and the Bottom of the front / rear of the target (the visible one). The positive side is to the hosts right";
CM_ SG_ 154 OBJ_Angle_Bottom_STD_16 "STD for OBJAngle_Bottom. ";
CM_ SG_ 154 OBJ_Angle_Bottom_STD_V_16 "Validator for OBJAngle_Bottom_STD. ";
CM_ SG_ 154 OBJ_Visibility_Side_V_16 "Currently Supported for VD only";
CM_ SG_ 154 OBJ_Visibility_Side_16 "From what car  side is the object visible";
CM_ SG_ 154 OBJ_Is_In_Drivable_Area_16 "Indicates whether the target is in a driveable area.";
CM_ SG_ 154 OBJ_Is_In_Drivable_Area_V_16 "Validator for OBJ_Is_In_Drivable_Area.";
CM_ SG_ 154 OBJ_Is_VeryClose_16 "Indicates whether the target is very close to the host such that it is hard to measure it's distance. Currently relevant for peds only. ";
CM_ SG_ 154 OBJ_Is_VeryClose_V_16 "Validator for OBJ_Is_VeryClose. ";
CM_ SG_ 154 OBJ_Occlusion_RL_16 "Was Rear left of the 3D detection of theobject occluded";
CM_ SG_ 154 OBJ_Occlusion_RR_16 "Was Rear Right of the 3D detection of theobject occluded";
CM_ SG_ 154 OBJ_Occlusion_FR_16 "Was front Right of the 3D detection of theobject occluded";
CM_ SG_ 154 OBJ_Occlusion_FL_16 "Was Front left of the 3D detection of theobject occluded";
CM_ SG_ 154 OBJ_CRC_17 "Calculated over each object signal";
CM_ SG_ 154 OBJ_ID_17 "The detected object ID. Range is 1-255, while 0 indicates that the field in unfilled.";
CM_ SG_ 154 OBJ_Existence_Probability_17 "The existence probability of the vehicle";
CM_ SG_ 154 OBJ_Fusion_Source_17 "sources ids used for fusion";
CM_ SG_ 154 OBJ_Triggered_SDM_17 "Indicates whether the object has trigered the SDM (Safety Diagnostic Manager) alert.";
CM_ SG_ 154 OBJ_Motion_Category_17 "Relevant for VD only. Full description of values can be found at the ACC guide.";
CM_ SG_ 154 OBJ_Object_Age_17 "The number of frames in which the object was recognized.";
CM_ SG_ 154 OBJ_Measuring_Status_17 "Measurment status. Old vs New marks if this is the first frame in which the object is reported. Predicted vs Measured marks if the report is raw or has been predicted forward in time using the measured dynamics and ego motion.";
CM_ SG_ 154 OBJ_Object_Class_17 "Indicates the object type. Uncertain is outputted in case the probability that a vehicle is a truck is very similar to the probability that it is a car. ";
CM_ SG_ 154 OBJ_Class_Probability_17 "The probability of this type classification.";
CM_ SG_ 154 OBJ_Camera_Source_17 "The camera in which this object was detected (best choice).";
CM_ SG_ 154 OBJ_Motion_Status_17 "MOVING - the object is moving STATIONARY - the object was never seen moving STOPPED -  the object was moving and has stopped MOVING_SLOWLY - the object is moving very slowly";
CM_ SG_ 154 OBJ_Motion_Orientation_17 "The direction of the target's heading compared to the host. ";
CM_ SG_ 154 OBJ_Has_Cut_Lane_17 "Indicates whether the object cut the host's (right or left) lane. In case there are no lanes, indicates whether the objects is at most 1 meters away from the host.";
CM_ SG_ 154 OBJ_Has_Cut_Path_17 "Indicates whether the object is in the host's path.";
CM_ SG_ 154 OBJ_Brake_Light_17 "Indication for brake lights ";
CM_ SG_ 154 OBJ_Turn_Indicator_Right_17 "Indication for blinking right light.";
CM_ SG_ 154 OBJ_Turn_Indicator_Left_17 "Indication for blinking left light ";
CM_ SG_ 154 OBJ_Light_Indicator_Validity_17 "Validator for light indicators";
CM_ SG_ 154 OBJ_Right_Out_Of_Image_17 "Indicates whether the measurment are predicted out of the right side of the image bounderies.";
CM_ SG_ 154 OBJ_Left_Out_Of_Image_17 "Indicates whether if measurment are predicted out of  the left side of the image bounderies";
CM_ SG_ 154 OBJ_Right_Out_Of_Image_V_17 "validator";
CM_ SG_ 154 OBJ_Left_Out_Of_Image_V_17 "validator";
CM_ SG_ 154 OBJ_Top_Out_Of_Image_17 "Indicates whether if measurment are predicted out of  the top of the image bounderies";
CM_ SG_ 154 OBJ_Bottom_Out_Of_Image_17 "validator";
CM_ SG_ 154 OBJ_Top_Out_Of_Image_V_17 "Indicates whether if measurment are predicted out of  the bottom of the image bounderies";
CM_ SG_ 154 OBJ_Bottom_Out_Of_Image_V_17 "validator";
CM_ SG_ 154 OBJ_Lane_Assignment_17 "The object's lane relative to the host lane.";
CM_ SG_ 154 OBJ_Lane_Assignment_V_17 "Validator for lane assignment";
CM_ SG_ 154 OBJ_Age_Seconds_17 "Time in seconds in which the object was recognized. Currently available for peds only. ";
CM_ SG_ 154 OBJ_Age_Seconds_V_17 "Validator for object age";
CM_ SG_ 154 OBJ_Width_17 "The width of the target vehicle in the world (not to be mistaken with the width of the visible part of the vehicle).";
CM_ SG_ 154 OBJ_Width_V_17 "Validator for object width";
CM_ SG_ 154 OBJ_Width_STD_17 "Standard deviation for object width";
CM_ SG_ 154 OBJ_Width_STD_V_17 "Validator for the standard deviation of object width";
CM_ SG_ 154 OBJ_Length_17 "The length of the vehicle in the world. For crossing bicycles it gives the viewed length of the bicycle.";
CM_ SG_ 154 OBJ_Length_V_17 "Validator for object length.";
CM_ SG_ 154 OBJ_Length_STD_17 "Standard deviation for object length.";
CM_ SG_ 154 OBJ_Length_STD_V_17 "Validator for the standard deviation of object length.";
CM_ SG_ 154 OBJ_Height_17 "The height of the object in the world. ";
CM_ SG_ 154 OBJ_Height_V_17 "Validator for object height.";
CM_ SG_ 154 OBJ_Height_STD_17 "Standard deviation for object height.";
CM_ SG_ 154 OBJ_Height_STD_V_17 "Validator for the standard deviation of object height.";
CM_ SG_ 154 OBJ_Abs_Long_Velocity_17 "Absolute longitudinal velocity.";
CM_ SG_ 154 OBJ_Abs_Long_Velocity_V_17 "Validator for absolute longitudinal velocity.";
CM_ SG_ 154 OBJ_Abs_Long_Velocity_STD_17 "Standard deviation of absolute longitudinal velocity.";
CM_ SG_ 154 OBJ_Abs_Long_Vel_STD_V_17 "Validator for the standard deviation of the absolute longitudinal velocity.";
CM_ SG_ 154 OBJ_Abs_Lat_Velocity_17 "The lateral ground speed of the object.";
CM_ SG_ 154 OBJ_Abs_Lat_Velocity_V_17 "Validator for the lateral ground speed of the object.";
CM_ SG_ 154 OBJ_Abs_Lat_Velocity_STD_17 "STD of the lateral ground speed of the object.";
CM_ SG_ 154 OBJ_Abs_Lat_Vel_STD_V_17 "Validator for the STD of the lateral ground speed of the object.";
CM_ SG_ 154 OBJ_Abs_Long_Acc_17 "The longitudinal ground acceleration of the object.";
CM_ SG_ 154 OBJ_Abs_Long_Acc_V_17 "Validator for the longitudinal ground acceleration of the object.";
CM_ SG_ 154 OBJ_Abs_Long_Acc_STD_17 "STD of the longitudinal ground acceleration of the object.";
CM_ SG_ 154 OBJ_Abs_Long_Acc_STD_V_17 "Validator for the STD of the longitudinal ground acceleration of the object.";
CM_ SG_ 154 OBJ_Abs_Lat_Acc_17 "The lateral ground acceleration of the object.";
CM_ SG_ 154 OBJ_Abs_Lat_Acc_V_17 "Validator for the lateral ground acceleration of the object.";
CM_ SG_ 154 OBJ_Abs_Lat_Acc_STD_17 "STD of the lateral ground acceleration of the object.";
CM_ SG_ 154 OBJ_Abs_Lat_Acc_STD_V_17 "Validator for the STD of the lateral ground acceleration of the object.";
CM_ SG_ 154 OBJ_Abs_Acceleration_17 "The absolute ground acceleration in the target's heading direction.";
CM_ SG_ 154 OBJ_Abs_Acceleration_V_17 "Validator for the absolute ground acceleration.";
CM_ SG_ 154 OBJ_Abs_Acc_STD_17 "STD of the absolute ground acceleration.";
CM_ SG_ 154 OBJ_Abs_Acc_STD_V_17 "Validator for the STD of the absolute ground acceleration.";
CM_ SG_ 154 OBJ_Inv_TTC_17 "Inverse TTC (time to collision).";
CM_ SG_ 154 OBJ_Inv_TTC_V_17 "Validator for Inverse TTC.";
CM_ SG_ 154 OBJ_Inv_TTC_STD_17 "STD for inverse TTC .";
CM_ SG_ 154 OBJ_Inv_TTC_STD_V_17 "Validator for the STD for inverse TTC .";
CM_ SG_ 154 OBJ_Relative_Long_Acc_17 "The relative lateral ground acceleration of the object.";
CM_ SG_ 154 OBJ_Relative_Long_Acc_V_17 "Validator for the relative lateral ground acceleration of the object.";
CM_ SG_ 154 OBJ_Relative_Long_Acc_STD_17 "STD of the relative lateral ground acceleration of the object.";
CM_ SG_ 154 OBJ_Rel_Long_Acc_STD_V_17 "Validator for the STD of the relative lateral ground acceleration.";
CM_ SG_ 154 OBJ_Relative_Long_Velocity_17 "The relative longtitudinal speed between the target and ego vehicle. ";
CM_ SG_ 154 OBJ_Relative_Long_Velocity_V_17 "Validator for the relative longtitudinal speed.";
CM_ SG_ 154 OBJ_Relative_Long_Vel_STD_17 "STD of the relative longtitudinal speed.";
CM_ SG_ 154 OBJ_Rel_Long_Vel_STD_V_17 "Validator for the STD of the relative longtitudinal speed.";
CM_ SG_ 154 OBJ_Relative_Lat_Velocity_17 "The relative lateral speed between the target and ego vehicle. ";
CM_ SG_ 154 OBJ_Relative_Lat_Velocity_V_17 "Validator for the relative lateral speed. ";
CM_ SG_ 154 OBJ_Relative_Lat_Velocity_STD_17 "STD of the relative lateral speed. ";
CM_ SG_ 154 OBJ_Rel_Lat_Vel_STD_V_17 "Validator for the STD of the relative lateral speed. ";
CM_ SG_ 154 OBJ_Long_Distance_17 "The longtitudinal distance from the object to the middle of the Rear-Left and Rear-Right corners of the host vehicle.  ";
CM_ SG_ 154 OBJ_Long_Distance_V_17 "Validator of the longtitudinal distance from the object to the middle of the rear-axle of the host.  ";
CM_ SG_ 154 OBJ_Long_Distance_STD_17 "STD of the  longtitudinal distance.";
CM_ SG_ 154 OBJ_Long_Distance_STD_V_17 "Validator for the STD of the  longtitudinal distance.";
CM_ SG_ 154 OBJ_Lat_Distance_17 "Lateral distance to the middle of the RL and RR corners.  ";
CM_ SG_ 154 OBJ_Lat_Distance_V_17 "Validator for the lateral distance of the object.";
CM_ SG_ 154 OBJ_Lat_Distance_STD_17 "STD of the lateral distance of the object.";
CM_ SG_ 154 OBJ_Lat_Distance_STD_V_17 "Validator for the STD of the lateral distance of the object.";
CM_ SG_ 154 OBJ_Absolute_Speed_17 "The absolute ground speed in the targets' heading direction.";
CM_ SG_ 154 OBJ_Absolute_Speed_V_17 "Validator for the absolute ground speed.";
CM_ SG_ 154 OBJ_Absolute_Speed_STD_17 "STD of the absolute ground speed.";
CM_ SG_ 154 OBJ_Absolute_Speed_STD_V_17 "Validator for the STD of the absolute ground speed.";
CM_ SG_ 154 OBJ_Heading_17 "The angle beetweenthe host longitudinal axis and target's heading (clockwise, e.g. PI/2 is a target crossing from left to right).";
CM_ SG_ 154 OBJ_Heading_V_17 "Validator for the object heading.";
CM_ SG_ 154 OBJ_Heading_STD_17 "STD of the object heading.";
CM_ SG_ 154 OBJ_Heading_STD_V_17 "Validator for the STD of the object heading.";
CM_ SG_ 154 OBJ_Angle_Rate_STD_17 "Standard deviation of the angular speed. (radians)";
CM_ SG_ 154 OBJ_Angle_Rate_STD_V_17 "Validator for the STD of the angular speed.";
CM_ SG_ 154 OBJ_Angle_Rate_17 "The momentary angular speed of the object. (radians)";
CM_ SG_ 154 OBJ_Angle_Rate_V_17 "Validator for the angular speed.";
CM_ SG_ 154 OBJ_Angle_Right_17 "The angle between the host longitudinal axis and the right side of the front / rear of the target (the visible one). The positive side is to the host's right.";
CM_ SG_ 154 OBJ_Angle_Right_V_17 "Validator for angleRight";
CM_ SG_ 154 OBJ_Angle_Right_STD_17 "Standard deviation of angleRight";
CM_ SG_ 154 OBJ_Angle_Right_STD_V_17 "Validator for the standard deviation of angleRight.";
CM_ SG_ 154 OBJ_Angle_Left_17 "The angle between the host longitudinal axis and the left side of the front / rear of the target (the visible one). The positive side is to the host's right.";
CM_ SG_ 154 OBJ_Angle_Left_V_17 "Validator for angleLeft.";
CM_ SG_ 154 OBJ_Angle_Left_STD_17 "Standard deviation of angleLeft.";
CM_ SG_ 154 OBJ_Angle_Left_STD_V_17 "Validator for the standard deviation of angleLeft.";
CM_ SG_ 154 OBJ_Angle_Side_17 "The angle between the host longitudinal axis and the far visible edge - the visible edge of the front / rear of the target that is not visible. Currently supported for vehicles only.";
CM_ SG_ 154 OBJ_Angle_Side_V_17 "Validator for angleSide.";
CM_ SG_ 154 OBJ_Angle_Side_STD_17 "Standard deviation of angleSide.";
CM_ SG_ 154 OBJ_Angle_Side_STD_V_17 "Validator for the STD of angleSide.";
CM_ SG_ 154 OBJ_Angle_Mid_V_17 "Validator for angleMid.";
CM_ SG_ 154 OBJ_Angle_Mid_17 "The angle between the host longitudinal axis and the middle of the front / rear of the target (the visible one). The positive side is to the host's right.";
CM_ SG_ 154 OBJ_Angle_Mid_STD_17 "Standard deviation of angleMid.";
CM_ SG_ 154 OBJ_Angle_Mid_STD_V_17 "Validator for the STD of angleMid.";
CM_ SG_ 154 OBJ_Angle_Bottom_V_17 "Validator for OBJAngle_Bottom. ";
CM_ SG_ 154 OBJ_Angle_Bottom_17 "The angle between the logitudinal axis and the Bottom of the front / rear of the target (the visible one). The positive side is to the hosts right";
CM_ SG_ 154 OBJ_Angle_Bottom_STD_17 "STD for OBJAngle_Bottom. ";
CM_ SG_ 154 OBJ_Angle_Bottom_STD_V_17 "Validator for OBJAngle_Bottom_STD. ";
CM_ SG_ 154 OBJ_Visibility_Side_V_17 "Currently Supported for VD only";
CM_ SG_ 154 OBJ_Visibility_Side_17 "From what car  side is the object visible";
CM_ SG_ 154 OBJ_Is_In_Drivable_Area_17 "Indicates whether the target is in a driveable area.";
CM_ SG_ 154 OBJ_Is_In_Drivable_Area_V_17 "Validator for OBJ_Is_In_Drivable_Area.";
CM_ SG_ 154 OBJ_Is_VeryClose_17 "Indicates whether the target is very close to the host such that it is hard to measure it's distance. Currently relevant for peds only. ";
CM_ SG_ 154 OBJ_Is_VeryClose_V_17 "Validator for OBJ_Is_VeryClose. ";
CM_ SG_ 154 OBJ_Occlusion_RL_17 "Was Rear left of the 3D detection of theobject occluded";
CM_ SG_ 154 OBJ_Occlusion_RR_17 "Was Rear Right of the 3D detection of theobject occluded";
CM_ SG_ 154 OBJ_Occlusion_FR_17 "Was front Right of the 3D detection of theobject occluded";
CM_ SG_ 154 OBJ_Occlusion_FL_17 "Was Front left of the 3D detection of theobject occluded";
CM_ SG_ 154 OBJ_CRC_18 "Calculated over each object signal";
CM_ SG_ 154 OBJ_ID_18 "The detected object ID. Range is 1-255, while 0 indicates that the field in unfilled.";
CM_ SG_ 154 OBJ_Existence_Probability_18 "The existence probability of the vehicle";
CM_ SG_ 154 OBJ_Fusion_Source_18 "sources ids used for fusion";
CM_ SG_ 154 OBJ_Triggered_SDM_18 "Indicates whether the object has trigered the SDM (Safety Diagnostic Manager) alert.";
CM_ SG_ 154 OBJ_Motion_Category_18 "Relevant for VD only. Full description of values can be found at the ACC guide.";
CM_ SG_ 154 OBJ_Object_Age_18 "The number of frames in which the object was recognized.";
CM_ SG_ 154 OBJ_Measuring_Status_18 "Measurment status. Old vs New marks if this is the first frame in which the object is reported. Predicted vs Measured marks if the report is raw or has been predicted forward in time using the measured dynamics and ego motion.";
CM_ SG_ 154 OBJ_Object_Class_18 "Indicates the object type. Uncertain is outputted in case the probability that a vehicle is a truck is very similar to the probability that it is a car. ";
CM_ SG_ 154 OBJ_Class_Probability_18 "The probability of this type classification.";
CM_ SG_ 154 OBJ_Camera_Source_18 "The camera in which this object was detected (best choice).";
CM_ SG_ 154 OBJ_Motion_Status_18 "MOVING - the object is moving STATIONARY - the object was never seen moving STOPPED -  the object was moving and has stopped MOVING_SLOWLY - the object is moving very slowly";
CM_ SG_ 154 OBJ_Motion_Orientation_18 "The direction of the target's heading compared to the host. ";
CM_ SG_ 154 OBJ_Has_Cut_Lane_18 "Indicates whether the object cut the host's (right or left) lane. In case there are no lanes, indicates whether the objects is at most 1 meters away from the host.";
CM_ SG_ 154 OBJ_Has_Cut_Path_18 "Indicates whether the object is in the host's path.";
CM_ SG_ 154 OBJ_Brake_Light_18 "Indication for brake lights ";
CM_ SG_ 154 OBJ_Turn_Indicator_Right_18 "Indication for blinking right light.";
CM_ SG_ 154 OBJ_Turn_Indicator_Left_18 "Indication for blinking left light ";
CM_ SG_ 154 OBJ_Light_Indicator_Validity_18 "Validator for light indicators";
CM_ SG_ 154 OBJ_Right_Out_Of_Image_18 "Indicates whether the measurment are predicted out of the right side of the image bounderies.";
CM_ SG_ 154 OBJ_Left_Out_Of_Image_18 "Indicates whether if measurment are predicted out of  the left side of the image bounderies";
CM_ SG_ 154 OBJ_Right_Out_Of_Image_V_18 "validator";
CM_ SG_ 154 OBJ_Left_Out_Of_Image_V_18 "validator";
CM_ SG_ 154 OBJ_Top_Out_Of_Image_18 "Indicates whether if measurment are predicted out of  the top of the image bounderies";
CM_ SG_ 154 OBJ_Bottom_Out_Of_Image_18 "validator";
CM_ SG_ 154 OBJ_Top_Out_Of_Image_V_18 "Indicates whether if measurment are predicted out of  the bottom of the image bounderies";
CM_ SG_ 154 OBJ_Bottom_Out_Of_Image_V_18 "validator";
CM_ SG_ 154 OBJ_Lane_Assignment_18 "The object's lane relative to the host lane.";
CM_ SG_ 154 OBJ_Lane_Assignment_V_18 "Validator for lane assignment";
CM_ SG_ 154 OBJ_Age_Seconds_18 "Time in seconds in which the object was recognized. Currently available for peds only. ";
CM_ SG_ 154 OBJ_Age_Seconds_V_18 "Validator for object age";
CM_ SG_ 154 OBJ_Width_18 "The width of the target vehicle in the world (not to be mistaken with the width of the visible part of the vehicle).";
CM_ SG_ 154 OBJ_Width_V_18 "Validator for object width";
CM_ SG_ 154 OBJ_Width_STD_18 "Standard deviation for object width";
CM_ SG_ 154 OBJ_Width_STD_V_18 "Validator for the standard deviation of object width";
CM_ SG_ 154 OBJ_Length_18 "The length of the vehicle in the world. For crossing bicycles it gives the viewed length of the bicycle.";
CM_ SG_ 154 OBJ_Length_V_18 "Validator for object length.";
CM_ SG_ 154 OBJ_Length_STD_18 "Standard deviation for object length.";
CM_ SG_ 154 OBJ_Length_STD_V_18 "Validator for the standard deviation of object length.";
CM_ SG_ 154 OBJ_Height_18 "The height of the object in the world. ";
CM_ SG_ 154 OBJ_Height_V_18 "Validator for object height.";
CM_ SG_ 154 OBJ_Height_STD_18 "Standard deviation for object height.";
CM_ SG_ 154 OBJ_Height_STD_V_18 "Validator for the standard deviation of object height.";
CM_ SG_ 154 OBJ_Abs_Long_Velocity_18 "Absolute longitudinal velocity.";
CM_ SG_ 154 OBJ_Abs_Long_Velocity_V_18 "Validator for absolute longitudinal velocity.";
CM_ SG_ 154 OBJ_Abs_Long_Velocity_STD_18 "Standard deviation of absolute longitudinal velocity.";
CM_ SG_ 154 OBJ_Abs_Long_Vel_STD_V_18 "Validator for the standard deviation of the absolute longitudinal velocity.";
CM_ SG_ 154 OBJ_Abs_Lat_Velocity_18 "The lateral ground speed of the object.";
CM_ SG_ 154 OBJ_Abs_Lat_Velocity_V_18 "Validator for the lateral ground speed of the object.";
CM_ SG_ 154 OBJ_Abs_Lat_Velocity_STD_18 "STD of the lateral ground speed of the object.";
CM_ SG_ 154 OBJ_Abs_Lat_Vel_STD_V_18 "Validator for the STD of the lateral ground speed of the object.";
CM_ SG_ 154 OBJ_Abs_Long_Acc_18 "The longitudinal ground acceleration of the object.";
CM_ SG_ 154 OBJ_Abs_Long_Acc_V_18 "Validator for the longitudinal ground acceleration of the object.";
CM_ SG_ 154 OBJ_Abs_Long_Acc_STD_18 "STD of the longitudinal ground acceleration of the object.";
CM_ SG_ 154 OBJ_Abs_Long_Acc_STD_V_18 "Validator for the STD of the longitudinal ground acceleration of the object.";
CM_ SG_ 154 OBJ_Abs_Lat_Acc_18 "The lateral ground acceleration of the object.";
CM_ SG_ 154 OBJ_Abs_Lat_Acc_V_18 "Validator for the lateral ground acceleration of the object.";
CM_ SG_ 154 OBJ_Abs_Lat_Acc_STD_18 "STD of the lateral ground acceleration of the object.";
CM_ SG_ 154 OBJ_Abs_Lat_Acc_STD_V_18 "Validator for the STD of the lateral ground acceleration of the object.";
CM_ SG_ 154 OBJ_Abs_Acceleration_18 "The absolute ground acceleration in the target's heading direction.";
CM_ SG_ 154 OBJ_Abs_Acceleration_V_18 "Validator for the absolute ground acceleration.";
CM_ SG_ 154 OBJ_Abs_Acc_STD_18 "STD of the absolute ground acceleration.";
CM_ SG_ 154 OBJ_Abs_Acc_STD_V_18 "Validator for the STD of the absolute ground acceleration.";
CM_ SG_ 154 OBJ_Inv_TTC_18 "Inverse TTC (time to collision).";
CM_ SG_ 154 OBJ_Inv_TTC_V_18 "Validator for Inverse TTC.";
CM_ SG_ 154 OBJ_Inv_TTC_STD_18 "STD for inverse TTC .";
CM_ SG_ 154 OBJ_Inv_TTC_STD_V_18 "Validator for the STD for inverse TTC .";
CM_ SG_ 154 OBJ_Relative_Long_Acc_18 "The relative lateral ground acceleration of the object.";
CM_ SG_ 154 OBJ_Relative_Long_Acc_V_18 "Validator for the relative lateral ground acceleration of the object.";
CM_ SG_ 154 OBJ_Relative_Long_Acc_STD_18 "STD of the relative lateral ground acceleration of the object.";
CM_ SG_ 154 OBJ_Rel_Long_Acc_STD_V_18 "Validator for the STD of the relative lateral ground acceleration.";
CM_ SG_ 154 OBJ_Relative_Long_Velocity_18 "The relative longtitudinal speed between the target and ego vehicle. ";
CM_ SG_ 154 OBJ_Relative_Long_Velocity_V_18 "Validator for the relative longtitudinal speed.";
CM_ SG_ 154 OBJ_Relative_Long_Vel_STD_18 "STD of the relative longtitudinal speed.";
CM_ SG_ 154 OBJ_Rel_Long_Vel_STD_V_18 "Validator for the STD of the relative longtitudinal speed.";
CM_ SG_ 154 OBJ_Relative_Lat_Velocity_18 "The relative lateral speed between the target and ego vehicle. ";
CM_ SG_ 154 OBJ_Relative_Lat_Velocity_V_18 "Validator for the relative lateral speed. ";
CM_ SG_ 154 OBJ_Relative_Lat_Velocity_STD_18 "STD of the relative lateral speed. ";
CM_ SG_ 154 OBJ_Rel_Lat_Vel_STD_V_18 "Validator for the STD of the relative lateral speed. ";
CM_ SG_ 154 OBJ_Long_Distance_18 "The longtitudinal distance from the object to the middle of the Rear-Left and Rear-Right corners of the host vehicle.  ";
CM_ SG_ 154 OBJ_Long_Distance_V_18 "Validator of the longtitudinal distance from the object to the middle of the rear-axle of the host.  ";
CM_ SG_ 154 OBJ_Long_Distance_STD_18 "STD of the  longtitudinal distance.";
CM_ SG_ 154 OBJ_Long_Distance_STD_V_18 "Validator for the STD of the  longtitudinal distance.";
CM_ SG_ 154 OBJ_Lat_Distance_18 "Lateral distance to the middle of the RL and RR corners.  ";
CM_ SG_ 154 OBJ_Lat_Distance_V_18 "Validator for the lateral distance of the object.";
CM_ SG_ 154 OBJ_Lat_Distance_STD_18 "STD of the lateral distance of the object.";
CM_ SG_ 154 OBJ_Lat_Distance_STD_V_18 "Validator for the STD of the lateral distance of the object.";
CM_ SG_ 154 OBJ_Absolute_Speed_18 "The absolute ground speed in the targets' heading direction.";
CM_ SG_ 154 OBJ_Absolute_Speed_V_18 "Validator for the absolute ground speed.";
CM_ SG_ 154 OBJ_Absolute_Speed_STD_18 "STD of the absolute ground speed.";
CM_ SG_ 154 OBJ_Absolute_Speed_STD_V_18 "Validator for the STD of the absolute ground speed.";
CM_ SG_ 154 OBJ_Heading_18 "The angle beetweenthe host longitudinal axis and target's heading (clockwise, e.g. PI/2 is a target crossing from left to right).";
CM_ SG_ 154 OBJ_Heading_V_18 "Validator for the object heading.";
CM_ SG_ 154 OBJ_Heading_STD_18 "STD of the object heading.";
CM_ SG_ 154 OBJ_Heading_STD_V_18 "Validator for the STD of the object heading.";
CM_ SG_ 154 OBJ_Angle_Rate_STD_18 "Standard deviation of the angular speed. (radians)";
CM_ SG_ 154 OBJ_Angle_Rate_STD_V_18 "Validator for the STD of the angular speed.";
CM_ SG_ 154 OBJ_Angle_Rate_18 "The momentary angular speed of the object. (radians)";
CM_ SG_ 154 OBJ_Angle_Rate_V_18 "Validator for the angular speed.";
CM_ SG_ 154 OBJ_Angle_Right_18 "The angle between the host longitudinal axis and the right side of the front / rear of the target (the visible one). The positive side is to the host's right.";
CM_ SG_ 154 OBJ_Angle_Right_V_18 "Validator for angleRight";
CM_ SG_ 154 OBJ_Angle_Right_STD_18 "Standard deviation of angleRight";
CM_ SG_ 154 OBJ_Angle_Right_STD_V_18 "Validator for the standard deviation of angleRight.";
CM_ SG_ 154 OBJ_Angle_Left_18 "The angle between the host longitudinal axis and the left side of the front / rear of the target (the visible one). The positive side is to the host's right.";
CM_ SG_ 154 OBJ_Angle_Left_V_18 "Validator for angleLeft.";
CM_ SG_ 154 OBJ_Angle_Left_STD_18 "Standard deviation of angleLeft.";
CM_ SG_ 154 OBJ_Angle_Left_STD_V_18 "Validator for the standard deviation of angleLeft.";
CM_ SG_ 154 OBJ_Angle_Side_18 "The angle between the host longitudinal axis and the far visible edge - the visible edge of the front / rear of the target that is not visible. Currently supported for vehicles only.";
CM_ SG_ 154 OBJ_Angle_Side_V_18 "Validator for angleSide.";
CM_ SG_ 154 OBJ_Angle_Side_STD_18 "Standard deviation of angleSide.";
CM_ SG_ 154 OBJ_Angle_Side_STD_V_18 "Validator for the STD of angleSide.";
CM_ SG_ 154 OBJ_Angle_Mid_V_18 "Validator for angleMid.";
CM_ SG_ 154 OBJ_Angle_Mid_18 "The angle between the host longitudinal axis and the middle of the front / rear of the target (the visible one). The positive side is to the host's right.";
CM_ SG_ 154 OBJ_Angle_Mid_STD_18 "Standard deviation of angleMid.";
CM_ SG_ 154 OBJ_Angle_Mid_STD_V_18 "Validator for the STD of angleMid.";
CM_ SG_ 154 OBJ_Angle_Bottom_V_18 "Validator for OBJAngle_Bottom. ";
CM_ SG_ 154 OBJ_Angle_Bottom_18 "The angle between the logitudinal axis and the Bottom of the front / rear of the target (the visible one). The positive side is to the hosts right";
CM_ SG_ 154 OBJ_Angle_Bottom_STD_18 "STD for OBJAngle_Bottom. ";
CM_ SG_ 154 OBJ_Angle_Bottom_STD_V_18 "Validator for OBJAngle_Bottom_STD. ";
CM_ SG_ 154 OBJ_Visibility_Side_V_18 "Currently Supported for VD only";
CM_ SG_ 154 OBJ_Visibility_Side_18 "From what car  side is the object visible";
CM_ SG_ 154 OBJ_Is_In_Drivable_Area_18 "Indicates whether the target is in a driveable area.";
CM_ SG_ 154 OBJ_Is_In_Drivable_Area_V_18 "Validator for OBJ_Is_In_Drivable_Area.";
CM_ SG_ 154 OBJ_Is_VeryClose_18 "Indicates whether the target is very close to the host such that it is hard to measure it's distance. Currently relevant for peds only. ";
CM_ SG_ 154 OBJ_Is_VeryClose_V_18 "Validator for OBJ_Is_VeryClose. ";
CM_ SG_ 154 OBJ_Occlusion_RL_18 "Was Rear left of the 3D detection of theobject occluded";
CM_ SG_ 154 OBJ_Occlusion_RR_18 "Was Rear Right of the 3D detection of theobject occluded";
CM_ SG_ 154 OBJ_Occlusion_FR_18 "Was front Right of the 3D detection of theobject occluded";
CM_ SG_ 154 OBJ_Occlusion_FL_18 "Was Front left of the 3D detection of theobject occluded";
CM_ SG_ 154 OBJ_CRC_19 "Calculated over each object signal";
CM_ SG_ 154 OBJ_ID_19 "The detected object ID. Range is 1-255, while 0 indicates that the field in unfilled.";
CM_ SG_ 154 OBJ_Existence_Probability_19 "The existence probability of the vehicle";
CM_ SG_ 154 OBJ_Fusion_Source_19 "sources ids used for fusion";
CM_ SG_ 154 OBJ_Triggered_SDM_19 "Indicates whether the object has trigered the SDM (Safety Diagnostic Manager) alert.";
CM_ SG_ 154 OBJ_Motion_Category_19 "Relevant for VD only. Full description of values can be found at the ACC guide.";
CM_ SG_ 154 OBJ_Object_Age_19 "The number of frames in which the object was recognized.";
CM_ SG_ 154 OBJ_Measuring_Status_19 "Measurment status. Old vs New marks if this is the first frame in which the object is reported. Predicted vs Measured marks if the report is raw or has been predicted forward in time using the measured dynamics and ego motion.";
CM_ SG_ 154 OBJ_Object_Class_19 "Indicates the object type. Uncertain is outputted in case the probability that a vehicle is a truck is very similar to the probability that it is a car. ";
CM_ SG_ 154 OBJ_Class_Probability_19 "The probability of this type classification.";
CM_ SG_ 154 OBJ_Camera_Source_19 "The camera in which this object was detected (best choice).";
CM_ SG_ 154 OBJ_Motion_Status_19 "MOVING - the object is moving STATIONARY - the object was never seen moving STOPPED -  the object was moving and has stopped MOVING_SLOWLY - the object is moving very slowly";
CM_ SG_ 154 OBJ_Motion_Orientation_19 "The direction of the target's heading compared to the host. ";
CM_ SG_ 154 OBJ_Has_Cut_Lane_19 "Indicates whether the object cut the host's (right or left) lane. In case there are no lanes, indicates whether the objects is at most 1 meters away from the host.";
CM_ SG_ 154 OBJ_Has_Cut_Path_19 "Indicates whether the object is in the host's path.";
CM_ SG_ 154 OBJ_Brake_Light_19 "Indication for brake lights ";
CM_ SG_ 154 OBJ_Turn_Indicator_Right_19 "Indication for blinking right light.";
CM_ SG_ 154 OBJ_Turn_Indicator_Left_19 "Indication for blinking left light ";
CM_ SG_ 154 OBJ_Light_Indicator_Validity_19 "Validator for light indicators";
CM_ SG_ 154 OBJ_Right_Out_Of_Image_19 "Indicates whether the measurment are predicted out of the right side of the image bounderies.";
CM_ SG_ 154 OBJ_Left_Out_Of_Image_19 "Indicates whether if measurment are predicted out of  the left side of the image bounderies";
CM_ SG_ 154 OBJ_Right_Out_Of_Image_V_19 "validator";
CM_ SG_ 154 OBJ_Left_Out_Of_Image_V_19 "validator";
CM_ SG_ 154 OBJ_Top_Out_Of_Image_19 "Indicates whether if measurment are predicted out of  the top of the image bounderies";
CM_ SG_ 154 OBJ_Bottom_Out_Of_Image_19 "validator";
CM_ SG_ 154 OBJ_Top_Out_Of_Image_V_19 "Indicates whether if measurment are predicted out of  the bottom of the image bounderies";
CM_ SG_ 154 OBJ_Bottom_Out_Of_Image_V_19 "validator";
CM_ SG_ 154 OBJ_Lane_Assignment_19 "The object's lane relative to the host lane.";
CM_ SG_ 154 OBJ_Lane_Assignment_V_19 "Validator for lane assignment";
CM_ SG_ 154 OBJ_Age_Seconds_19 "Time in seconds in which the object was recognized. Currently available for peds only. ";
CM_ SG_ 154 OBJ_Age_Seconds_V_19 "Validator for object age";
CM_ SG_ 154 OBJ_Width_19 "The width of the target vehicle in the world (not to be mistaken with the width of the visible part of the vehicle).";
CM_ SG_ 154 OBJ_Width_V_19 "Validator for object width";
CM_ SG_ 154 OBJ_Width_STD_19 "Standard deviation for object width";
CM_ SG_ 154 OBJ_Width_STD_V_19 "Validator for the standard deviation of object width";
CM_ SG_ 154 OBJ_Length_19 "The length of the vehicle in the world. For crossing bicycles it gives the viewed length of the bicycle.";
CM_ SG_ 154 OBJ_Length_V_19 "Validator for object length.";
CM_ SG_ 154 OBJ_Length_STD_19 "Standard deviation for object length.";
CM_ SG_ 154 OBJ_Length_STD_V_19 "Validator for the standard deviation of object length.";
CM_ SG_ 154 OBJ_Height_19 "The height of the object in the world. ";
CM_ SG_ 154 OBJ_Height_V_19 "Validator for object height.";
CM_ SG_ 154 OBJ_Height_STD_19 "Standard deviation for object height.";
CM_ SG_ 154 OBJ_Height_STD_V_19 "Validator for the standard deviation of object height.";
CM_ SG_ 154 OBJ_Abs_Long_Velocity_19 "Absolute longitudinal velocity.";
CM_ SG_ 154 OBJ_Abs_Long_Velocity_V_19 "Validator for absolute longitudinal velocity.";
CM_ SG_ 154 OBJ_Abs_Long_Velocity_STD_19 "Standard deviation of absolute longitudinal velocity.";
CM_ SG_ 154 OBJ_Abs_Long_Vel_STD_V_19 "Validator for the standard deviation of the absolute longitudinal velocity.";
CM_ SG_ 154 OBJ_Abs_Lat_Velocity_19 "The lateral ground speed of the object.";
CM_ SG_ 154 OBJ_Abs_Lat_Velocity_V_19 "Validator for the lateral ground speed of the object.";
CM_ SG_ 154 OBJ_Abs_Lat_Velocity_STD_19 "STD of the lateral ground speed of the object.";
CM_ SG_ 154 OBJ_Abs_Lat_Vel_STD_V_19 "Validator for the STD of the lateral ground speed of the object.";
CM_ SG_ 154 OBJ_Abs_Long_Acc_19 "The longitudinal ground acceleration of the object.";
CM_ SG_ 154 OBJ_Abs_Long_Acc_V_19 "Validator for the longitudinal ground acceleration of the object.";
CM_ SG_ 154 OBJ_Abs_Long_Acc_STD_19 "STD of the longitudinal ground acceleration of the object.";
CM_ SG_ 154 OBJ_Abs_Long_Acc_STD_V_19 "Validator for the STD of the longitudinal ground acceleration of the object.";
CM_ SG_ 154 OBJ_Abs_Lat_Acc_19 "The lateral ground acceleration of the object.";
CM_ SG_ 154 OBJ_Abs_Lat_Acc_V_19 "Validator for the lateral ground acceleration of the object.";
CM_ SG_ 154 OBJ_Abs_Lat_Acc_STD_19 "STD of the lateral ground acceleration of the object.";
CM_ SG_ 154 OBJ_Abs_Lat_Acc_STD_V_19 "Validator for the STD of the lateral ground acceleration of the object.";
CM_ SG_ 154 OBJ_Abs_Acceleration_19 "The absolute ground acceleration in the target's heading direction.";
CM_ SG_ 154 OBJ_Abs_Acceleration_V_19 "Validator for the absolute ground acceleration.";
CM_ SG_ 154 OBJ_Abs_Acc_STD_19 "STD of the absolute ground acceleration.";
CM_ SG_ 154 OBJ_Abs_Acc_STD_V_19 "Validator for the STD of the absolute ground acceleration.";
CM_ SG_ 154 OBJ_Inv_TTC_19 "Inverse TTC (time to collision).";
CM_ SG_ 154 OBJ_Inv_TTC_V_19 "Validator for Inverse TTC.";
CM_ SG_ 154 OBJ_Inv_TTC_STD_19 "STD for inverse TTC .";
CM_ SG_ 154 OBJ_Inv_TTC_STD_V_19 "Validator for the STD for inverse TTC .";
CM_ SG_ 154 OBJ_Relative_Long_Acc_19 "The relative lateral ground acceleration of the object.";
CM_ SG_ 154 OBJ_Relative_Long_Acc_V_19 "Validator for the relative lateral ground acceleration of the object.";
CM_ SG_ 154 OBJ_Relative_Long_Acc_STD_19 "STD of the relative lateral ground acceleration of the object.";
CM_ SG_ 154 OBJ_Rel_Long_Acc_STD_V_19 "Validator for the STD of the relative lateral ground acceleration.";
CM_ SG_ 154 OBJ_Relative_Long_Velocity_19 "The relative longtitudinal speed between the target and ego vehicle. ";
CM_ SG_ 154 OBJ_Relative_Long_Velocity_V_19 "Validator for the relative longtitudinal speed.";
CM_ SG_ 154 OBJ_Relative_Long_Vel_STD_19 "STD of the relative longtitudinal speed.";
CM_ SG_ 154 OBJ_Rel_Long_Vel_STD_V_19 "Validator for the STD of the relative longtitudinal speed.";
CM_ SG_ 154 OBJ_Relative_Lat_Velocity_19 "The relative lateral speed between the target and ego vehicle. ";
CM_ SG_ 154 OBJ_Relative_Lat_Velocity_V_19 "Validator for the relative lateral speed. ";
CM_ SG_ 154 OBJ_Relative_Lat_Velocity_STD_19 "STD of the relative lateral speed. ";
CM_ SG_ 154 OBJ_Rel_Lat_Vel_STD_V_19 "Validator for the STD of the relative lateral speed. ";
CM_ SG_ 154 OBJ_Long_Distance_19 "The longtitudinal distance from the object to the middle of the Rear-Left and Rear-Right corners of the host vehicle.  ";
CM_ SG_ 154 OBJ_Long_Distance_V_19 "Validator of the longtitudinal distance from the object to the middle of the rear-axle of the host.  ";
CM_ SG_ 154 OBJ_Long_Distance_STD_19 "STD of the  longtitudinal distance.";
CM_ SG_ 154 OBJ_Long_Distance_STD_V_19 "Validator for the STD of the  longtitudinal distance.";
CM_ SG_ 154 OBJ_Lat_Distance_19 "Lateral distance to the middle of the RL and RR corners.  ";
CM_ SG_ 154 OBJ_Lat_Distance_V_19 "Validator for the lateral distance of the object.";
CM_ SG_ 154 OBJ_Lat_Distance_STD_19 "STD of the lateral distance of the object.";
CM_ SG_ 154 OBJ_Lat_Distance_STD_V_19 "Validator for the STD of the lateral distance of the object.";
CM_ SG_ 154 OBJ_Absolute_Speed_19 "The absolute ground speed in the targets' heading direction.";
CM_ SG_ 154 OBJ_Absolute_Speed_V_19 "Validator for the absolute ground speed.";
CM_ SG_ 154 OBJ_Absolute_Speed_STD_19 "STD of the absolute ground speed.";
CM_ SG_ 154 OBJ_Absolute_Speed_STD_V_19 "Validator for the STD of the absolute ground speed.";
CM_ SG_ 154 OBJ_Heading_19 "The angle beetweenthe host longitudinal axis and target's heading (clockwise, e.g. PI/2 is a target crossing from left to right).";
CM_ SG_ 154 OBJ_Heading_V_19 "Validator for the object heading.";
CM_ SG_ 154 OBJ_Heading_STD_19 "STD of the object heading.";
CM_ SG_ 154 OBJ_Heading_STD_V_19 "Validator for the STD of the object heading.";
CM_ SG_ 154 OBJ_Angle_Rate_STD_19 "Standard deviation of the angular speed. (radians)";
CM_ SG_ 154 OBJ_Angle_Rate_STD_V_19 "Validator for the STD of the angular speed.";
CM_ SG_ 154 OBJ_Angle_Rate_19 "The momentary angular speed of the object. (radians)";
CM_ SG_ 154 OBJ_Angle_Rate_V_19 "Validator for the angular speed.";
CM_ SG_ 154 OBJ_Angle_Right_19 "The angle between the host longitudinal axis and the right side of the front / rear of the target (the visible one). The positive side is to the host's right.";
CM_ SG_ 154 OBJ_Angle_Right_V_19 "Validator for angleRight";
CM_ SG_ 154 OBJ_Angle_Right_STD_19 "Standard deviation of angleRight";
CM_ SG_ 154 OBJ_Angle_Right_STD_V_19 "Validator for the standard deviation of angleRight.";
CM_ SG_ 154 OBJ_Angle_Left_19 "The angle between the host longitudinal axis and the left side of the front / rear of the target (the visible one). The positive side is to the host's right.";
CM_ SG_ 154 OBJ_Angle_Left_V_19 "Validator for angleLeft.";
CM_ SG_ 154 OBJ_Angle_Left_STD_19 "Standard deviation of angleLeft.";
CM_ SG_ 154 OBJ_Angle_Left_STD_V_19 "Validator for the standard deviation of angleLeft.";
CM_ SG_ 154 OBJ_Angle_Side_19 "The angle between the host longitudinal axis and the far visible edge - the visible edge of the front / rear of the target that is not visible. Currently supported for vehicles only.";
CM_ SG_ 154 OBJ_Angle_Side_V_19 "Validator for angleSide.";
CM_ SG_ 154 OBJ_Angle_Side_STD_19 "Standard deviation of angleSide.";
CM_ SG_ 154 OBJ_Angle_Side_STD_V_19 "Validator for the STD of angleSide.";
CM_ SG_ 154 OBJ_Angle_Mid_V_19 "Validator for angleMid.";
CM_ SG_ 154 OBJ_Angle_Mid_19 "The angle between the host longitudinal axis and the middle of the front / rear of the target (the visible one). The positive side is to the host's right.";
CM_ SG_ 154 OBJ_Angle_Mid_STD_19 "Standard deviation of angleMid.";
CM_ SG_ 154 OBJ_Angle_Mid_STD_V_19 "Validator for the STD of angleMid.";
CM_ SG_ 154 OBJ_Angle_Bottom_V_19 "Validator for OBJAngle_Bottom. ";
CM_ SG_ 154 OBJ_Angle_Bottom_19 "The angle between the logitudinal axis and the Bottom of the front / rear of the target (the visible one). The positive side is to the hosts right";
CM_ SG_ 154 OBJ_Angle_Bottom_STD_19 "STD for OBJAngle_Bottom. ";
CM_ SG_ 154 OBJ_Angle_Bottom_STD_V_19 "Validator for OBJAngle_Bottom_STD. ";
CM_ SG_ 154 OBJ_Visibility_Side_V_19 "Currently Supported for VD only";
CM_ SG_ 154 OBJ_Visibility_Side_19 "From what car  side is the object visible";
CM_ SG_ 154 OBJ_Is_In_Drivable_Area_19 "Indicates whether the target is in a driveable area.";
CM_ SG_ 154 OBJ_Is_In_Drivable_Area_V_19 "Validator for OBJ_Is_In_Drivable_Area.";
CM_ SG_ 154 OBJ_Is_VeryClose_19 "Indicates whether the target is very close to the host such that it is hard to measure it's distance. Currently relevant for peds only. ";
CM_ SG_ 154 OBJ_Is_VeryClose_V_19 "Validator for OBJ_Is_VeryClose. ";
CM_ SG_ 154 OBJ_Occlusion_RL_19 "Was Rear left of the 3D detection of theobject occluded";
CM_ SG_ 154 OBJ_Occlusion_RR_19 "Was Rear Right of the 3D detection of theobject occluded";
CM_ SG_ 154 OBJ_Occlusion_FR_19 "Was front Right of the 3D detection of theobject occluded";
CM_ SG_ 154 OBJ_Occlusion_FL_19 "Was Front left of the 3D detection of theobject occluded";
BA_DEF_ SG_  "GenSigStartValue" INT 0 0;
BA_DEF_DEF_  "GenSigStartValue" 0;
BA_ "GenSigStartValue" SG_ 154 OBJ_Width_14 40;
BA_ "GenSigStartValue" SG_ 154 OBJ_Length_14 24;
BA_ "GenSigStartValue" SG_ 154 OBJ_Width_15 40;
BA_ "GenSigStartValue" SG_ 154 OBJ_Length_15 24;
BA_ "GenSigStartValue" SG_ 154 OBJ_Width_16 40;
BA_ "GenSigStartValue" SG_ 154 OBJ_Length_16 24;
BA_ "GenSigStartValue" SG_ 154 OBJ_Width_17 40;
BA_ "GenSigStartValue" SG_ 154 OBJ_Length_17 24;
BA_ "GenSigStartValue" SG_ 154 OBJ_Width_18 40;
BA_ "GenSigStartValue" SG_ 154 OBJ_Length_18 24;
BA_ "GenSigStartValue" SG_ 154 OBJ_Width_19 40;
BA_ "GenSigStartValue" SG_ 154 OBJ_Length_19 24;
VAL_ 154 OBJ_Abs_Lat_Acc_V_13 1 "VALID" 0 "INVALID" ;
VAL_ 154 OBJ_Abs_Lat_Acc_STD_V_13 1 "VALID" 0 "INVALID" ;
VAL_ 154 OBJ_Abs_Acceleration_V_13 1 "VALID" 0 "INVALID" ;
VAL_ 154 OBJ_Abs_Acc_STD_V_13 1 "VALID" 0 "INVALID" ;
VAL_ 154 OBJ_Inv_TTC_V_13 1 "VALID" 0 "INVALID" ;
VAL_ 154 OBJ_Inv_TTC_STD_V_13 1 "VALID" 0 "INVALID" ;
VAL_ 154 OBJ_Relative_Long_Acc_V_13 1 "VALID" 0 "INVALID" ;
VAL_ 154 OBJ_Rel_Long_Acc_STD_V_13 1 "VALID" 0 "INVALID" ;
VAL_ 154 OBJ_Relative_Long_Velocity_V_13 1 "VALID" 0 "INVALID" ;
VAL_ 154 OBJ_Rel_Long_Vel_STD_V_13 1 "VALID" 0 "INVALID" ;
VAL_ 154 OBJ_Relative_Lat_Velocity_V_13 1 "VALID" 0 "INVALID" ;
VAL_ 154 OBJ_Rel_Lat_Vel_STD_V_13 1 "VALID" 0 "INVALID" ;
VAL_ 154 OBJ_Long_Distance_V_13 1 "VALID" 0 "INVALID" ;
VAL_ 154 OBJ_Long_Distance_STD_V_13 1 "VALID" 0 "INVALID" ;
VAL_ 154 OBJ_Lat_Distance_V_13 1 "VALID" 0 "INVALID" ;
VAL_ 154 OBJ_Lat_Distance_STD_V_13 1 "VALID" 0 "INVALID" ;
VAL_ 154 OBJ_Absolute_Speed_V_13 1 "VALID" 0 "INVALID" ;
VAL_ 154 OBJ_Absolute_Speed_STD_V_13 1 "VALID" 0 "INVALID" ;
VAL_ 154 OBJ_Heading_V_13 1 "VALID" 0 "INVALID" ;
VAL_ 154 OBJ_Heading_STD_V_13 1 "VALID" 0 "INVALID" ;
VAL_ 154 OBJ_Angle_Rate_STD_V_13 1 "VALID" 0 "INVALID" ;
VAL_ 154 OBJ_Angle_Rate_V_13 1 "VALID" 0 "INVALID" ;
VAL_ 154 OBJ_Angle_Right_V_13 1 "VALID" 0 "INVALID" ;
VAL_ 154 OBJ_Angle_Right_STD_V_13 1 "VALID" 0 "INVALID" ;
VAL_ 154 OBJ_Angle_Left_V_13 1 "VALID" 0 "INVALID" ;
VAL_ 154 OBJ_Angle_Left_STD_V_13 1 "VALID" 0 "INVALID" ;
VAL_ 154 OBJ_Angle_Side_V_13 1 "VALID" 0 "INVALID" ;
VAL_ 154 OBJ_Angle_Side_STD_V_13 1 "VALID" 0 "INVALID" ;
VAL_ 154 OBJ_Angle_Mid_V_13 1 "VALID" 0 "INVALID" ;
VAL_ 154 OBJ_Angle_Mid_STD_V_13 1 "VALID" 0 "INVALID" ;
VAL_ 154 OBJ_Angle_Bottom_V_13 1 "VALID" 0 "INVALID" ;
VAL_ 154 OBJ_Angle_Bottom_STD_V_13 1 "VALID" 0 "INVALID" ;
VAL_ 154 OBJ_Visibility_Side_V_13 1 "VALID" 0 "INVALID" ;
VAL_ 154 OBJ_Visibility_Side_13 2 "REAR" 1 "FRONT" 0 "NOT_VISIBLE" ;
VAL_ 154 OBJ_Is_In_Drivable_Area_13 1 "TRUE" 0 "FALSE" ;
VAL_ 154 OBJ_Is_In_Drivable_Area_V_13 1 "VALID" 0 "INVALID" ;
VAL_ 154 OBJ_Is_VeryClose_13 1 "TRUE" 0 "FALSE" ;
VAL_ 154 OBJ_Is_VeryClose_V_13 1 "VALID" 0 "INVALID" ;
VAL_ 154 OBJ_Occlusion_RL_13 2 "OCCLUDED" 1 "NOT_OCCLUDED" 0 "NOT_RELEVANT" ;
VAL_ 154 OBJ_Occlusion_RR_13 2 "OCCLUDED" 1 "NOT_OCCLUDED" 0 "NOT_RELEVANT" ;
VAL_ 154 OBJ_Occlusion_FR_13 2 "OCCLUDED" 1 "NOT_OCCLUDED" 0 "NOT_RELEVANT" ;
VAL_ 154 OBJ_Occlusion_FL_13 2 "OCCLUDED" 1 "NOT_OCCLUDED" 0 "NOT_RELEVANT" ;
VAL_ 154 OBJ_Triggered_SDM_14 2 "NOT_TRIGGERED" 1 "TRIGGERED" 0 "NOT_AVAILABLE" ;
VAL_ 154 OBJ_Motion_Category_14 13 "ONCOMING" 12 "PRECEEDING" 11 "MOVING" 10 "RTAP" 9 "LTAP" 8 "CROSSING" 7 "MOVING_OUT" 6 "MOVING_IN" 5 "CLOSE_CUT_IN" 4 "PASSING_OUT" 3 "PASSING_IN" 2 "PASSING" 1 "UNDEFINED" 0 "UNFILLED" ;
VAL_ 154 OBJ_Measuring_Status_14 2 "(BIT_2)NOT_VALID_OR_VALID" 1 "(BIT_1)PREDICTED_OR_MEASURED" 0 "(BIT_0)OLD_OR_NEW" ;
VAL_ 154 OBJ_Object_Class_14 8 "UNCERTAIN_VCL" 7 "ANIMAL" 6 "GENERAL_OBJECT" 5 "PEDESTRIAN" 4 "BICYCLE" 3 "MOTORBIKE" 2 "TRUCK" 1 "CAR" 0 "UNFILLED" ;
VAL_ 154 OBJ_Camera_Source_14 11 "PARKING_RIGHT" 10 "PARKING_LEFT" 9 "PARKING_REAR" 8 "PARKING_FRONT" 7 "FRONT_CORNER_RIGHT" 6 "FRONT_CORNER_LEFT" 5 "REAR_CORNER_RIGHT" 4 "REAR_CORNER_LEFT" 3 "REAR" 2 "FRONT_FISHEYE" 1 "FRONT_NARROW" 0 "FRONT_MAIN" ;
VAL_ 154 OBJ_Motion_Status_14 5 "MOVING_SLOWLY" 4 "STOPPED" 3 "STATIONARY" 2 "MOVING" 1 "UNKNOWN" 0 "INVALID" ;
VAL_ 154 OBJ_Motion_Orientation_14 13 "UNKNOWN" 12 "PRECEEDING" 11 "DRIFTING_LEFT" 9 "CROSSING_LEFT" 7 "OC_DRIFTING_LEFT" 6 "ONCOMING" 5 "OC_DRIFTING_RIGHT" 3 "CROSSING_RIGHT" 1 "DRIFTING_RIGHT" 0 "INVALID" ;
VAL_ 154 OBJ_Has_Cut_Lane_14 1 "TRUE" 0 "FALSE" ;
VAL_ 154 OBJ_Has_Cut_Path_14 1 "TRUE" 0 "FALSE" ;
VAL_ 154 OBJ_Brake_Light_14 1 "TRUE" 0 "FALSE" ;
VAL_ 154 OBJ_Turn_Indicator_Right_14 1 "TRUE" 0 "FALSE" ;
VAL_ 154 OBJ_Turn_Indicator_Left_14 1 "TRUE" 0 "FALSE" ;
VAL_ 154 OBJ_Light_Indicator_Validity_14 1 "TRUE" 0 "FALSE" ;
VAL_ 154 OBJ_Right_Out_Of_Image_14 1 "TRUE" 0 "FALSE" ;
VAL_ 154 OBJ_Left_Out_Of_Image_14 1 "TRUE" 0 "FALSE" ;
VAL_ 154 OBJ_Right_Out_Of_Image_V_14 1 "TRUE" 0 "FALSE" ;
VAL_ 154 OBJ_Left_Out_Of_Image_V_14 1 "TRUE" 0 "FALSE" ;
VAL_ 154 OBJ_Top_Out_Of_Image_14 1 "TRUE" 0 "FALSE" ;
VAL_ 154 OBJ_Bottom_Out_Of_Image_14 1 "TRUE" 0 "FALSE" ;
VAL_ 154 OBJ_Top_Out_Of_Image_V_14 1 "VALID" 0 "INVALID" ;
VAL_ 154 OBJ_Bottom_Out_Of_Image_V_14 1 "VALID" 0 "INVALID" ;
VAL_ 154 OBJ_Lane_Assignment_14 5 "RIGHT_RIGHT" 4 "RIGHT" 3 "HOST" 2 "LEFT" 1 "LEFT_LEFT" 0 "UNKNOWN" ;
VAL_ 154 OBJ_Lane_Assignment_V_14 1 "VALID" 0 "INVALID" ;
VAL_ 154 OBJ_Age_Seconds_V_14 1 "VALID" 0 "INVALID" ;
VAL_ 154 OBJ_Width_V_14 1 "VALID" 0 "INVALID" ;
VAL_ 154 OBJ_Width_STD_V_14 1 "VALID" 0 "INVALID" ;
VAL_ 154 OBJ_Length_V_14 1 "VALID" 0 "INVALID" ;
VAL_ 154 OBJ_Length_STD_V_14 1 "VALID" 0 "INVALID" ;
VAL_ 154 OBJ_Height_V_14 1 "VALID" 0 "INVALID" ;
VAL_ 154 OBJ_Height_STD_V_14 1 "VALID" 0 "INVALID" ;
VAL_ 154 OBJ_Abs_Long_Velocity_V_14 1 "VALID" 0 "INVALID" ;
VAL_ 154 OBJ_Abs_Long_Vel_STD_V_14 1 "VALID" 0 "INVALID" ;
VAL_ 154 OBJ_Abs_Lat_Velocity_V_14 1 "VALID" 0 "INVALID" ;
VAL_ 154 OBJ_Abs_Lat_Vel_STD_V_14 1 "VALID" 0 "INVALID" ;
VAL_ 154 OBJ_Abs_Long_Acc_V_14 1 "VALID" 0 "INVALID" ;
VAL_ 154 OBJ_Abs_Long_Acc_STD_V_14 1 "VALID" 0 "INVALID" ;
VAL_ 154 OBJ_Abs_Lat_Acc_V_14 1 "VALID" 0 "INVALID" ;
VAL_ 154 OBJ_Abs_Lat_Acc_STD_V_14 1 "VALID" 0 "INVALID" ;
VAL_ 154 OBJ_Abs_Acceleration_V_14 1 "VALID" 0 "INVALID" ;
VAL_ 154 OBJ_Abs_Acc_STD_V_14 1 "VALID" 0 "INVALID" ;
VAL_ 154 OBJ_Inv_TTC_V_14 1 "VALID" 0 "INVALID" ;
VAL_ 154 OBJ_Inv_TTC_STD_V_14 1 "VALID" 0 "INVALID" ;
VAL_ 154 OBJ_Relative_Long_Acc_V_14 1 "VALID" 0 "INVALID" ;
VAL_ 154 OBJ_Rel_Long_Acc_STD_V_14 1 "VALID" 0 "INVALID" ;
VAL_ 154 OBJ_Relative_Long_Velocity_V_14 1 "VALID" 0 "INVALID" ;
VAL_ 154 OBJ_Rel_Long_Vel_STD_V_14 1 "VALID" 0 "INVALID" ;
VAL_ 154 OBJ_Relative_Lat_Velocity_V_14 1 "VALID" 0 "INVALID" ;
VAL_ 154 OBJ_Rel_Lat_Vel_STD_V_14 1 "VALID" 0 "INVALID" ;
VAL_ 154 OBJ_Long_Distance_V_14 1 "VALID" 0 "INVALID" ;
VAL_ 154 OBJ_Long_Distance_STD_V_14 1 "VALID" 0 "INVALID" ;
VAL_ 154 OBJ_Lat_Distance_V_14 1 "VALID" 0 "INVALID" ;
VAL_ 154 OBJ_Lat_Distance_STD_V_14 1 "VALID" 0 "INVALID" ;
VAL_ 154 OBJ_Absolute_Speed_V_14 1 "VALID" 0 "INVALID" ;
VAL_ 154 OBJ_Absolute_Speed_STD_V_14 1 "VALID" 0 "INVALID" ;
VAL_ 154 OBJ_Heading_V_14 1 "VALID" 0 "INVALID" ;
VAL_ 154 OBJ_Heading_STD_V_14 1 "VALID" 0 "INVALID" ;
VAL_ 154 OBJ_Angle_Rate_STD_V_14 1 "VALID" 0 "INVALID" ;
VAL_ 154 OBJ_Angle_Rate_V_14 1 "VALID" 0 "INVALID" ;
VAL_ 154 OBJ_Angle_Right_V_14 1 "VALID" 0 "INVALID" ;
VAL_ 154 OBJ_Angle_Right_STD_V_14 1 "VALID" 0 "INVALID" ;
VAL_ 154 OBJ_Angle_Left_V_14 1 "VALID" 0 "INVALID" ;
VAL_ 154 OBJ_Angle_Left_STD_V_14 1 "VALID" 0 "INVALID" ;
VAL_ 154 OBJ_Angle_Side_V_14 1 "VALID" 0 "INVALID" ;
VAL_ 154 OBJ_Angle_Side_STD_V_14 1 "VALID" 0 "INVALID" ;
VAL_ 154 OBJ_Angle_Mid_V_14 1 "VALID" 0 "INVALID" ;
VAL_ 154 OBJ_Angle_Mid_STD_V_14 1 "VALID" 0 "INVALID" ;
VAL_ 154 OBJ_Angle_Bottom_V_14 1 "VALID" 0 "INVALID" ;
VAL_ 154 OBJ_Angle_Bottom_STD_V_14 1 "VALID" 0 "INVALID" ;
VAL_ 154 OBJ_Visibility_Side_V_14 1 "VALID" 0 "INVALID" ;
VAL_ 154 OBJ_Visibility_Side_14 2 "REAR" 1 "FRONT" 0 "NOT_VISIBLE" ;
VAL_ 154 OBJ_Is_In_Drivable_Area_14 1 "TRUE" 0 "FALSE" ;
VAL_ 154 OBJ_Is_In_Drivable_Area_V_14 1 "VALID" 0 "INVALID" ;
VAL_ 154 OBJ_Is_VeryClose_14 1 "TRUE" 0 "FALSE" ;
VAL_ 154 OBJ_Is_VeryClose_V_14 1 "VALID" 0 "INVALID" ;
VAL_ 154 OBJ_Occlusion_RL_14 2 "OCCLUDED" 1 "NOT_OCCLUDED" 0 "NOT_RELEVANT" ;
VAL_ 154 OBJ_Occlusion_RR_14 2 "OCCLUDED" 1 "NOT_OCCLUDED" 0 "NOT_RELEVANT" ;
VAL_ 154 OBJ_Occlusion_FR_14 2 "OCCLUDED" 1 "NOT_OCCLUDED" 0 "NOT_RELEVANT" ;
VAL_ 154 OBJ_Occlusion_FL_14 2 "OCCLUDED" 1 "NOT_OCCLUDED" 0 "NOT_RELEVANT" ;
VAL_ 154 OBJ_Triggered_SDM_15 2 "NOT_TRIGGERED" 1 "TRIGGERED" 0 "NOT_AVAILABLE" ;
VAL_ 154 OBJ_Motion_Category_15 13 "ONCOMING" 12 "PRECEEDING" 11 "MOVING" 10 "RTAP" 9 "LTAP" 8 "CROSSING" 7 "MOVING_OUT" 6 "MOVING_IN" 5 "CLOSE_CUT_IN" 4 "PASSING_OUT" 3 "PASSING_IN" 2 "PASSING" 1 "UNDEFINED" 0 "UNFILLED" ;
VAL_ 154 OBJ_Measuring_Status_15 2 "(BIT_2)NOT_VALID_OR_VALID" 1 "(BIT_1)PREDICTED_OR_MEASURED" 0 "(BIT_0)OLD_OR_NEW" ;
VAL_ 154 OBJ_Object_Class_15 8 "UNCERTAIN_VCL" 7 "ANIMAL" 6 "GENERAL_OBJECT" 5 "PEDESTRIAN" 4 "BICYCLE" 3 "MOTORBIKE" 2 "TRUCK" 1 "CAR" 0 "UNFILLED" ;
VAL_ 154 OBJ_Camera_Source_15 11 "PARKING_RIGHT" 10 "PARKING_LEFT" 9 "PARKING_REAR" 8 "PARKING_FRONT" 7 "FRONT_CORNER_RIGHT" 6 "FRONT_CORNER_LEFT" 5 "REAR_CORNER_RIGHT" 4 "REAR_CORNER_LEFT" 3 "REAR" 2 "FRONT_FISHEYE" 1 "FRONT_NARROW" 0 "FRONT_MAIN" ;
VAL_ 154 OBJ_Motion_Status_15 5 "MOVING_SLOWLY" 4 "STOPPED" 3 "STATIONARY" 2 "MOVING" 1 "UNKNOWN" 0 "INVALID" ;
VAL_ 154 OBJ_Motion_Orientation_15 13 "UNKNOWN" 12 "PRECEEDING" 11 "DRIFTING_LEFT" 9 "CROSSING_LEFT" 7 "OC_DRIFTING_LEFT" 6 "ONCOMING" 5 "OC_DRIFTING_RIGHT" 3 "CROSSING_RIGHT" 1 "DRIFTING_RIGHT" 0 "INVALID" ;
VAL_ 154 OBJ_Has_Cut_Lane_15 1 "TRUE" 0 "FALSE" ;
VAL_ 154 OBJ_Has_Cut_Path_15 1 "TRUE" 0 "FALSE" ;
VAL_ 154 OBJ_Brake_Light_15 1 "TRUE" 0 "FALSE" ;
VAL_ 154 OBJ_Turn_Indicator_Right_15 1 "TRUE" 0 "FALSE" ;
VAL_ 154 OBJ_Turn_Indicator_Left_15 1 "TRUE" 0 "FALSE" ;
VAL_ 154 OBJ_Light_Indicator_Validity_15 1 "TRUE" 0 "FALSE" ;
VAL_ 154 OBJ_Right_Out_Of_Image_15 1 "TRUE" 0 "FALSE" ;
VAL_ 154 OBJ_Left_Out_Of_Image_15 1 "TRUE" 0 "FALSE" ;
VAL_ 154 OBJ_Right_Out_Of_Image_V_15 1 "TRUE" 0 "FALSE" ;
VAL_ 154 OBJ_Left_Out_Of_Image_V_15 1 "TRUE" 0 "FALSE" ;
VAL_ 154 OBJ_Top_Out_Of_Image_15 1 "TRUE" 0 "FALSE" ;
VAL_ 154 OBJ_Bottom_Out_Of_Image_15 1 "TRUE" 0 "FALSE" ;
VAL_ 154 OBJ_Top_Out_Of_Image_V_15 1 "VALID" 0 "INVALID" ;
VAL_ 154 OBJ_Bottom_Out_Of_Image_V_15 1 "VALID" 0 "INVALID" ;
VAL_ 154 OBJ_Lane_Assignment_15 5 "RIGHT_RIGHT" 4 "RIGHT" 3 "HOST" 2 "LEFT" 1 "LEFT_LEFT" 0 "UNKNOWN" ;
VAL_ 154 OBJ_Lane_Assignment_V_15 1 "VALID" 0 "INVALID" ;
VAL_ 154 OBJ_Age_Seconds_V_15 1 "VALID" 0 "INVALID" ;
VAL_ 154 OBJ_Width_V_15 1 "VALID" 0 "INVALID" ;
VAL_ 154 OBJ_Width_STD_V_15 1 "VALID" 0 "INVALID" ;
VAL_ 154 OBJ_Length_V_15 1 "VALID" 0 "INVALID" ;
VAL_ 154 OBJ_Length_STD_V_15 1 "VALID" 0 "INVALID" ;
VAL_ 154 OBJ_Height_V_15 1 "VALID" 0 "INVALID" ;
VAL_ 154 OBJ_Height_STD_V_15 1 "VALID" 0 "INVALID" ;
VAL_ 154 OBJ_Abs_Long_Velocity_V_15 1 "VALID" 0 "INVALID" ;
VAL_ 154 OBJ_Abs_Long_Vel_STD_V_15 1 "VALID" 0 "INVALID" ;
VAL_ 154 OBJ_Abs_Lat_Velocity_V_15 1 "VALID" 0 "INVALID" ;
VAL_ 154 OBJ_Abs_Lat_Vel_STD_V_15 1 "VALID" 0 "INVALID" ;
VAL_ 154 OBJ_Abs_Long_Acc_V_15 1 "VALID" 0 "INVALID" ;
VAL_ 154 OBJ_Abs_Long_Acc_STD_V_15 1 "VALID" 0 "INVALID" ;
VAL_ 154 OBJ_Abs_Lat_Acc_V_15 1 "VALID" 0 "INVALID" ;
VAL_ 154 OBJ_Abs_Lat_Acc_STD_V_15 1 "VALID" 0 "INVALID" ;
VAL_ 154 OBJ_Abs_Acceleration_V_15 1 "VALID" 0 "INVALID" ;
VAL_ 154 OBJ_Abs_Acc_STD_V_15 1 "VALID" 0 "INVALID" ;
VAL_ 154 OBJ_Inv_TTC_V_15 1 "VALID" 0 "INVALID" ;
VAL_ 154 OBJ_Inv_TTC_STD_V_15 1 "VALID" 0 "INVALID" ;
VAL_ 154 OBJ_Relative_Long_Acc_V_15 1 "VALID" 0 "INVALID" ;
VAL_ 154 OBJ_Rel_Long_Acc_STD_V_15 1 "VALID" 0 "INVALID" ;
VAL_ 154 OBJ_Relative_Long_Velocity_V_15 1 "VALID" 0 "INVALID" ;
VAL_ 154 OBJ_Rel_Long_Vel_STD_V_15 1 "VALID" 0 "INVALID" ;
VAL_ 154 OBJ_Relative_Lat_Velocity_V_15 1 "VALID" 0 "INVALID" ;
VAL_ 154 OBJ_Rel_Lat_Vel_STD_V_15 1 "VALID" 0 "INVALID" ;
VAL_ 154 OBJ_Long_Distance_V_15 1 "VALID" 0 "INVALID" ;
VAL_ 154 OBJ_Long_Distance_STD_V_15 1 "VALID" 0 "INVALID" ;
VAL_ 154 OBJ_Lat_Distance_V_15 1 "VALID" 0 "INVALID" ;
VAL_ 154 OBJ_Lat_Distance_STD_V_15 1 "VALID" 0 "INVALID" ;
VAL_ 154 OBJ_Absolute_Speed_V_15 1 "VALID" 0 "INVALID" ;
VAL_ 154 OBJ_Absolute_Speed_STD_V_15 1 "VALID" 0 "INVALID" ;
VAL_ 154 OBJ_Heading_V_15 1 "VALID" 0 "INVALID" ;
VAL_ 154 OBJ_Heading_STD_V_15 1 "VALID" 0 "INVALID" ;
VAL_ 154 OBJ_Angle_Rate_STD_V_15 1 "VALID" 0 "INVALID" ;
VAL_ 154 OBJ_Angle_Rate_V_15 1 "VALID" 0 "INVALID" ;
VAL_ 154 OBJ_Angle_Right_V_15 1 "VALID" 0 "INVALID" ;
VAL_ 154 OBJ_Angle_Right_STD_V_15 1 "VALID" 0 "INVALID" ;
VAL_ 154 OBJ_Angle_Left_V_15 1 "VALID" 0 "INVALID" ;
VAL_ 154 OBJ_Angle_Left_STD_V_15 1 "VALID" 0 "INVALID" ;
VAL_ 154 OBJ_Angle_Side_V_15 1 "VALID" 0 "INVALID" ;
VAL_ 154 OBJ_Angle_Side_STD_V_15 1 "VALID" 0 "INVALID" ;
VAL_ 154 OBJ_Angle_Mid_V_15 1 "VALID" 0 "INVALID" ;
VAL_ 154 OBJ_Angle_Mid_STD_V_15 1 "VALID" 0 "INVALID" ;
VAL_ 154 OBJ_Angle_Bottom_V_15 1 "VALID" 0 "INVALID" ;
VAL_ 154 OBJ_Angle_Bottom_STD_V_15 1 "VALID" 0 "INVALID" ;
VAL_ 154 OBJ_Visibility_Side_V_15 1 "VALID" 0 "INVALID" ;
VAL_ 154 OBJ_Visibility_Side_15 2 "REAR" 1 "FRONT" 0 "NOT_VISIBLE" ;
VAL_ 154 OBJ_Is_In_Drivable_Area_15 1 "TRUE" 0 "FALSE" ;
VAL_ 154 OBJ_Is_In_Drivable_Area_V_15 1 "VALID" 0 "INVALID" ;
VAL_ 154 OBJ_Is_VeryClose_15 1 "TRUE" 0 "FALSE" ;
VAL_ 154 OBJ_Is_VeryClose_V_15 1 "VALID" 0 "INVALID" ;
VAL_ 154 OBJ_Occlusion_RL_15 2 "OCCLUDED" 1 "NOT_OCCLUDED" 0 "NOT_RELEVANT" ;
VAL_ 154 OBJ_Occlusion_RR_15 2 "OCCLUDED" 1 "NOT_OCCLUDED" 0 "NOT_RELEVANT" ;
VAL_ 154 OBJ_Occlusion_FR_15 2 "OCCLUDED" 1 "NOT_OCCLUDED" 0 "NOT_RELEVANT" ;
VAL_ 154 OBJ_Occlusion_FL_15 2 "OCCLUDED" 1 "NOT_OCCLUDED" 0 "NOT_RELEVANT" ;
VAL_ 154 OBJ_Triggered_SDM_16 2 "NOT_TRIGGERED" 1 "TRIGGERED" 0 "NOT_AVAILABLE" ;
VAL_ 154 OBJ_Motion_Category_16 13 "ONCOMING" 12 "PRECEEDING" 11 "MOVING" 10 "RTAP" 9 "LTAP" 8 "CROSSING" 7 "MOVING_OUT" 6 "MOVING_IN" 5 "CLOSE_CUT_IN" 4 "PASSING_OUT" 3 "PASSING_IN" 2 "PASSING" 1 "UNDEFINED" 0 "UNFILLED" ;
VAL_ 154 OBJ_Measuring_Status_16 2 "(BIT_2)NOT_VALID_OR_VALID" 1 "(BIT_1)PREDICTED_OR_MEASURED" 0 "(BIT_0)OLD_OR_NEW" ;
VAL_ 154 OBJ_Object_Class_16 8 "UNCERTAIN_VCL" 7 "ANIMAL" 6 "GENERAL_OBJECT" 5 "PEDESTRIAN" 4 "BICYCLE" 3 "MOTORBIKE" 2 "TRUCK" 1 "CAR" 0 "UNFILLED" ;
VAL_ 154 OBJ_Camera_Source_16 11 "PARKING_RIGHT" 10 "PARKING_LEFT" 9 "PARKING_REAR" 8 "PARKING_FRONT" 7 "FRONT_CORNER_RIGHT" 6 "FRONT_CORNER_LEFT" 5 "REAR_CORNER_RIGHT" 4 "REAR_CORNER_LEFT" 3 "REAR" 2 "FRONT_FISHEYE" 1 "FRONT_NARROW" 0 "FRONT_MAIN" ;
VAL_ 154 OBJ_Motion_Status_16 5 "MOVING_SLOWLY" 4 "STOPPED" 3 "STATIONARY" 2 "MOVING" 1 "UNKNOWN" 0 "INVALID" ;
VAL_ 154 OBJ_Motion_Orientation_16 13 "UNKNOWN" 12 "PRECEEDING" 11 "DRIFTING_LEFT" 9 "CROSSING_LEFT" 7 "OC_DRIFTING_LEFT" 6 "ONCOMING" 5 "OC_DRIFTING_RIGHT" 3 "CROSSING_RIGHT" 1 "DRIFTING_RIGHT" 0 "INVALID" ;
VAL_ 154 OBJ_Has_Cut_Lane_16 1 "TRUE" 0 "FALSE" ;
VAL_ 154 OBJ_Has_Cut_Path_16 1 "TRUE" 0 "FALSE" ;
VAL_ 154 OBJ_Brake_Light_16 1 "TRUE" 0 "FALSE" ;
VAL_ 154 OBJ_Turn_Indicator_Right_16 1 "TRUE" 0 "FALSE" ;
VAL_ 154 OBJ_Turn_Indicator_Left_16 1 "TRUE" 0 "FALSE" ;
VAL_ 154 OBJ_Light_Indicator_Validity_16 1 "TRUE" 0 "FALSE" ;
VAL_ 154 OBJ_Right_Out_Of_Image_16 1 "TRUE" 0 "FALSE" ;
VAL_ 154 OBJ_Left_Out_Of_Image_16 1 "TRUE" 0 "FALSE" ;
VAL_ 154 OBJ_Right_Out_Of_Image_V_16 1 "TRUE" 0 "FALSE" ;
VAL_ 154 OBJ_Left_Out_Of_Image_V_16 1 "TRUE" 0 "FALSE" ;
VAL_ 154 OBJ_Top_Out_Of_Image_16 1 "TRUE" 0 "FALSE" ;
VAL_ 154 OBJ_Bottom_Out_Of_Image_16 1 "TRUE" 0 "FALSE" ;
VAL_ 154 OBJ_Top_Out_Of_Image_V_16 1 "VALID" 0 "INVALID" ;
VAL_ 154 OBJ_Bottom_Out_Of_Image_V_16 1 "VALID" 0 "INVALID" ;
VAL_ 154 OBJ_Lane_Assignment_16 5 "RIGHT_RIGHT" 4 "RIGHT" 3 "HOST" 2 "LEFT" 1 "LEFT_LEFT" 0 "UNKNOWN" ;
VAL_ 154 OBJ_Lane_Assignment_V_16 1 "VALID" 0 "INVALID" ;
VAL_ 154 OBJ_Age_Seconds_V_16 1 "VALID" 0 "INVALID" ;
VAL_ 154 OBJ_Width_V_16 1 "VALID" 0 "INVALID" ;
VAL_ 154 OBJ_Width_STD_V_16 1 "VALID" 0 "INVALID" ;
VAL_ 154 OBJ_Length_V_16 1 "VALID" 0 "INVALID" ;
VAL_ 154 OBJ_Length_STD_V_16 1 "VALID" 0 "INVALID" ;
VAL_ 154 OBJ_Height_V_16 1 "VALID" 0 "INVALID" ;
VAL_ 154 OBJ_Height_STD_V_16 1 "VALID" 0 "INVALID" ;
VAL_ 154 OBJ_Abs_Long_Velocity_V_16 1 "VALID" 0 "INVALID" ;
VAL_ 154 OBJ_Abs_Long_Vel_STD_V_16 1 "VALID" 0 "INVALID" ;
VAL_ 154 OBJ_Abs_Lat_Velocity_V_16 1 "VALID" 0 "INVALID" ;
VAL_ 154 OBJ_Abs_Lat_Vel_STD_V_16 1 "VALID" 0 "INVALID" ;
VAL_ 154 OBJ_Abs_Long_Acc_V_16 1 "VALID" 0 "INVALID" ;
VAL_ 154 OBJ_Abs_Long_Acc_STD_V_16 1 "VALID" 0 "INVALID" ;
VAL_ 154 OBJ_Abs_Lat_Acc_V_16 1 "VALID" 0 "INVALID" ;
VAL_ 154 OBJ_Abs_Lat_Acc_STD_V_16 1 "VALID" 0 "INVALID" ;
VAL_ 154 OBJ_Abs_Acceleration_V_16 1 "VALID" 0 "INVALID" ;
VAL_ 154 OBJ_Abs_Acc_STD_V_16 1 "VALID" 0 "INVALID" ;
VAL_ 154 OBJ_Inv_TTC_V_16 1 "VALID" 0 "INVALID" ;
VAL_ 154 OBJ_Inv_TTC_STD_V_16 1 "VALID" 0 "INVALID" ;
VAL_ 154 OBJ_Relative_Long_Acc_V_16 1 "VALID" 0 "INVALID" ;
VAL_ 154 OBJ_Rel_Long_Acc_STD_V_16 1 "VALID" 0 "INVALID" ;
VAL_ 154 OBJ_Relative_Long_Velocity_V_16 1 "VALID" 0 "INVALID" ;
VAL_ 154 OBJ_Rel_Long_Vel_STD_V_16 1 "VALID" 0 "INVALID" ;
VAL_ 154 OBJ_Relative_Lat_Velocity_V_16 1 "VALID" 0 "INVALID" ;
VAL_ 154 OBJ_Rel_Lat_Vel_STD_V_16 1 "VALID" 0 "INVALID" ;
VAL_ 154 OBJ_Long_Distance_V_16 1 "VALID" 0 "INVALID" ;
VAL_ 154 OBJ_Long_Distance_STD_V_16 1 "VALID" 0 "INVALID" ;
VAL_ 154 OBJ_Lat_Distance_V_16 1 "VALID" 0 "INVALID" ;
VAL_ 154 OBJ_Lat_Distance_STD_V_16 1 "VALID" 0 "INVALID" ;
VAL_ 154 OBJ_Absolute_Speed_V_16 1 "VALID" 0 "INVALID" ;
VAL_ 154 OBJ_Absolute_Speed_STD_V_16 1 "VALID" 0 "INVALID" ;
VAL_ 154 OBJ_Heading_V_16 1 "VALID" 0 "INVALID" ;
VAL_ 154 OBJ_Heading_STD_V_16 1 "VALID" 0 "INVALID" ;
VAL_ 154 OBJ_Angle_Rate_STD_V_16 1 "VALID" 0 "INVALID" ;
VAL_ 154 OBJ_Angle_Rate_V_16 1 "VALID" 0 "INVALID" ;
VAL_ 154 OBJ_Angle_Right_V_16 1 "VALID" 0 "INVALID" ;
VAL_ 154 OBJ_Angle_Right_STD_V_16 1 "VALID" 0 "INVALID" ;
VAL_ 154 OBJ_Angle_Left_V_16 1 "VALID" 0 "INVALID" ;
VAL_ 154 OBJ_Angle_Left_STD_V_16 1 "VALID" 0 "INVALID" ;
VAL_ 154 OBJ_Angle_Side_V_16 1 "VALID" 0 "INVALID" ;
VAL_ 154 OBJ_Angle_Side_STD_V_16 1 "VALID" 0 "INVALID" ;
VAL_ 154 OBJ_Angle_Mid_V_16 1 "VALID" 0 "INVALID" ;
VAL_ 154 OBJ_Angle_Mid_STD_V_16 1 "VALID" 0 "INVALID" ;
VAL_ 154 OBJ_Angle_Bottom_V_16 1 "VALID" 0 "INVALID" ;
VAL_ 154 OBJ_Angle_Bottom_STD_V_16 1 "VALID" 0 "INVALID" ;
VAL_ 154 OBJ_Visibility_Side_V_16 1 "VALID" 0 "INVALID" ;
VAL_ 154 OBJ_Visibility_Side_16 2 "REAR" 1 "FRONT" 0 "NOT_VISIBLE" ;
VAL_ 154 OBJ_Is_In_Drivable_Area_16 1 "TRUE" 0 "FALSE" ;
VAL_ 154 OBJ_Is_In_Drivable_Area_V_16 1 "VALID" 0 "INVALID" ;
VAL_ 154 OBJ_Is_VeryClose_16 1 "TRUE" 0 "FALSE" ;
VAL_ 154 OBJ_Is_VeryClose_V_16 1 "VALID" 0 "INVALID" ;
VAL_ 154 OBJ_Occlusion_RL_16 2 "OCCLUDED" 1 "NOT_OCCLUDED" 0 "NOT_RELEVANT" ;
VAL_ 154 OBJ_Occlusion_RR_16 2 "OCCLUDED" 1 "NOT_OCCLUDED" 0 "NOT_RELEVANT" ;
VAL_ 154 OBJ_Occlusion_FR_16 2 "OCCLUDED" 1 "NOT_OCCLUDED" 0 "NOT_RELEVANT" ;
VAL_ 154 OBJ_Occlusion_FL_16 2 "OCCLUDED" 1 "NOT_OCCLUDED" 0 "NOT_RELEVANT" ;
VAL_ 154 OBJ_Triggered_SDM_17 2 "NOT_TRIGGERED" 1 "TRIGGERED" 0 "NOT_AVAILABLE" ;
VAL_ 154 OBJ_Motion_Category_17 13 "ONCOMING" 12 "PRECEEDING" 11 "MOVING" 10 "RTAP" 9 "LTAP" 8 "CROSSING" 7 "MOVING_OUT" 6 "MOVING_IN" 5 "CLOSE_CUT_IN" 4 "PASSING_OUT" 3 "PASSING_IN" 2 "PASSING" 1 "UNDEFINED" 0 "UNFILLED" ;
VAL_ 154 OBJ_Measuring_Status_17 2 "(BIT_2)NOT_VALID_OR_VALID" 1 "(BIT_1)PREDICTED_OR_MEASURED" 0 "(BIT_0)OLD_OR_NEW" ;
VAL_ 154 OBJ_Object_Class_17 8 "UNCERTAIN_VCL" 7 "ANIMAL" 6 "GENERAL_OBJECT" 5 "PEDESTRIAN" 4 "BICYCLE" 3 "MOTORBIKE" 2 "TRUCK" 1 "CAR" 0 "UNFILLED" ;
VAL_ 154 OBJ_Camera_Source_17 11 "PARKING_RIGHT" 10 "PARKING_LEFT" 9 "PARKING_REAR" 8 "PARKING_FRONT" 7 "FRONT_CORNER_RIGHT" 6 "FRONT_CORNER_LEFT" 5 "REAR_CORNER_RIGHT" 4 "REAR_CORNER_LEFT" 3 "REAR" 2 "FRONT_FISHEYE" 1 "FRONT_NARROW" 0 "FRONT_MAIN" ;
VAL_ 154 OBJ_Motion_Status_17 5 "MOVING_SLOWLY" 4 "STOPPED" 3 "STATIONARY" 2 "MOVING" 1 "UNKNOWN" 0 "INVALID" ;
VAL_ 154 OBJ_Motion_Orientation_17 13 "UNKNOWN" 12 "PRECEEDING" 11 "DRIFTING_LEFT" 9 "CROSSING_LEFT" 7 "OC_DRIFTING_LEFT" 6 "ONCOMING" 5 "OC_DRIFTING_RIGHT" 3 "CROSSING_RIGHT" 1 "DRIFTING_RIGHT" 0 "INVALID" ;
VAL_ 154 OBJ_Has_Cut_Lane_17 1 "TRUE" 0 "FALSE" ;
VAL_ 154 OBJ_Has_Cut_Path_17 1 "TRUE" 0 "FALSE" ;
VAL_ 154 OBJ_Brake_Light_17 1 "TRUE" 0 "FALSE" ;
VAL_ 154 OBJ_Turn_Indicator_Right_17 1 "TRUE" 0 "FALSE" ;
VAL_ 154 OBJ_Turn_Indicator_Left_17 1 "TRUE" 0 "FALSE" ;
VAL_ 154 OBJ_Light_Indicator_Validity_17 1 "TRUE" 0 "FALSE" ;
VAL_ 154 OBJ_Right_Out_Of_Image_17 1 "TRUE" 0 "FALSE" ;
VAL_ 154 OBJ_Left_Out_Of_Image_17 1 "TRUE" 0 "FALSE" ;
VAL_ 154 OBJ_Right_Out_Of_Image_V_17 1 "TRUE" 0 "FALSE" ;
VAL_ 154 OBJ_Left_Out_Of_Image_V_17 1 "TRUE" 0 "FALSE" ;
VAL_ 154 OBJ_Top_Out_Of_Image_17 1 "TRUE" 0 "FALSE" ;
VAL_ 154 OBJ_Bottom_Out_Of_Image_17 1 "TRUE" 0 "FALSE" ;
VAL_ 154 OBJ_Top_Out_Of_Image_V_17 1 "VALID" 0 "INVALID" ;
VAL_ 154 OBJ_Bottom_Out_Of_Image_V_17 1 "VALID" 0 "INVALID" ;
VAL_ 154 OBJ_Lane_Assignment_17 5 "RIGHT_RIGHT" 4 "RIGHT" 3 "HOST" 2 "LEFT" 1 "LEFT_LEFT" 0 "UNKNOWN" ;
VAL_ 154 OBJ_Lane_Assignment_V_17 1 "VALID" 0 "INVALID" ;
VAL_ 154 OBJ_Age_Seconds_V_17 1 "VALID" 0 "INVALID" ;
VAL_ 154 OBJ_Width_V_17 1 "VALID" 0 "INVALID" ;
VAL_ 154 OBJ_Width_STD_V_17 1 "VALID" 0 "INVALID" ;
VAL_ 154 OBJ_Length_V_17 1 "VALID" 0 "INVALID" ;
VAL_ 154 OBJ_Length_STD_V_17 1 "VALID" 0 "INVALID" ;
VAL_ 154 OBJ_Height_V_17 1 "VALID" 0 "INVALID" ;
VAL_ 154 OBJ_Height_STD_V_17 1 "VALID" 0 "INVALID" ;
VAL_ 154 OBJ_Abs_Long_Velocity_V_17 1 "VALID" 0 "INVALID" ;
VAL_ 154 OBJ_Abs_Long_Vel_STD_V_17 1 "VALID" 0 "INVALID" ;
VAL_ 154 OBJ_Abs_Lat_Velocity_V_17 1 "VALID" 0 "INVALID" ;
VAL_ 154 OBJ_Abs_Lat_Vel_STD_V_17 1 "VALID" 0 "INVALID" ;
VAL_ 154 OBJ_Abs_Long_Acc_V_17 1 "VALID" 0 "INVALID" ;
VAL_ 154 OBJ_Abs_Long_Acc_STD_V_17 1 "VALID" 0 "INVALID" ;
VAL_ 154 OBJ_Abs_Lat_Acc_V_17 1 "VALID" 0 "INVALID" ;
VAL_ 154 OBJ_Abs_Lat_Acc_STD_V_17 1 "VALID" 0 "INVALID" ;
VAL_ 154 OBJ_Abs_Acceleration_V_17 1 "VALID" 0 "INVALID" ;
VAL_ 154 OBJ_Abs_Acc_STD_V_17 1 "VALID" 0 "INVALID" ;
VAL_ 154 OBJ_Inv_TTC_V_17 1 "VALID" 0 "INVALID" ;
VAL_ 154 OBJ_Inv_TTC_STD_V_17 1 "VALID" 0 "INVALID" ;
VAL_ 154 OBJ_Relative_Long_Acc_V_17 1 "VALID" 0 "INVALID" ;
VAL_ 154 OBJ_Rel_Long_Acc_STD_V_17 1 "VALID" 0 "INVALID" ;
VAL_ 154 OBJ_Relative_Long_Velocity_V_17 1 "VALID" 0 "INVALID" ;
VAL_ 154 OBJ_Rel_Long_Vel_STD_V_17 1 "VALID" 0 "INVALID" ;
VAL_ 154 OBJ_Relative_Lat_Velocity_V_17 1 "VALID" 0 "INVALID" ;
VAL_ 154 OBJ_Rel_Lat_Vel_STD_V_17 1 "VALID" 0 "INVALID" ;
VAL_ 154 OBJ_Long_Distance_V_17 1 "VALID" 0 "INVALID" ;
VAL_ 154 OBJ_Long_Distance_STD_V_17 1 "VALID" 0 "INVALID" ;
VAL_ 154 OBJ_Lat_Distance_V_17 1 "VALID" 0 "INVALID" ;
VAL_ 154 OBJ_Lat_Distance_STD_V_17 1 "VALID" 0 "INVALID" ;
VAL_ 154 OBJ_Absolute_Speed_V_17 1 "VALID" 0 "INVALID" ;
VAL_ 154 OBJ_Absolute_Speed_STD_V_17 1 "VALID" 0 "INVALID" ;
VAL_ 154 OBJ_Heading_V_17 1 "VALID" 0 "INVALID" ;
VAL_ 154 OBJ_Heading_STD_V_17 1 "VALID" 0 "INVALID" ;
VAL_ 154 OBJ_Angle_Rate_STD_V_17 1 "VALID" 0 "INVALID" ;
VAL_ 154 OBJ_Angle_Rate_V_17 1 "VALID" 0 "INVALID" ;
VAL_ 154 OBJ_Angle_Right_V_17 1 "VALID" 0 "INVALID" ;
VAL_ 154 OBJ_Angle_Right_STD_V_17 1 "VALID" 0 "INVALID" ;
VAL_ 154 OBJ_Angle_Left_V_17 1 "VALID" 0 "INVALID" ;
VAL_ 154 OBJ_Angle_Left_STD_V_17 1 "VALID" 0 "INVALID" ;
VAL_ 154 OBJ_Angle_Side_V_17 1 "VALID" 0 "INVALID" ;
VAL_ 154 OBJ_Angle_Side_STD_V_17 1 "VALID" 0 "INVALID" ;
VAL_ 154 OBJ_Angle_Mid_V_17 1 "VALID" 0 "INVALID" ;
VAL_ 154 OBJ_Angle_Mid_STD_V_17 1 "VALID" 0 "INVALID" ;
VAL_ 154 OBJ_Angle_Bottom_V_17 1 "VALID" 0 "INVALID" ;
VAL_ 154 OBJ_Angle_Bottom_STD_V_17 1 "VALID" 0 "INVALID" ;
VAL_ 154 OBJ_Visibility_Side_V_17 1 "VALID" 0 "INVALID" ;
VAL_ 154 OBJ_Visibility_Side_17 2 "REAR" 1 "FRONT" 0 "NOT_VISIBLE" ;
VAL_ 154 OBJ_Is_In_Drivable_Area_17 1 "TRUE" 0 "FALSE" ;
VAL_ 154 OBJ_Is_In_Drivable_Area_V_17 1 "VALID" 0 "INVALID" ;
VAL_ 154 OBJ_Is_VeryClose_17 1 "TRUE" 0 "FALSE" ;
VAL_ 154 OBJ_Is_VeryClose_V_17 1 "VALID" 0 "INVALID" ;
VAL_ 154 OBJ_Occlusion_RL_17 2 "OCCLUDED" 1 "NOT_OCCLUDED" 0 "NOT_RELEVANT" ;
VAL_ 154 OBJ_Occlusion_RR_17 2 "OCCLUDED" 1 "NOT_OCCLUDED" 0 "NOT_RELEVANT" ;
VAL_ 154 OBJ_Occlusion_FR_17 2 "OCCLUDED" 1 "NOT_OCCLUDED" 0 "NOT_RELEVANT" ;
VAL_ 154 OBJ_Occlusion_FL_17 2 "OCCLUDED" 1 "NOT_OCCLUDED" 0 "NOT_RELEVANT" ;
VAL_ 154 OBJ_Triggered_SDM_18 2 "NOT_TRIGGERED" 1 "TRIGGERED" 0 "NOT_AVAILABLE" ;
VAL_ 154 OBJ_Motion_Category_18 13 "ONCOMING" 12 "PRECEEDING" 11 "MOVING" 10 "RTAP" 9 "LTAP" 8 "CROSSING" 7 "MOVING_OUT" 6 "MOVING_IN" 5 "CLOSE_CUT_IN" 4 "PASSING_OUT" 3 "PASSING_IN" 2 "PASSING" 1 "UNDEFINED" 0 "UNFILLED" ;
VAL_ 154 OBJ_Measuring_Status_18 2 "(BIT_2)NOT_VALID_OR_VALID" 1 "(BIT_1)PREDICTED_OR_MEASURED" 0 "(BIT_0)OLD_OR_NEW" ;
VAL_ 154 OBJ_Object_Class_18 8 "UNCERTAIN_VCL" 7 "ANIMAL" 6 "GENERAL_OBJECT" 5 "PEDESTRIAN" 4 "BICYCLE" 3 "MOTORBIKE" 2 "TRUCK" 1 "CAR" 0 "UNFILLED" ;
VAL_ 154 OBJ_Camera_Source_18 11 "PARKING_RIGHT" 10 "PARKING_LEFT" 9 "PARKING_REAR" 8 "PARKING_FRONT" 7 "FRONT_CORNER_RIGHT" 6 "FRONT_CORNER_LEFT" 5 "REAR_CORNER_RIGHT" 4 "REAR_CORNER_LEFT" 3 "REAR" 2 "FRONT_FISHEYE" 1 "FRONT_NARROW" 0 "FRONT_MAIN" ;
VAL_ 154 OBJ_Motion_Status_18 5 "MOVING_SLOWLY" 4 "STOPPED" 3 "STATIONARY" 2 "MOVING" 1 "UNKNOWN" 0 "INVALID" ;
VAL_ 154 OBJ_Motion_Orientation_18 13 "UNKNOWN" 12 "PRECEEDING" 11 "DRIFTING_LEFT" 9 "CROSSING_LEFT" 7 "OC_DRIFTING_LEFT" 6 "ONCOMING" 5 "OC_DRIFTING_RIGHT" 3 "CROSSING_RIGHT" 1 "DRIFTING_RIGHT" 0 "INVALID" ;
VAL_ 154 OBJ_Has_Cut_Lane_18 1 "TRUE" 0 "FALSE" ;
VAL_ 154 OBJ_Has_Cut_Path_18 1 "TRUE" 0 "FALSE" ;
VAL_ 154 OBJ_Brake_Light_18 1 "TRUE" 0 "FALSE" ;
VAL_ 154 OBJ_Turn_Indicator_Right_18 1 "TRUE" 0 "FALSE" ;
VAL_ 154 OBJ_Turn_Indicator_Left_18 1 "TRUE" 0 "FALSE" ;
VAL_ 154 OBJ_Light_Indicator_Validity_18 1 "TRUE" 0 "FALSE" ;
VAL_ 154 OBJ_Right_Out_Of_Image_18 1 "TRUE" 0 "FALSE" ;
VAL_ 154 OBJ_Left_Out_Of_Image_18 1 "TRUE" 0 "FALSE" ;
VAL_ 154 OBJ_Right_Out_Of_Image_V_18 1 "TRUE" 0 "FALSE" ;
VAL_ 154 OBJ_Left_Out_Of_Image_V_18 1 "TRUE" 0 "FALSE" ;
VAL_ 154 OBJ_Top_Out_Of_Image_18 1 "TRUE" 0 "FALSE" ;
VAL_ 154 OBJ_Bottom_Out_Of_Image_18 1 "TRUE" 0 "FALSE" ;
VAL_ 154 OBJ_Top_Out_Of_Image_V_18 1 "VALID" 0 "INVALID" ;
VAL_ 154 OBJ_Bottom_Out_Of_Image_V_18 1 "VALID" 0 "INVALID" ;
VAL_ 154 OBJ_Lane_Assignment_18 5 "RIGHT_RIGHT" 4 "RIGHT" 3 "HOST" 2 "LEFT" 1 "LEFT_LEFT" 0 "UNKNOWN" ;
VAL_ 154 OBJ_Lane_Assignment_V_18 1 "VALID" 0 "INVALID" ;
VAL_ 154 OBJ_Age_Seconds_V_18 1 "VALID" 0 "INVALID" ;
VAL_ 154 OBJ_Width_V_18 1 "VALID" 0 "INVALID" ;
VAL_ 154 OBJ_Width_STD_V_18 1 "VALID" 0 "INVALID" ;
VAL_ 154 OBJ_Length_V_18 1 "VALID" 0 "INVALID" ;
VAL_ 154 OBJ_Length_STD_V_18 1 "VALID" 0 "INVALID" ;
VAL_ 154 OBJ_Height_V_18 1 "VALID" 0 "INVALID" ;
VAL_ 154 OBJ_Height_STD_V_18 1 "VALID" 0 "INVALID" ;
VAL_ 154 OBJ_Abs_Long_Velocity_V_18 1 "VALID" 0 "INVALID" ;
VAL_ 154 OBJ_Abs_Long_Vel_STD_V_18 1 "VALID" 0 "INVALID" ;
VAL_ 154 OBJ_Abs_Lat_Velocity_V_18 1 "VALID" 0 "INVALID" ;
VAL_ 154 OBJ_Abs_Lat_Vel_STD_V_18 1 "VALID" 0 "INVALID" ;
VAL_ 154 OBJ_Abs_Long_Acc_V_18 1 "VALID" 0 "INVALID" ;
VAL_ 154 OBJ_Abs_Long_Acc_STD_V_18 1 "VALID" 0 "INVALID" ;
VAL_ 154 OBJ_Abs_Lat_Acc_V_18 1 "VALID" 0 "INVALID" ;
VAL_ 154 OBJ_Abs_Lat_Acc_STD_V_18 1 "VALID" 0 "INVALID" ;
VAL_ 154 OBJ_Abs_Acceleration_V_18 1 "VALID" 0 "INVALID" ;
VAL_ 154 OBJ_Abs_Acc_STD_V_18 1 "VALID" 0 "INVALID" ;
VAL_ 154 OBJ_Inv_TTC_V_18 1 "VALID" 0 "INVALID" ;
VAL_ 154 OBJ_Inv_TTC_STD_V_18 1 "VALID" 0 "INVALID" ;
VAL_ 154 OBJ_Relative_Long_Acc_V_18 1 "VALID" 0 "INVALID" ;
VAL_ 154 OBJ_Rel_Long_Acc_STD_V_18 1 "VALID" 0 "INVALID" ;
VAL_ 154 OBJ_Relative_Long_Velocity_V_18 1 "VALID" 0 "INVALID" ;
VAL_ 154 OBJ_Rel_Long_Vel_STD_V_18 1 "VALID" 0 "INVALID" ;
VAL_ 154 OBJ_Relative_Lat_Velocity_V_18 1 "VALID" 0 "INVALID" ;
VAL_ 154 OBJ_Rel_Lat_Vel_STD_V_18 1 "VALID" 0 "INVALID" ;
VAL_ 154 OBJ_Long_Distance_V_18 1 "VALID" 0 "INVALID" ;
VAL_ 154 OBJ_Long_Distance_STD_V_18 1 "VALID" 0 "INVALID" ;
VAL_ 154 OBJ_Lat_Distance_V_18 1 "VALID" 0 "INVALID" ;
VAL_ 154 OBJ_Lat_Distance_STD_V_18 1 "VALID" 0 "INVALID" ;
VAL_ 154 OBJ_Absolute_Speed_V_18 1 "VALID" 0 "INVALID" ;
VAL_ 154 OBJ_Absolute_Speed_STD_V_18 1 "VALID" 0 "INVALID" ;
VAL_ 154 OBJ_Heading_V_18 1 "VALID" 0 "INVALID" ;
VAL_ 154 OBJ_Heading_STD_V_18 1 "VALID" 0 "INVALID" ;
VAL_ 154 OBJ_Angle_Rate_STD_V_18 1 "VALID" 0 "INVALID" ;
VAL_ 154 OBJ_Angle_Rate_V_18 1 "VALID" 0 "INVALID" ;
VAL_ 154 OBJ_Angle_Right_V_18 1 "VALID" 0 "INVALID" ;
VAL_ 154 OBJ_Angle_Right_STD_V_18 1 "VALID" 0 "INVALID" ;
VAL_ 154 OBJ_Angle_Left_V_18 1 "VALID" 0 "INVALID" ;
VAL_ 154 OBJ_Angle_Left_STD_V_18 1 "VALID" 0 "INVALID" ;
VAL_ 154 OBJ_Angle_Side_V_18 1 "VALID" 0 "INVALID" ;
VAL_ 154 OBJ_Angle_Side_STD_V_18 1 "VALID" 0 "INVALID" ;
VAL_ 154 OBJ_Angle_Mid_V_18 1 "VALID" 0 "INVALID" ;
VAL_ 154 OBJ_Angle_Mid_STD_V_18 1 "VALID" 0 "INVALID" ;
VAL_ 154 OBJ_Angle_Bottom_V_18 1 "VALID" 0 "INVALID" ;
VAL_ 154 OBJ_Angle_Bottom_STD_V_18 1 "VALID" 0 "INVALID" ;
VAL_ 154 OBJ_Visibility_Side_V_18 1 "VALID" 0 "INVALID" ;
VAL_ 154 OBJ_Visibility_Side_18 2 "REAR" 1 "FRONT" 0 "NOT_VISIBLE" ;
VAL_ 154 OBJ_Is_In_Drivable_Area_18 1 "TRUE" 0 "FALSE" ;
VAL_ 154 OBJ_Is_In_Drivable_Area_V_18 1 "VALID" 0 "INVALID" ;
VAL_ 154 OBJ_Is_VeryClose_18 1 "TRUE" 0 "FALSE" ;
VAL_ 154 OBJ_Is_VeryClose_V_18 1 "VALID" 0 "INVALID" ;
VAL_ 154 OBJ_Occlusion_RL_18 2 "OCCLUDED" 1 "NOT_OCCLUDED" 0 "NOT_RELEVANT" ;
VAL_ 154 OBJ_Occlusion_RR_18 2 "OCCLUDED" 1 "NOT_OCCLUDED" 0 "NOT_RELEVANT" ;
VAL_ 154 OBJ_Occlusion_FR_18 2 "OCCLUDED" 1 "NOT_OCCLUDED" 0 "NOT_RELEVANT" ;
VAL_ 154 OBJ_Occlusion_FL_18 2 "OCCLUDED" 1 "NOT_OCCLUDED" 0 "NOT_RELEVANT" ;
VAL_ 154 OBJ_Triggered_SDM_19 2 "NOT_TRIGGERED" 1 "TRIGGERED" 0 "NOT_AVAILABLE" ;
VAL_ 154 OBJ_Motion_Category_19 13 "ONCOMING" 12 "PRECEEDING" 11 "MOVING" 10 "RTAP" 9 "LTAP" 8 "CROSSING" 7 "MOVING_OUT" 6 "MOVING_IN" 5 "CLOSE_CUT_IN" 4 "PASSING_OUT" 3 "PASSING_IN" 2 "PASSING" 1 "UNDEFINED" 0 "UNFILLED" ;
VAL_ 154 OBJ_Measuring_Status_19 2 "(BIT_2)NOT_VALID_OR_VALID" 1 "(BIT_1)PREDICTED_OR_MEASURED" 0 "(BIT_0)OLD_OR_NEW" ;
VAL_ 154 OBJ_Object_Class_19 8 "UNCERTAIN_VCL" 7 "ANIMAL" 6 "GENERAL_OBJECT" 5 "PEDESTRIAN" 4 "BICYCLE" 3 "MOTORBIKE" 2 "TRUCK" 1 "CAR" 0 "UNFILLED" ;
VAL_ 154 OBJ_Camera_Source_19 11 "PARKING_RIGHT" 10 "PARKING_LEFT" 9 "PARKING_REAR" 8 "PARKING_FRONT" 7 "FRONT_CORNER_RIGHT" 6 "FRONT_CORNER_LEFT" 5 "REAR_CORNER_RIGHT" 4 "REAR_CORNER_LEFT" 3 "REAR" 2 "FRONT_FISHEYE" 1 "FRONT_NARROW" 0 "FRONT_MAIN" ;
VAL_ 154 OBJ_Motion_Status_19 5 "MOVING_SLOWLY" 4 "STOPPED" 3 "STATIONARY" 2 "MOVING" 1 "UNKNOWN" 0 "INVALID" ;
VAL_ 154 OBJ_Motion_Orientation_19 13 "UNKNOWN" 12 "PRECEEDING" 11 "DRIFTING_LEFT" 9 "CROSSING_LEFT" 7 "OC_DRIFTING_LEFT" 6 "ONCOMING" 5 "OC_DRIFTING_RIGHT" 3 "CROSSING_RIGHT" 1 "DRIFTING_RIGHT" 0 "INVALID" ;
VAL_ 154 OBJ_Has_Cut_Lane_19 1 "TRUE" 0 "FALSE" ;
VAL_ 154 OBJ_Has_Cut_Path_19 1 "TRUE" 0 "FALSE" ;
VAL_ 154 OBJ_Brake_Light_19 1 "TRUE" 0 "FALSE" ;
VAL_ 154 OBJ_Turn_Indicator_Right_19 1 "TRUE" 0 "FALSE" ;
VAL_ 154 OBJ_Turn_Indicator_Left_19 1 "TRUE" 0 "FALSE" ;
VAL_ 154 OBJ_Light_Indicator_Validity_19 1 "TRUE" 0 "FALSE" ;
VAL_ 154 OBJ_Right_Out_Of_Image_19 1 "TRUE" 0 "FALSE" ;
VAL_ 154 OBJ_Left_Out_Of_Image_19 1 "TRUE" 0 "FALSE" ;
VAL_ 154 OBJ_Right_Out_Of_Image_V_19 1 "TRUE" 0 "FALSE" ;
VAL_ 154 OBJ_Left_Out_Of_Image_V_19 1 "TRUE" 0 "FALSE" ;
VAL_ 154 OBJ_Top_Out_Of_Image_19 1 "TRUE" 0 "FALSE" ;
VAL_ 154 OBJ_Bottom_Out_Of_Image_19 1 "TRUE" 0 "FALSE" ;
VAL_ 154 OBJ_Top_Out_Of_Image_V_19 1 "VALID" 0 "INVALID" ;
VAL_ 154 OBJ_Bottom_Out_Of_Image_V_19 1 "VALID" 0 "INVALID" ;
VAL_ 154 OBJ_Lane_Assignment_19 5 "RIGHT_RIGHT" 4 "RIGHT" 3 "HOST" 2 "LEFT" 1 "LEFT_LEFT" 0 "UNKNOWN" ;
VAL_ 154 OBJ_Lane_Assignment_V_19 1 "VALID" 0 "INVALID" ;
VAL_ 154 OBJ_Age_Seconds_V_19 1 "VALID" 0 "INVALID" ;
VAL_ 154 OBJ_Width_V_19 1 "VALID" 0 "INVALID" ;
VAL_ 154 OBJ_Width_STD_V_19 1 "VALID" 0 "INVALID" ;
VAL_ 154 OBJ_Length_V_19 1 "VALID" 0 "INVALID" ;
VAL_ 154 OBJ_Length_STD_V_19 1 "VALID" 0 "INVALID" ;
VAL_ 154 OBJ_Height_V_19 1 "VALID" 0 "INVALID" ;
VAL_ 154 OBJ_Height_STD_V_19 1 "VALID" 0 "INVALID" ;
VAL_ 154 OBJ_Abs_Long_Velocity_V_19 1 "VALID" 0 "INVALID" ;
VAL_ 154 OBJ_Abs_Long_Vel_STD_V_19 1 "VALID" 0 "INVALID" ;
VAL_ 154 OBJ_Abs_Lat_Velocity_V_19 1 "VALID" 0 "INVALID" ;
VAL_ 154 OBJ_Abs_Lat_Vel_STD_V_19 1 "VALID" 0 "INVALID" ;
VAL_ 154 OBJ_Abs_Long_Acc_V_19 1 "VALID" 0 "INVALID" ;
VAL_ 154 OBJ_Abs_Long_Acc_STD_V_19 1 "VALID" 0 "INVALID" ;
VAL_ 154 OBJ_Abs_Lat_Acc_V_19 1 "VALID" 0 "INVALID" ;
VAL_ 154 OBJ_Abs_Lat_Acc_STD_V_19 1 "VALID" 0 "INVALID" ;
VAL_ 154 OBJ_Abs_Acceleration_V_19 1 "VALID" 0 "INVALID" ;
VAL_ 154 OBJ_Abs_Acc_STD_V_19 1 "VALID" 0 "INVALID" ;
VAL_ 154 OBJ_Inv_TTC_V_19 1 "VALID" 0 "INVALID" ;
VAL_ 154 OBJ_Inv_TTC_STD_V_19 1 "VALID" 0 "INVALID" ;
VAL_ 154 OBJ_Relative_Long_Acc_V_19 1 "VALID" 0 "INVALID" ;
VAL_ 154 OBJ_Rel_Long_Acc_STD_V_19 1 "VALID" 0 "INVALID" ;
VAL_ 154 OBJ_Relative_Long_Velocity_V_19 1 "VALID" 0 "INVALID" ;
VAL_ 154 OBJ_Rel_Long_Vel_STD_V_19 1 "VALID" 0 "INVALID" ;
VAL_ 154 OBJ_Relative_Lat_Velocity_V_19 1 "VALID" 0 "INVALID" ;
VAL_ 154 OBJ_Rel_Lat_Vel_STD_V_19 1 "VALID" 0 "INVALID" ;
VAL_ 154 OBJ_Long_Distance_V_19 1 "VALID" 0 "INVALID" ;
VAL_ 154 OBJ_Long_Distance_STD_V_19 1 "VALID" 0 "INVALID" ;
VAL_ 154 OBJ_Lat_Distance_V_19 1 "VALID" 0 "INVALID" ;
VAL_ 154 OBJ_Lat_Distance_STD_V_19 1 "VALID" 0 "INVALID" ;
VAL_ 154 OBJ_Absolute_Speed_V_19 1 "VALID" 0 "INVALID" ;
VAL_ 154 OBJ_Absolute_Speed_STD_V_19 1 "VALID" 0 "INVALID" ;
VAL_ 154 OBJ_Heading_V_19 1 "VALID" 0 "INVALID" ;
VAL_ 154 OBJ_Heading_STD_V_19 1 "VALID" 0 "INVALID" ;
VAL_ 154 OBJ_Angle_Rate_STD_V_19 1 "VALID" 0 "INVALID" ;
VAL_ 154 OBJ_Angle_Rate_V_19 1 "VALID" 0 "INVALID" ;
VAL_ 154 OBJ_Angle_Right_V_19 1 "VALID" 0 "INVALID" ;
VAL_ 154 OBJ_Angle_Right_STD_V_19 1 "VALID" 0 "INVALID" ;
VAL_ 154 OBJ_Angle_Left_V_19 1 "VALID" 0 "INVALID" ;
VAL_ 154 OBJ_Angle_Left_STD_V_19 1 "VALID" 0 "INVALID" ;
VAL_ 154 OBJ_Angle_Side_V_19 1 "VALID" 0 "INVALID" ;
VAL_ 154 OBJ_Angle_Side_STD_V_19 1 "VALID" 0 "INVALID" ;
VAL_ 154 OBJ_Angle_Mid_V_19 1 "VALID" 0 "INVALID" ;
VAL_ 154 OBJ_Angle_Mid_STD_V_19 1 "VALID" 0 "INVALID" ;
VAL_ 154 OBJ_Angle_Bottom_V_19 1 "VALID" 0 "INVALID" ;
VAL_ 154 OBJ_Angle_Bottom_STD_V_19 1 "VALID" 0 "INVALID" ;
VAL_ 154 OBJ_Visibility_Side_V_19 1 "VALID" 0 "INVALID" ;
VAL_ 154 OBJ_Visibility_Side_19 2 "REAR" 1 "FRONT" 0 "NOT_VISIBLE" ;
VAL_ 154 OBJ_Is_In_Drivable_Area_19 1 "TRUE" 0 "FALSE" ;
VAL_ 154 OBJ_Is_In_Drivable_Area_V_19 1 "VALID" 0 "INVALID" ;
VAL_ 154 OBJ_Is_VeryClose_19 1 "TRUE" 0 "FALSE" ;
VAL_ 154 OBJ_Is_VeryClose_V_19 1 "VALID" 0 "INVALID" ;
VAL_ 154 OBJ_Occlusion_RL_19 2 "OCCLUDED" 1 "NOT_OCCLUDED" 0 "NOT_RELEVANT" ;
VAL_ 154 OBJ_Occlusion_RR_19 2 "OCCLUDED" 1 "NOT_OCCLUDED" 0 "NOT_RELEVANT" ;
VAL_ 154 OBJ_Occlusion_FR_19 2 "OCCLUDED" 1 "NOT_OCCLUDED" 0 "NOT_RELEVANT" ;
VAL_ 154 OBJ_Occlusion_FL_19 2 "OCCLUDED" 1 "NOT_OCCLUDED" 0 "NOT_RELEVANT" ;
