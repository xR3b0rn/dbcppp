VERSION "8"

NS_ :

BS_:

BU_: EyeQ4 MCU

BO_ 154 Core_Objects_protocol: 1940 EyeQ4
 SG_ OBJ_Absolute_Speed_STD_6 : 5293|11@1+ (0.05,0) [0|65] "MPS" MCU
 SG_ OBJ_Absolute_Speed_STD_V_6 : 5304|1@1+ (1,0) [0|1] "bool" MCU
 SG_ Reserved_14_6 : 5305|7@1+ (1,0) [0|0] "NA" MCU
 SG_ OBJ_Heading_6 : 5312|10@1+ (0.01,-3.14) [-3.14|3.14] "rad" MCU
 SG_ OBJ_Heading_V_6 : 5322|1@1+ (1,0) [0|1] "bool" MCU
 SG_ OBJ_Heading_STD_6 : 5323|9@1+ (0.01,0) [0|3.14] "rad" MCU
 SG_ OBJ_Heading_STD_V_6 : 5332|1@1+ (1,0) [0|1] "bool" MCU
 SG_ OBJ_Angle_Rate_STD_6 : 5333|11@1+ (0.002,0) [0|2.2318] "RPS" MCU
 SG_ OBJ_Angle_Rate_STD_V_6 : 5344|1@1+ (1,0) [0|1] "bool" MCU
 SG_ OBJ_Angle_Rate_6 : 5345|12@1+ (0.002,-2.234) [-2.234|2.2318] "RPS" MCU
 SG_ OBJ_Angle_Rate_V_6 : 5357|1@1+ (1,0) [0|1] "bool" MCU
 SG_ OBJ_Angle_Right_6 : 5358|14@1+ (0.0002,-1.571) [-1.571|1.571] "rad " MCU
 SG_ OBJ_Angle_Right_V_6 : 5372|1@1+ (1,0) [0|1] "bool" MCU
 SG_ Reserved_15_6 : 5373|3@1+ (1,0) [0|0] "NA" MCU
 SG_ OBJ_Angle_Right_STD_6 : 5376|13@1+ (0.0002,0) [0|1.571] "rad " MCU
 SG_ OBJ_Angle_Right_STD_V_6 : 5389|1@1+ (1,0) [0|1] "bool" MCU
 SG_ OBJ_Angle_Left_6 : 5390|14@1+ (0.0002,-1.571) [-1.571|1.571] "rad " MCU
 SG_ OBJ_Angle_Left_V_6 : 5404|1@1+ (1,0) [0|1] "bool" MCU
 SG_ Reserved_16_6 : 5405|3@1+ (1,0) [0|0] "NA" MCU
 SG_ OBJ_Angle_Left_STD_6 : 5408|13@1+ (0.0002,0) [0|1.571] "rad" MCU
 SG_ OBJ_Angle_Left_STD_V_6 : 5421|1@1+ (1,0) [0|1] "bool" MCU
 SG_ OBJ_Angle_Side_6 : 5422|14@1+ (0.0002,-1.571) [-1.571|1.571] "rad" MCU
 SG_ OBJ_Angle_Side_V_6 : 5436|1@1+ (1,0) [0|1] "bool" MCU
 SG_ Reserved_17_6 : 5437|3@1+ (1,0) [0|0] "NA" MCU
 SG_ OBJ_Angle_Side_STD_6 : 5440|13@1+ (0.0002,0) [0|1.571] "rad" MCU
 SG_ OBJ_Angle_Side_STD_V_6 : 5453|1@1+ (1,0) [0|1] "bool" MCU
 SG_ OBJ_Angle_Mid_V_6 : 5454|1@1+ (1,0) [0|1] "bool" MCU
 SG_ OBJ_Angle_Mid_6 : 5455|14@1+ (0.0002,-1.571) [-1.571|1.571] "rad" MCU
 SG_ Reserved_18_6 : 5469|3@1+ (1,0) [0|0] "NA" MCU
 SG_ OBJ_Angle_Mid_STD_6 : 5472|13@1+ (0.0002,0) [0|1.571] "rad" MCU
 SG_ OBJ_Angle_Mid_STD_V_6 : 5485|1@1+ (1,0) [0|1] "bool" MCU
 SG_ OBJ_Angle_Bottom_V_6 : 5486|1@1+ (1,0) [0|1] "bool" MCU
 SG_ OBJ_Angle_Bottom_6 : 5487|14@1+ (0.0002,-1.571) [-1.571|1.571] "rad" MCU
 SG_ Reserved_19_6 : 5501|3@1+ (1,0) [0|0] "NA" MCU
 SG_ OBJ_Angle_Bottom_STD_6 : 5504|13@1+ (0.0002,0) [0|1.571] "rad" MCU
 SG_ OBJ_Angle_Bottom_STD_V_6 : 5517|1@1+ (1,0) [0|1] "bool" MCU
 SG_ OBJ_Visibility_Side_V_6 : 5518|1@1+ (1,0) [0|1] "Bool" MCU
 SG_ OBJ_Visibility_Side_6 : 5519|2@1+ (1,0) [0|2] "ENUM" MCU
 SG_ OBJ_Is_In_Drivable_Area_6 : 5521|1@1+ (1,0) [0|1] "bool" MCU
 SG_ OBJ_Is_In_Drivable_Area_V_6 : 5522|1@1+ (1,0) [0|1] "bool" MCU
 SG_ OBJ_Is_VeryClose_6 : 5523|1@1+ (1,0) [0|1] "bool" MCU
 SG_ OBJ_Is_VeryClose_V_6 : 5524|1@1+ (1,0) [0|1] "bool" MCU
 SG_ OBJ_Occlusion_RL_6 : 5525|2@1+ (1,0) [0|2] "ENUM" MCU
 SG_ OBJ_Occlusion_RR_6 : 5527|2@1+ (1,0) [0|2] "ENUM" MCU
 SG_ OBJ_Occlusion_FR_6 : 5529|2@1+ (1,0) [0|2] "ENUM" MCU
 SG_ OBJ_Occlusion_FL_6 : 5531|2@1+ (1,0) [0|2] "ENUM" MCU
 SG_ OBJ_Buffer_6 : 5533|3@1+ (1,0) [0|0] "NA" MCU
 SG_ OBJ_CRC_7 : 5536|32@1+ (1,0) [0|4294967295] "NA" MCU
 SG_ OBJ_ID_7 : 5568|8@1+ (1,0) [0|255] "counter" MCU
 SG_ OBJ_Existence_Probability_7 : 5576|8@1+ (0.01,0) [0|1] "NA" MCU
 SG_ OBJ_Fusion_Source_7 : 5584|16@1+ (1,0) [0|65535] "BITWIZE" MCU
 SG_ OBJ_Triggered_SDM_7 : 5600|2@1+ (1,0) [0|2] "ENUM " MCU
 SG_ OBJ_Motion_Category_7 : 5602|4@1+ (1,0) [0|13] "ENUM " MCU
 SG_ OBJ_Buffer_C0_7 : 5606|7@1+ (1,0) [0|127] "NA" MCU
 SG_ OBJ_Object_Age_7 : 5613|11@1+ (1,0) [0|2047] "Frames" MCU
 SG_ OBJ_Measuring_Status_7 : 5624|3@1+ (1,0) [0|7] "BITWIZE" MCU
 SG_ OBJ_Object_Class_7 : 5627|4@1+ (1,0) [0|8] "ENUM" MCU
 SG_ Reserved_3_7 : 5631|1@1+ (1,0) [0|0] "NA" MCU
 SG_ OBJ_Class_Probability_7 : 5632|7@1+ (0.01,0) [0|1] "NA" MCU
 SG_ OBJ_Buffer_C1_7 : 5639|7@1+ (1,0) [0|127] "NA" MCU
 SG_ OBJ_Buffer_C2_7 : 5646|7@1+ (1,0) [0|127] "NA" MCU
 SG_ OBJ_Buffer_C3_7 : 5653|7@1+ (1,0) [0|127] "NA" MCU
 SG_ OBJ_Camera_Source_7 : 5660|4@1+ (1,0) [0|15] "ENUM" MCU
 SG_ OBJ_Motion_Status_7 : 5664|3@1+ (1,0) [0|5] "ENUM " MCU
 SG_ OBJ_Motion_Orientation_7 : 5667|4@1+ (1,0) [0|13] "ENUM " MCU
 SG_ OBJ_Has_Cut_Lane_7 : 5671|1@1+ (1,0) [0|1] "bool" MCU
 SG_ OBJ_Has_Cut_Path_7 : 5672|1@1+ (1,0) [0|1] "bool" MCU
 SG_ OBJ_Brake_Light_7 : 5673|1@1+ (1,0) [0|1] "bool" MCU
 SG_ OBJ_Turn_Indicator_Right_7 : 5674|1@1+ (1,0) [0|1] "bool" MCU
 SG_ OBJ_Turn_Indicator_Left_7 : 5675|1@1+ (1,0) [0|1] "bool" MCU
 SG_ OBJ_Light_Indicator_Validity_7 : 5676|1@1+ (1,0) [0|1] "bool" MCU
 SG_ OBJ_Right_Out_Of_Image_7 : 5677|1@1+ (1,0) [0|1] "bool" MCU
 SG_ OBJ_Left_Out_Of_Image_7 : 5678|1@1+ (1,0) [0|1] "bool" MCU
 SG_ OBJ_Right_Out_Of_Image_V_7 : 5679|1@1+ (1,0) [0|1] "bool" MCU
 SG_ OBJ_Left_Out_Of_Image_V_7 : 5680|1@1+ (1,0) [0|1] "bool" MCU
 SG_ OBJ_Top_Out_Of_Image_7 : 5681|1@1+ (1,0) [0|1] "bool" MCU
 SG_ OBJ_Bottom_Out_Of_Image_7 : 5682|1@1+ (1,0) [0|1] "bool" MCU
 SG_ OBJ_Top_Out_Of_Image_V_7 : 5683|1@1+ (1,0) [0|1] "bool" MCU
 SG_ OBJ_Bottom_Out_Of_Image_V_7 : 5684|1@1+ (1,0) [0|1] "bool" MCU
 SG_ OBJ_Lane_Assignment_7 : 5685|3@1+ (1,0) [0|5] "ENUM" MCU
 SG_ OBJ_Lane_Assignment_V_7 : 5688|1@1+ (1,0) [0|1] "bool" MCU
 SG_ OBJ_Age_Seconds_7 : 5689|7@1+ (1,0) [0|100] "s" MCU
 SG_ OBJ_Age_Seconds_V_7 : 5696|1@1+ (1,0) [0|1] "bool" MCU
 SG_ OBJ_Width_7 : 5697|9@1+ (0.01,0) [0.4|2.95] "m" MCU
 SG_ OBJ_Width_V_7 : 5706|1@1+ (1,0) [0|1] "bool" MCU
 SG_ OBJ_Width_STD_7 : 5707|8@1+ (0.01,0) [0|2] "m" MCU
 SG_ OBJ_Width_STD_V_7 : 5715|1@1+ (1,0) [0|1] "bool" MCU
 SG_ OBJ_Length_7 : 5716|9@1+ (0.05,0) [1.2|21] "m" MCU
 SG_ OBJ_Length_V_7 : 5725|1@1+ (1,0) [0|1] "bool" MCU
 SG_ Reserved_4_7 : 5726|2@1+ (1,0) [0|0] "NA" MCU
 SG_ OBJ_Length_STD_7 : 5728|8@1+ (0.05,0) [0|10] "m" MCU
 SG_ OBJ_Length_STD_V_7 : 5736|1@1+ (1,0) [0|1] "bool" MCU
 SG_ OBJ_Height_7 : 5737|9@1+ (0.01,0) [0|2.95] "m" MCU
 SG_ OBJ_Height_V_7 : 5746|1@1+ (1,0) [0|1] "bool" MCU
 SG_ OBJ_Height_STD_7 : 5747|8@1+ (0.01,0) [0|2] "m" MCU
 SG_ OBJ_Height_STD_V_7 : 5755|1@1+ (1,0) [0|1] "bool" MCU
 SG_ Reserved_5_7 : 5756|4@1+ (1,0) [0|0] "NA" MCU
 SG_ OBJ_Abs_Long_Velocity_7 : 5760|12@1+ (0.05,-30) [-30|100] "MPS" MCU
 SG_ OBJ_Abs_Long_Velocity_V_7 : 5772|1@1+ (1,0) [0|1] "bool" MCU
 SG_ OBJ_Abs_Long_Velocity_STD_7 : 5773|11@1+ (0.05,0) [0|65] "MPS" MCU
 SG_ OBJ_Abs_Long_Vel_STD_V_7 : 5784|1@1+ (1,0) [0|1] "bool" MCU
 SG_ Reserved_6_7 : 5785|7@1+ (1,0) [0|0] "NA" MCU
 SG_ OBJ_Abs_Lat_Velocity_7 : 5792|11@1+ (0.05,-50) [-50|50] "MPS" MCU
 SG_ OBJ_Abs_Lat_Velocity_V_7 : 5803|1@1+ (1,0) [0|1] "bool" MCU
 SG_ OBJ_Abs_Lat_Velocity_STD_7 : 5804|10@1+ (0.05,0) [0|50] "MPS" MCU
 SG_ OBJ_Abs_Lat_Vel_STD_V_7 : 5814|1@1+ (1,0) [0|1] "bool" MCU
 SG_ OBJ_Abs_Long_Acc_7 : 5815|9@1+ (0.05,-10.3) [-10.3|7.3] "MPS2" MCU
 SG_ OBJ_Abs_Long_Acc_V_7 : 5824|1@1+ (1,0) [0|1] "bool" MCU
 SG_ OBJ_Abs_Long_Acc_STD_7 : 5825|8@1+ (0.05,0) [0|7.3] "MPS2" MCU
 SG_ OBJ_Abs_Long_Acc_STD_V_7 : 5833|1@1+ (1,0) [0|1] "bool" MCU
 SG_ OBJ_Abs_Lat_Acc_7 : 5834|9@1+ (0.05,-10.3) [-10.3|7.3] "MPS2" MCU
 SG_ OBJ_Abs_Lat_Acc_V_7 : 5843|1@1+ (1,0) [0|1] "bool" MCU
 SG_ OBJ_Abs_Lat_Acc_STD_7 : 5844|8@1+ (0.05,0) [0|7.3] "MPS2" MCU
 SG_ OBJ_Abs_Lat_Acc_STD_V_7 : 5852|1@1+ (1,0) [0|1] "bool" MCU
 SG_ Reserved_7_7 : 5853|3@1+ (1,0) [0|0] "NA" MCU
 SG_ OBJ_Abs_Acceleration_7 : 5856|9@1+ (0.05,-10.3) [-10.3|7.3] "MPS2" MCU
 SG_ OBJ_Abs_Acceleration_V_7 : 5865|1@1+ (1,0) [0|1] "bool" MCU
 SG_ OBJ_Abs_Acc_STD_7 : 5866|8@1+ (0.05,0) [0|7.3] "MPS2" MCU
 SG_ OBJ_Abs_Acc_STD_V_7 : 5874|1@1+ (1,0) [0|1] "bool" MCU
 SG_ OBJ_Inv_TTC_7 : 5875|11@1+ (0.01,-8) [-8|8] "INV(s)" MCU
 SG_ OBJ_Inv_TTC_V_7 : 5886|1@1+ (1,0) [0|1] "bool" MCU
 SG_ Reserved_8_7 : 5887|1@1+ (1,0) [0|0] "NA" MCU
 SG_ OBJ_Inv_TTC_STD_7 : 5888|11@1+ (0.01,0) [0|4] "INV(s)" MCU
 SG_ OBJ_Inv_TTC_STD_V_7 : 5899|1@1+ (1,0) [0|1] "bool" MCU
 SG_ OBJ_Relative_Long_Acc_7 : 5900|9@1+ (0.05,-10.3) [-10.3|7.3] "MPS2" MCU
 SG_ OBJ_Relative_Long_Acc_V_7 : 5909|1@1+ (1,0) [0|1] "bool" MCU
 SG_ OBJ_Relative_Long_Acc_STD_7 : 5910|8@1+ (0.05,0) [0|7.3] "MPS2" MCU
 SG_ OBJ_Rel_Long_Acc_STD_V_7 : 5918|1@1+ (1,0) [0|1] "bool" MCU
 SG_ Reserved_9_7 : 5919|1@1+ (1,0) [0|0] "NA" MCU
 SG_ OBJ_Relative_Long_Velocity_7 : 5920|13@1+ (0.05,-120) [-120|130] "MPS" MCU
 SG_ OBJ_Relative_Long_Velocity_V_7 : 5933|1@1+ (1,0) [0|1] "bool" MCU
 SG_ OBJ_Relative_Long_Vel_STD_7 : 5934|12@1+ (0.05,0) [0|130] "MPS" MCU
 SG_ OBJ_Rel_Long_Vel_STD_V_7 : 5946|1@1+ (1,0) [0|1] "bool" MCU
 SG_ Reserved_10_7 : 5947|5@1+ (1,0) [0|0] "NA" MCU
 SG_ OBJ_Relative_Lat_Velocity_7 : 5952|11@1+ (0.05,-50) [-50|50] "MPS" MCU
 SG_ OBJ_Relative_Lat_Velocity_V_7 : 5963|1@1+ (1,0) [0|1] "bool" MCU
 SG_ OBJ_Relative_Lat_Velocity_STD_7 : 5964|10@1+ (0.05,0) [0|50] "MPS" MCU
 SG_ OBJ_Rel_Lat_Vel_STD_V_7 : 5974|1@1+ (1,0) [0|1] "bool" MCU
 SG_ Reserved_11_7 : 5975|9@1+ (1,0) [0|0] "NA" MCU
 SG_ OBJ_Long_Distance_7 : 5984|14@1+ (0.05,-200) [-200|250] "m" MCU
 SG_ OBJ_Long_Distance_V_7 : 5998|1@1+ (1,0) [0|1] "bool" MCU
 SG_ OBJ_Long_Distance_STD_7 : 5999|13@1+ (0.05,0) [0|250] "m" MCU
 SG_ OBJ_Long_Distance_STD_V_7 : 6012|1@1+ (1,0) [0|1] "bool" MCU
 SG_ Reserved_12_7 : 6013|3@1+ (1,0) [0|0] "NA" MCU
 SG_ OBJ_Lat_Distance_7 : 6016|12@1+ (0.05,-100) [-100|100] "m" MCU
 SG_ OBJ_Lat_Distance_V_7 : 6028|1@1+ (1,0) [0|1] "bool" MCU
 SG_ OBJ_Lat_Distance_STD_7 : 6029|11@1+ (0.05,0) [0|100] "m" MCU
 SG_ OBJ_Lat_Distance_STD_V_7 : 6040|1@1+ (1,0) [0|1] "bool" MCU
 SG_ Reserved_13_7 : 6041|7@1+ (1,0) [0|0] "NA" MCU
 SG_ OBJ_Absolute_Speed_7 : 6048|12@1+ (0.05,-65) [-65|65] "MPS" MCU
 SG_ OBJ_Absolute_Speed_V_7 : 6060|1@1+ (1,0) [0|1] "bool" MCU
 SG_ OBJ_Absolute_Speed_STD_7 : 6061|11@1+ (0.05,0) [0|65] "MPS" MCU
 SG_ OBJ_Absolute_Speed_STD_V_7 : 6072|1@1+ (1,0) [0|1] "bool" MCU
 SG_ Reserved_14_7 : 6073|7@1+ (1,0) [0|0] "NA" MCU
 SG_ OBJ_Heading_7 : 6080|10@1+ (0.01,-3.14) [-3.14|3.14] "rad" MCU
 SG_ OBJ_Heading_V_7 : 6090|1@1+ (1,0) [0|1] "bool" MCU
 SG_ OBJ_Heading_STD_7 : 6091|9@1+ (0.01,0) [0|3.14] "rad" MCU
 SG_ OBJ_Heading_STD_V_7 : 6100|1@1+ (1,0) [0|1] "bool" MCU
 SG_ OBJ_Angle_Rate_STD_7 : 6101|11@1+ (0.002,0) [0|2.2318] "RPS" MCU
 SG_ OBJ_Angle_Rate_STD_V_7 : 6112|1@1+ (1,0) [0|1] "bool" MCU
 SG_ OBJ_Angle_Rate_7 : 6113|12@1+ (0.002,-2.234) [-2.234|2.2318] "RPS" MCU
 SG_ OBJ_Angle_Rate_V_7 : 6125|1@1+ (1,0) [0|1] "bool" MCU
 SG_ OBJ_Angle_Right_7 : 6126|14@1+ (0.0002,-1.571) [-1.571|1.571] "rad " MCU
 SG_ OBJ_Angle_Right_V_7 : 6140|1@1+ (1,0) [0|1] "bool" MCU
 SG_ Reserved_15_7 : 6141|3@1+ (1,0) [0|0] "NA" MCU
 SG_ OBJ_Angle_Right_STD_7 : 6144|13@1+ (0.0002,0) [0|1.571] "rad " MCU
 SG_ OBJ_Angle_Right_STD_V_7 : 6157|1@1+ (1,0) [0|1] "bool" MCU
 SG_ OBJ_Angle_Left_7 : 6158|14@1+ (0.0002,-1.571) [-1.571|1.571] "rad " MCU
 SG_ OBJ_Angle_Left_V_7 : 6172|1@1+ (1,0) [0|1] "bool" MCU
 SG_ Reserved_16_7 : 6173|3@1+ (1,0) [0|0] "NA" MCU
 SG_ OBJ_Angle_Left_STD_7 : 6176|13@1+ (0.0002,0) [0|1.571] "rad" MCU
 SG_ OBJ_Angle_Left_STD_V_7 : 6189|1@1+ (1,0) [0|1] "bool" MCU
 SG_ OBJ_Angle_Side_7 : 6190|14@1+ (0.0002,-1.571) [-1.571|1.571] "rad" MCU
 SG_ OBJ_Angle_Side_V_7 : 6204|1@1+ (1,0) [0|1] "bool" MCU
 SG_ Reserved_17_7 : 6205|3@1+ (1,0) [0|0] "NA" MCU
 SG_ OBJ_Angle_Side_STD_7 : 6208|13@1+ (0.0002,0) [0|1.571] "rad" MCU
 SG_ OBJ_Angle_Side_STD_V_7 : 6221|1@1+ (1,0) [0|1] "bool" MCU
 SG_ OBJ_Angle_Mid_V_7 : 6222|1@1+ (1,0) [0|1] "bool" MCU
 SG_ OBJ_Angle_Mid_7 : 6223|14@1+ (0.0002,-1.571) [-1.571|1.571] "rad" MCU
 SG_ Reserved_18_7 : 6237|3@1+ (1,0) [0|0] "NA" MCU
 SG_ OBJ_Angle_Mid_STD_7 : 6240|13@1+ (0.0002,0) [0|1.571] "rad" MCU
 SG_ OBJ_Angle_Mid_STD_V_7 : 6253|1@1+ (1,0) [0|1] "bool" MCU
 SG_ OBJ_Angle_Bottom_V_7 : 6254|1@1+ (1,0) [0|1] "bool" MCU
 SG_ OBJ_Angle_Bottom_7 : 6255|14@1+ (0.0002,-1.571) [-1.571|1.571] "rad" MCU
 SG_ Reserved_19_7 : 6269|3@1+ (1,0) [0|0] "NA" MCU
 SG_ OBJ_Angle_Bottom_STD_7 : 6272|13@1+ (0.0002,0) [0|1.571] "rad" MCU
 SG_ OBJ_Angle_Bottom_STD_V_7 : 6285|1@1+ (1,0) [0|1] "bool" MCU
 SG_ OBJ_Visibility_Side_V_7 : 6286|1@1+ (1,0) [0|1] "Bool" MCU
 SG_ OBJ_Visibility_Side_7 : 6287|2@1+ (1,0) [0|2] "ENUM" MCU
 SG_ OBJ_Is_In_Drivable_Area_7 : 6289|1@1+ (1,0) [0|1] "bool" MCU
 SG_ OBJ_Is_In_Drivable_Area_V_7 : 6290|1@1+ (1,0) [0|1] "bool" MCU
 SG_ OBJ_Is_VeryClose_7 : 6291|1@1+ (1,0) [0|1] "bool" MCU
 SG_ OBJ_Is_VeryClose_V_7 : 6292|1@1+ (1,0) [0|1] "bool" MCU
 SG_ OBJ_Occlusion_RL_7 : 6293|2@1+ (1,0) [0|2] "ENUM" MCU
 SG_ OBJ_Occlusion_RR_7 : 6295|2@1+ (1,0) [0|2] "ENUM" MCU
 SG_ OBJ_Occlusion_FR_7 : 6297|2@1+ (1,0) [0|2] "ENUM" MCU
 SG_ OBJ_Occlusion_FL_7 : 6299|2@1+ (1,0) [0|2] "ENUM" MCU
 SG_ OBJ_Buffer_7 : 6301|3@1+ (1,0) [0|0] "NA" MCU
 SG_ OBJ_CRC_8 : 6304|32@1+ (1,0) [0|4294967295] "NA" MCU
 SG_ OBJ_ID_8 : 6336|8@1+ (1,0) [0|255] "counter" MCU
 SG_ OBJ_Existence_Probability_8 : 6344|8@1+ (0.01,0) [0|1] "NA" MCU
 SG_ OBJ_Fusion_Source_8 : 6352|16@1+ (1,0) [0|65535] "BITWIZE" MCU
 SG_ OBJ_Triggered_SDM_8 : 6368|2@1+ (1,0) [0|2] "ENUM " MCU
 SG_ OBJ_Motion_Category_8 : 6370|4@1+ (1,0) [0|13] "ENUM " MCU
 SG_ OBJ_Buffer_C0_8 : 6374|7@1+ (1,0) [0|127] "NA" MCU
 SG_ OBJ_Object_Age_8 : 6381|11@1+ (1,0) [0|2047] "Frames" MCU
 SG_ OBJ_Measuring_Status_8 : 6392|3@1+ (1,0) [0|7] "BITWIZE" MCU
 SG_ OBJ_Object_Class_8 : 6395|4@1+ (1,0) [0|8] "ENUM" MCU
 SG_ Reserved_3_8 : 6399|1@1+ (1,0) [0|0] "NA" MCU
 SG_ OBJ_Class_Probability_8 : 6400|7@1+ (0.01,0) [0|1] "NA" MCU
 SG_ OBJ_Buffer_C1_8 : 6407|7@1+ (1,0) [0|127] "NA" MCU
 SG_ OBJ_Buffer_C2_8 : 6414|7@1+ (1,0) [0|127] "NA" MCU
 SG_ OBJ_Buffer_C3_8 : 6421|7@1+ (1,0) [0|127] "NA" MCU
 SG_ OBJ_Camera_Source_8 : 6428|4@1+ (1,0) [0|15] "ENUM" MCU
 SG_ OBJ_Motion_Status_8 : 6432|3@1+ (1,0) [0|5] "ENUM " MCU
 SG_ OBJ_Motion_Orientation_8 : 6435|4@1+ (1,0) [0|13] "ENUM " MCU
 SG_ OBJ_Has_Cut_Lane_8 : 6439|1@1+ (1,0) [0|1] "bool" MCU
 SG_ OBJ_Has_Cut_Path_8 : 6440|1@1+ (1,0) [0|1] "bool" MCU
 SG_ OBJ_Brake_Light_8 : 6441|1@1+ (1,0) [0|1] "bool" MCU
 SG_ OBJ_Turn_Indicator_Right_8 : 6442|1@1+ (1,0) [0|1] "bool" MCU
 SG_ OBJ_Turn_Indicator_Left_8 : 6443|1@1+ (1,0) [0|1] "bool" MCU
 SG_ OBJ_Light_Indicator_Validity_8 : 6444|1@1+ (1,0) [0|1] "bool" MCU
 SG_ OBJ_Right_Out_Of_Image_8 : 6445|1@1+ (1,0) [0|1] "bool" MCU
 SG_ OBJ_Left_Out_Of_Image_8 : 6446|1@1+ (1,0) [0|1] "bool" MCU
 SG_ OBJ_Right_Out_Of_Image_V_8 : 6447|1@1+ (1,0) [0|1] "bool" MCU
 SG_ OBJ_Left_Out_Of_Image_V_8 : 6448|1@1+ (1,0) [0|1] "bool" MCU
 SG_ OBJ_Top_Out_Of_Image_8 : 6449|1@1+ (1,0) [0|1] "bool" MCU
 SG_ OBJ_Bottom_Out_Of_Image_8 : 6450|1@1+ (1,0) [0|1] "bool" MCU
 SG_ OBJ_Top_Out_Of_Image_V_8 : 6451|1@1+ (1,0) [0|1] "bool" MCU
 SG_ OBJ_Bottom_Out_Of_Image_V_8 : 6452|1@1+ (1,0) [0|1] "bool" MCU
 SG_ OBJ_Lane_Assignment_8 : 6453|3@1+ (1,0) [0|5] "ENUM" MCU
 SG_ OBJ_Lane_Assignment_V_8 : 6456|1@1+ (1,0) [0|1] "bool" MCU
 SG_ OBJ_Age_Seconds_8 : 6457|7@1+ (1,0) [0|100] "s" MCU
 SG_ OBJ_Age_Seconds_V_8 : 6464|1@1+ (1,0) [0|1] "bool" MCU
 SG_ OBJ_Width_8 : 6465|9@1+ (0.01,0) [0.4|2.95] "m" MCU
 SG_ OBJ_Width_V_8 : 6474|1@1+ (1,0) [0|1] "bool" MCU
 SG_ OBJ_Width_STD_8 : 6475|8@1+ (0.01,0) [0|2] "m" MCU
 SG_ OBJ_Width_STD_V_8 : 6483|1@1+ (1,0) [0|1] "bool" MCU
 SG_ OBJ_Length_8 : 6484|9@1+ (0.05,0) [1.2|21] "m" MCU
 SG_ OBJ_Length_V_8 : 6493|1@1+ (1,0) [0|1] "bool" MCU
 SG_ Reserved_4_8 : 6494|2@1+ (1,0) [0|0] "NA" MCU
 SG_ OBJ_Length_STD_8 : 6496|8@1+ (0.05,0) [0|10] "m" MCU
 SG_ OBJ_Length_STD_V_8 : 6504|1@1+ (1,0) [0|1] "bool" MCU
 SG_ OBJ_Height_8 : 6505|9@1+ (0.01,0) [0|2.95] "m" MCU
 SG_ OBJ_Height_V_8 : 6514|1@1+ (1,0) [0|1] "bool" MCU
 SG_ OBJ_Height_STD_8 : 6515|8@1+ (0.01,0) [0|2] "m" MCU
 SG_ OBJ_Height_STD_V_8 : 6523|1@1+ (1,0) [0|1] "bool" MCU
 SG_ Reserved_5_8 : 6524|4@1+ (1,0) [0|0] "NA" MCU
 SG_ OBJ_Abs_Long_Velocity_8 : 6528|12@1+ (0.05,-30) [-30|100] "MPS" MCU
 SG_ OBJ_Abs_Long_Velocity_V_8 : 6540|1@1+ (1,0) [0|1] "bool" MCU
 SG_ OBJ_Abs_Long_Velocity_STD_8 : 6541|11@1+ (0.05,0) [0|65] "MPS" MCU
 SG_ OBJ_Abs_Long_Vel_STD_V_8 : 6552|1@1+ (1,0) [0|1] "bool" MCU
 SG_ Reserved_6_8 : 6553|7@1+ (1,0) [0|0] "NA" MCU
 SG_ OBJ_Abs_Lat_Velocity_8 : 6560|11@1+ (0.05,-50) [-50|50] "MPS" MCU
 SG_ OBJ_Abs_Lat_Velocity_V_8 : 6571|1@1+ (1,0) [0|1] "bool" MCU
 SG_ OBJ_Abs_Lat_Velocity_STD_8 : 6572|10@1+ (0.05,0) [0|50] "MPS" MCU
 SG_ OBJ_Abs_Lat_Vel_STD_V_8 : 6582|1@1+ (1,0) [0|1] "bool" MCU
 SG_ OBJ_Abs_Long_Acc_8 : 6583|9@1+ (0.05,-10.3) [-10.3|7.3] "MPS2" MCU
 SG_ OBJ_Abs_Long_Acc_V_8 : 6592|1@1+ (1,0) [0|1] "bool" MCU
 SG_ OBJ_Abs_Long_Acc_STD_8 : 6593|8@1+ (0.05,0) [0|7.3] "MPS2" MCU
 SG_ OBJ_Abs_Long_Acc_STD_V_8 : 6601|1@1+ (1,0) [0|1] "bool" MCU
 SG_ OBJ_Abs_Lat_Acc_8 : 6602|9@1+ (0.05,-10.3) [-10.3|7.3] "MPS2" MCU
 SG_ OBJ_Abs_Lat_Acc_V_8 : 6611|1@1+ (1,0) [0|1] "bool" MCU
 SG_ OBJ_Abs_Lat_Acc_STD_8 : 6612|8@1+ (0.05,0) [0|7.3] "MPS2" MCU
 SG_ OBJ_Abs_Lat_Acc_STD_V_8 : 6620|1@1+ (1,0) [0|1] "bool" MCU
 SG_ Reserved_7_8 : 6621|3@1+ (1,0) [0|0] "NA" MCU
 SG_ OBJ_Abs_Acceleration_8 : 6624|9@1+ (0.05,-10.3) [-10.3|7.3] "MPS2" MCU
 SG_ OBJ_Abs_Acceleration_V_8 : 6633|1@1+ (1,0) [0|1] "bool" MCU
 SG_ OBJ_Abs_Acc_STD_8 : 6634|8@1+ (0.05,0) [0|7.3] "MPS2" MCU
 SG_ OBJ_Abs_Acc_STD_V_8 : 6642|1@1+ (1,0) [0|1] "bool" MCU
 SG_ OBJ_Inv_TTC_8 : 6643|11@1+ (0.01,-8) [-8|8] "INV(s)" MCU
 SG_ OBJ_Inv_TTC_V_8 : 6654|1@1+ (1,0) [0|1] "bool" MCU
 SG_ Reserved_8_8 : 6655|1@1+ (1,0) [0|0] "NA" MCU
 SG_ OBJ_Inv_TTC_STD_8 : 6656|11@1+ (0.01,0) [0|4] "INV(s)" MCU
 SG_ OBJ_Inv_TTC_STD_V_8 : 6667|1@1+ (1,0) [0|1] "bool" MCU
 SG_ OBJ_Relative_Long_Acc_8 : 6668|9@1+ (0.05,-10.3) [-10.3|7.3] "MPS2" MCU
 SG_ OBJ_Relative_Long_Acc_V_8 : 6677|1@1+ (1,0) [0|1] "bool" MCU
 SG_ OBJ_Relative_Long_Acc_STD_8 : 6678|8@1+ (0.05,0) [0|7.3] "MPS2" MCU
 SG_ OBJ_Rel_Long_Acc_STD_V_8 : 6686|1@1+ (1,0) [0|1] "bool" MCU
 SG_ Reserved_9_8 : 6687|1@1+ (1,0) [0|0] "NA" MCU
 SG_ OBJ_Relative_Long_Velocity_8 : 6688|13@1+ (0.05,-120) [-120|130] "MPS" MCU
 SG_ OBJ_Relative_Long_Velocity_V_8 : 6701|1@1+ (1,0) [0|1] "bool" MCU
 SG_ OBJ_Relative_Long_Vel_STD_8 : 6702|12@1+ (0.05,0) [0|130] "MPS" MCU
 SG_ OBJ_Rel_Long_Vel_STD_V_8 : 6714|1@1+ (1,0) [0|1] "bool" MCU
 SG_ Reserved_10_8 : 6715|5@1+ (1,0) [0|0] "NA" MCU
 SG_ OBJ_Relative_Lat_Velocity_8 : 6720|11@1+ (0.05,-50) [-50|50] "MPS" MCU
 SG_ OBJ_Relative_Lat_Velocity_V_8 : 6731|1@1+ (1,0) [0|1] "bool" MCU
 SG_ OBJ_Relative_Lat_Velocity_STD_8 : 6732|10@1+ (0.05,0) [0|50] "MPS" MCU
 SG_ OBJ_Rel_Lat_Vel_STD_V_8 : 6742|1@1+ (1,0) [0|1] "bool" MCU
 SG_ Reserved_11_8 : 6743|9@1+ (1,0) [0|0] "NA" MCU
 SG_ OBJ_Long_Distance_8 : 6752|14@1+ (0.05,-200) [-200|250] "m" MCU
 SG_ OBJ_Long_Distance_V_8 : 6766|1@1+ (1,0) [0|1] "bool" MCU
 SG_ OBJ_Long_Distance_STD_8 : 6767|13@1+ (0.05,0) [0|250] "m" MCU
 SG_ OBJ_Long_Distance_STD_V_8 : 6780|1@1+ (1,0) [0|1] "bool" MCU
 SG_ Reserved_12_8 : 6781|3@1+ (1,0) [0|0] "NA" MCU
 SG_ OBJ_Lat_Distance_8 : 6784|12@1+ (0.05,-100) [-100|100] "m" MCU
 SG_ OBJ_Lat_Distance_V_8 : 6796|1@1+ (1,0) [0|1] "bool" MCU
 SG_ OBJ_Lat_Distance_STD_8 : 6797|11@1+ (0.05,0) [0|100] "m" MCU
 SG_ OBJ_Lat_Distance_STD_V_8 : 6808|1@1+ (1,0) [0|1] "bool" MCU
 SG_ Reserved_13_8 : 6809|7@1+ (1,0) [0|0] "NA" MCU
 SG_ OBJ_Absolute_Speed_8 : 6816|12@1+ (0.05,-65) [-65|65] "MPS" MCU
 SG_ OBJ_Absolute_Speed_V_8 : 6828|1@1+ (1,0) [0|1] "bool" MCU
 SG_ OBJ_Absolute_Speed_STD_8 : 6829|11@1+ (0.05,0) [0|65] "MPS" MCU
 SG_ OBJ_Absolute_Speed_STD_V_8 : 6840|1@1+ (1,0) [0|1] "bool" MCU
 SG_ Reserved_14_8 : 6841|7@1+ (1,0) [0|0] "NA" MCU
 SG_ OBJ_Heading_8 : 6848|10@1+ (0.01,-3.14) [-3.14|3.14] "rad" MCU
 SG_ OBJ_Heading_V_8 : 6858|1@1+ (1,0) [0|1] "bool" MCU
 SG_ OBJ_Heading_STD_8 : 6859|9@1+ (0.01,0) [0|3.14] "rad" MCU
 SG_ OBJ_Heading_STD_V_8 : 6868|1@1+ (1,0) [0|1] "bool" MCU
 SG_ OBJ_Angle_Rate_STD_8 : 6869|11@1+ (0.002,0) [0|2.2318] "RPS" MCU
 SG_ OBJ_Angle_Rate_STD_V_8 : 6880|1@1+ (1,0) [0|1] "bool" MCU
 SG_ OBJ_Angle_Rate_8 : 6881|12@1+ (0.002,-2.234) [-2.234|2.2318] "RPS" MCU
 SG_ OBJ_Angle_Rate_V_8 : 6893|1@1+ (1,0) [0|1] "bool" MCU
 SG_ OBJ_Angle_Right_8 : 6894|14@1+ (0.0002,-1.571) [-1.571|1.571] "rad " MCU
 SG_ OBJ_Angle_Right_V_8 : 6908|1@1+ (1,0) [0|1] "bool" MCU
 SG_ Reserved_15_8 : 6909|3@1+ (1,0) [0|0] "NA" MCU
 SG_ OBJ_Angle_Right_STD_8 : 6912|13@1+ (0.0002,0) [0|1.571] "rad " MCU
 SG_ OBJ_Angle_Right_STD_V_8 : 6925|1@1+ (1,0) [0|1] "bool" MCU
 SG_ OBJ_Angle_Left_8 : 6926|14@1+ (0.0002,-1.571) [-1.571|1.571] "rad " MCU
 SG_ OBJ_Angle_Left_V_8 : 6940|1@1+ (1,0) [0|1] "bool" MCU
 SG_ Reserved_16_8 : 6941|3@1+ (1,0) [0|0] "NA" MCU
 SG_ OBJ_Angle_Left_STD_8 : 6944|13@1+ (0.0002,0) [0|1.571] "rad" MCU
 SG_ OBJ_Angle_Left_STD_V_8 : 6957|1@1+ (1,0) [0|1] "bool" MCU
 SG_ OBJ_Angle_Side_8 : 6958|14@1+ (0.0002,-1.571) [-1.571|1.571] "rad" MCU
 SG_ OBJ_Angle_Side_V_8 : 6972|1@1+ (1,0) [0|1] "bool" MCU
 SG_ Reserved_17_8 : 6973|3@1+ (1,0) [0|0] "NA" MCU
 SG_ OBJ_Angle_Side_STD_8 : 6976|13@1+ (0.0002,0) [0|1.571] "rad" MCU
 SG_ OBJ_Angle_Side_STD_V_8 : 6989|1@1+ (1,0) [0|1] "bool" MCU
 SG_ OBJ_Angle_Mid_V_8 : 6990|1@1+ (1,0) [0|1] "bool" MCU
 SG_ OBJ_Angle_Mid_8 : 6991|14@1+ (0.0002,-1.571) [-1.571|1.571] "rad" MCU
 SG_ Reserved_18_8 : 7005|3@1+ (1,0) [0|0] "NA" MCU
 SG_ OBJ_Angle_Mid_STD_8 : 7008|13@1+ (0.0002,0) [0|1.571] "rad" MCU
 SG_ OBJ_Angle_Mid_STD_V_8 : 7021|1@1+ (1,0) [0|1] "bool" MCU
 SG_ OBJ_Angle_Bottom_V_8 : 7022|1@1+ (1,0) [0|1] "bool" MCU
 SG_ OBJ_Angle_Bottom_8 : 7023|14@1+ (0.0002,-1.571) [-1.571|1.571] "rad" MCU
 SG_ Reserved_19_8 : 7037|3@1+ (1,0) [0|0] "NA" MCU
 SG_ OBJ_Angle_Bottom_STD_8 : 7040|13@1+ (0.0002,0) [0|1.571] "rad" MCU
 SG_ OBJ_Angle_Bottom_STD_V_8 : 7053|1@1+ (1,0) [0|1] "bool" MCU
 SG_ OBJ_Visibility_Side_V_8 : 7054|1@1+ (1,0) [0|1] "Bool" MCU
 SG_ OBJ_Visibility_Side_8 : 7055|2@1+ (1,0) [0|2] "ENUM" MCU
 SG_ OBJ_Is_In_Drivable_Area_8 : 7057|1@1+ (1,0) [0|1] "bool" MCU
 SG_ OBJ_Is_In_Drivable_Area_V_8 : 7058|1@1+ (1,0) [0|1] "bool" MCU
 SG_ OBJ_Is_VeryClose_8 : 7059|1@1+ (1,0) [0|1] "bool" MCU
 SG_ OBJ_Is_VeryClose_V_8 : 7060|1@1+ (1,0) [0|1] "bool" MCU
 SG_ OBJ_Occlusion_RL_8 : 7061|2@1+ (1,0) [0|2] "ENUM" MCU
 SG_ OBJ_Occlusion_RR_8 : 7063|2@1+ (1,0) [0|2] "ENUM" MCU
 SG_ OBJ_Occlusion_FR_8 : 7065|2@1+ (1,0) [0|2] "ENUM" MCU
 SG_ OBJ_Occlusion_FL_8 : 7067|2@1+ (1,0) [0|2] "ENUM" MCU
 SG_ OBJ_Buffer_8 : 7069|3@1+ (1,0) [0|0] "NA" MCU
 SG_ OBJ_CRC_9 : 7072|32@1+ (1,0) [0|4294967295] "NA" MCU
 SG_ OBJ_ID_9 : 7104|8@1+ (1,0) [0|255] "counter" MCU
 SG_ OBJ_Existence_Probability_9 : 7112|8@1+ (0.01,0) [0|1] "NA" MCU
 SG_ OBJ_Fusion_Source_9 : 7120|16@1+ (1,0) [0|65535] "BITWIZE" MCU
 SG_ OBJ_Triggered_SDM_9 : 7136|2@1+ (1,0) [0|2] "ENUM " MCU
 SG_ OBJ_Motion_Category_9 : 7138|4@1+ (1,0) [0|13] "ENUM " MCU
 SG_ OBJ_Buffer_C0_9 : 7142|7@1+ (1,0) [0|127] "NA" MCU
 SG_ OBJ_Object_Age_9 : 7149|11@1+ (1,0) [0|2047] "Frames" MCU
 SG_ OBJ_Measuring_Status_9 : 7160|3@1+ (1,0) [0|7] "BITWIZE" MCU
 SG_ OBJ_Object_Class_9 : 7163|4@1+ (1,0) [0|8] "ENUM" MCU
 SG_ Reserved_3_9 : 7167|1@1+ (1,0) [0|0] "NA" MCU
 SG_ OBJ_Class_Probability_9 : 7168|7@1+ (0.01,0) [0|1] "NA" MCU
 SG_ OBJ_Buffer_C1_9 : 7175|7@1+ (1,0) [0|127] "NA" MCU
 SG_ OBJ_Buffer_C2_9 : 7182|7@1+ (1,0) [0|127] "NA" MCU
 SG_ OBJ_Buffer_C3_9 : 7189|7@1+ (1,0) [0|127] "NA" MCU
 SG_ OBJ_Camera_Source_9 : 7196|4@1+ (1,0) [0|15] "ENUM" MCU
 SG_ OBJ_Motion_Status_9 : 7200|3@1+ (1,0) [0|5] "ENUM " MCU
 SG_ OBJ_Motion_Orientation_9 : 7203|4@1+ (1,0) [0|13] "ENUM " MCU
 SG_ OBJ_Has_Cut_Lane_9 : 7207|1@1+ (1,0) [0|1] "bool" MCU
 SG_ OBJ_Has_Cut_Path_9 : 7208|1@1+ (1,0) [0|1] "bool" MCU
 SG_ OBJ_Brake_Light_9 : 7209|1@1+ (1,0) [0|1] "bool" MCU
 SG_ OBJ_Turn_Indicator_Right_9 : 7210|1@1+ (1,0) [0|1] "bool" MCU
 SG_ OBJ_Turn_Indicator_Left_9 : 7211|1@1+ (1,0) [0|1] "bool" MCU
 SG_ OBJ_Light_Indicator_Validity_9 : 7212|1@1+ (1,0) [0|1] "bool" MCU
 SG_ OBJ_Right_Out_Of_Image_9 : 7213|1@1+ (1,0) [0|1] "bool" MCU
 SG_ OBJ_Left_Out_Of_Image_9 : 7214|1@1+ (1,0) [0|1] "bool" MCU
 SG_ OBJ_Right_Out_Of_Image_V_9 : 7215|1@1+ (1,0) [0|1] "bool" MCU
 SG_ OBJ_Left_Out_Of_Image_V_9 : 7216|1@1+ (1,0) [0|1] "bool" MCU
 SG_ OBJ_Top_Out_Of_Image_9 : 7217|1@1+ (1,0) [0|1] "bool" MCU
 SG_ OBJ_Bottom_Out_Of_Image_9 : 7218|1@1+ (1,0) [0|1] "bool" MCU
 SG_ OBJ_Top_Out_Of_Image_V_9 : 7219|1@1+ (1,0) [0|1] "bool" MCU
 SG_ OBJ_Bottom_Out_Of_Image_V_9 : 7220|1@1+ (1,0) [0|1] "bool" MCU
 SG_ OBJ_Lane_Assignment_9 : 7221|3@1+ (1,0) [0|5] "ENUM" MCU
 SG_ OBJ_Lane_Assignment_V_9 : 7224|1@1+ (1,0) [0|1] "bool" MCU
 SG_ OBJ_Age_Seconds_9 : 7225|7@1+ (1,0) [0|100] "s" MCU
 SG_ OBJ_Age_Seconds_V_9 : 7232|1@1+ (1,0) [0|1] "bool" MCU
 SG_ OBJ_Width_9 : 7233|9@1+ (0.01,0) [0.4|2.95] "m" MCU
 SG_ OBJ_Width_V_9 : 7242|1@1+ (1,0) [0|1] "bool" MCU
 SG_ OBJ_Width_STD_9 : 7243|8@1+ (0.01,0) [0|2] "m" MCU
 SG_ OBJ_Width_STD_V_9 : 7251|1@1+ (1,0) [0|1] "bool" MCU
 SG_ OBJ_Length_9 : 7252|9@1+ (0.05,0) [1.2|21] "m" MCU
 SG_ OBJ_Length_V_9 : 7261|1@1+ (1,0) [0|1] "bool" MCU
 SG_ Reserved_4_9 : 7262|2@1+ (1,0) [0|0] "NA" MCU
 SG_ OBJ_Length_STD_9 : 7264|8@1+ (0.05,0) [0|10] "m" MCU
 SG_ OBJ_Length_STD_V_9 : 7272|1@1+ (1,0) [0|1] "bool" MCU
 SG_ OBJ_Height_9 : 7273|9@1+ (0.01,0) [0|2.95] "m" MCU
 SG_ OBJ_Height_V_9 : 7282|1@1+ (1,0) [0|1] "bool" MCU
 SG_ OBJ_Height_STD_9 : 7283|8@1+ (0.01,0) [0|2] "m" MCU
 SG_ OBJ_Height_STD_V_9 : 7291|1@1+ (1,0) [0|1] "bool" MCU
 SG_ Reserved_5_9 : 7292|4@1+ (1,0) [0|0] "NA" MCU
 SG_ OBJ_Abs_Long_Velocity_9 : 7296|12@1+ (0.05,-30) [-30|100] "MPS" MCU
 SG_ OBJ_Abs_Long_Velocity_V_9 : 7308|1@1+ (1,0) [0|1] "bool" MCU
 SG_ OBJ_Abs_Long_Velocity_STD_9 : 7309|11@1+ (0.05,0) [0|65] "MPS" MCU
 SG_ OBJ_Abs_Long_Vel_STD_V_9 : 7320|1@1+ (1,0) [0|1] "bool" MCU
 SG_ Reserved_6_9 : 7321|7@1+ (1,0) [0|0] "NA" MCU
 SG_ OBJ_Abs_Lat_Velocity_9 : 7328|11@1+ (0.05,-50) [-50|50] "MPS" MCU
 SG_ OBJ_Abs_Lat_Velocity_V_9 : 7339|1@1+ (1,0) [0|1] "bool" MCU
 SG_ OBJ_Abs_Lat_Velocity_STD_9 : 7340|10@1+ (0.05,0) [0|50] "MPS" MCU
 SG_ OBJ_Abs_Lat_Vel_STD_V_9 : 7350|1@1+ (1,0) [0|1] "bool" MCU
 SG_ OBJ_Abs_Long_Acc_9 : 7351|9@1+ (0.05,-10.3) [-10.3|7.3] "MPS2" MCU
 SG_ OBJ_Abs_Long_Acc_V_9 : 7360|1@1+ (1,0) [0|1] "bool" MCU
 SG_ OBJ_Abs_Long_Acc_STD_9 : 7361|8@1+ (0.05,0) [0|7.3] "MPS2" MCU
 SG_ OBJ_Abs_Long_Acc_STD_V_9 : 7369|1@1+ (1,0) [0|1] "bool" MCU
 SG_ OBJ_Abs_Lat_Acc_9 : 7370|9@1+ (0.05,-10.3) [-10.3|7.3] "MPS2" MCU
 SG_ OBJ_Abs_Lat_Acc_V_9 : 7379|1@1+ (1,0) [0|1] "bool" MCU
 SG_ OBJ_Abs_Lat_Acc_STD_9 : 7380|8@1+ (0.05,0) [0|7.3] "MPS2" MCU
 SG_ OBJ_Abs_Lat_Acc_STD_V_9 : 7388|1@1+ (1,0) [0|1] "bool" MCU
 SG_ Reserved_7_9 : 7389|3@1+ (1,0) [0|0] "NA" MCU
 SG_ OBJ_Abs_Acceleration_9 : 7392|9@1+ (0.05,-10.3) [-10.3|7.3] "MPS2" MCU
 SG_ OBJ_Abs_Acceleration_V_9 : 7401|1@1+ (1,0) [0|1] "bool" MCU
 SG_ OBJ_Abs_Acc_STD_9 : 7402|8@1+ (0.05,0) [0|7.3] "MPS2" MCU
 SG_ OBJ_Abs_Acc_STD_V_9 : 7410|1@1+ (1,0) [0|1] "bool" MCU
 SG_ OBJ_Inv_TTC_9 : 7411|11@1+ (0.01,-8) [-8|8] "INV(s)" MCU
 SG_ OBJ_Inv_TTC_V_9 : 7422|1@1+ (1,0) [0|1] "bool" MCU
 SG_ Reserved_8_9 : 7423|1@1+ (1,0) [0|0] "NA" MCU
 SG_ OBJ_Inv_TTC_STD_9 : 7424|11@1+ (0.01,0) [0|4] "INV(s)" MCU
 SG_ OBJ_Inv_TTC_STD_V_9 : 7435|1@1+ (1,0) [0|1] "bool" MCU
 SG_ OBJ_Relative_Long_Acc_9 : 7436|9@1+ (0.05,-10.3) [-10.3|7.3] "MPS2" MCU
 SG_ OBJ_Relative_Long_Acc_V_9 : 7445|1@1+ (1,0) [0|1] "bool" MCU
 SG_ OBJ_Relative_Long_Acc_STD_9 : 7446|8@1+ (0.05,0) [0|7.3] "MPS2" MCU
 SG_ OBJ_Rel_Long_Acc_STD_V_9 : 7454|1@1+ (1,0) [0|1] "bool" MCU
 SG_ Reserved_9_9 : 7455|1@1+ (1,0) [0|0] "NA" MCU
 SG_ OBJ_Relative_Long_Velocity_9 : 7456|13@1+ (0.05,-120) [-120|130] "MPS" MCU
 SG_ OBJ_Relative_Long_Velocity_V_9 : 7469|1@1+ (1,0) [0|1] "bool" MCU
 SG_ OBJ_Relative_Long_Vel_STD_9 : 7470|12@1+ (0.05,0) [0|130] "MPS" MCU
 SG_ OBJ_Rel_Long_Vel_STD_V_9 : 7482|1@1+ (1,0) [0|1] "bool" MCU
 SG_ Reserved_10_9 : 7483|5@1+ (1,0) [0|0] "NA" MCU
 SG_ OBJ_Relative_Lat_Velocity_9 : 7488|11@1+ (0.05,-50) [-50|50] "MPS" MCU
 SG_ OBJ_Relative_Lat_Velocity_V_9 : 7499|1@1+ (1,0) [0|1] "bool" MCU
 SG_ OBJ_Relative_Lat_Velocity_STD_9 : 7500|10@1+ (0.05,0) [0|50] "MPS" MCU
 SG_ OBJ_Rel_Lat_Vel_STD_V_9 : 7510|1@1+ (1,0) [0|1] "bool" MCU
 SG_ Reserved_11_9 : 7511|9@1+ (1,0) [0|0] "NA" MCU
 SG_ OBJ_Long_Distance_9 : 7520|14@1+ (0.05,-200) [-200|250] "m" MCU
 SG_ OBJ_Long_Distance_V_9 : 7534|1@1+ (1,0) [0|1] "bool" MCU
 SG_ OBJ_Long_Distance_STD_9 : 7535|13@1+ (0.05,0) [0|250] "m" MCU
 SG_ OBJ_Long_Distance_STD_V_9 : 7548|1@1+ (1,0) [0|1] "bool" MCU
 SG_ Reserved_12_9 : 7549|3@1+ (1,0) [0|0] "NA" MCU
 SG_ OBJ_Lat_Distance_9 : 7552|12@1+ (0.05,-100) [-100|100] "m" MCU
 SG_ OBJ_Lat_Distance_V_9 : 7564|1@1+ (1,0) [0|1] "bool" MCU
 SG_ OBJ_Lat_Distance_STD_9 : 7565|11@1+ (0.05,0) [0|100] "m" MCU
 SG_ OBJ_Lat_Distance_STD_V_9 : 7576|1@1+ (1,0) [0|1] "bool" MCU
 SG_ Reserved_13_9 : 7577|7@1+ (1,0) [0|0] "NA" MCU
 SG_ OBJ_Absolute_Speed_9 : 7584|12@1+ (0.05,-65) [-65|65] "MPS" MCU
 SG_ OBJ_Absolute_Speed_V_9 : 7596|1@1+ (1,0) [0|1] "bool" MCU
 SG_ OBJ_Absolute_Speed_STD_9 : 7597|11@1+ (0.05,0) [0|65] "MPS" MCU
 SG_ OBJ_Absolute_Speed_STD_V_9 : 7608|1@1+ (1,0) [0|1] "bool" MCU
 SG_ Reserved_14_9 : 7609|7@1+ (1,0) [0|0] "NA" MCU
 SG_ OBJ_Heading_9 : 7616|10@1+ (0.01,-3.14) [-3.14|3.14] "rad" MCU
 SG_ OBJ_Heading_V_9 : 7626|1@1+ (1,0) [0|1] "bool" MCU
 SG_ OBJ_Heading_STD_9 : 7627|9@1+ (0.01,0) [0|3.14] "rad" MCU
 SG_ OBJ_Heading_STD_V_9 : 7636|1@1+ (1,0) [0|1] "bool" MCU
 SG_ OBJ_Angle_Rate_STD_9 : 7637|11@1+ (0.002,0) [0|2.2318] "RPS" MCU
 SG_ OBJ_Angle_Rate_STD_V_9 : 7648|1@1+ (1,0) [0|1] "bool" MCU
 SG_ OBJ_Angle_Rate_9 : 7649|12@1+ (0.002,-2.234) [-2.234|2.2318] "RPS" MCU
 SG_ OBJ_Angle_Rate_V_9 : 7661|1@1+ (1,0) [0|1] "bool" MCU
 SG_ OBJ_Angle_Right_9 : 7662|14@1+ (0.0002,-1.571) [-1.571|1.571] "rad " MCU
 SG_ OBJ_Angle_Right_V_9 : 7676|1@1+ (1,0) [0|1] "bool" MCU
 SG_ Reserved_15_9 : 7677|3@1+ (1,0) [0|0] "NA" MCU
 SG_ OBJ_Angle_Right_STD_9 : 7680|13@1+ (0.0002,0) [0|1.571] "rad " MCU
 SG_ OBJ_Angle_Right_STD_V_9 : 7693|1@1+ (1,0) [0|1] "bool" MCU
 SG_ OBJ_Angle_Left_9 : 7694|14@1+ (0.0002,-1.571) [-1.571|1.571] "rad " MCU
 SG_ OBJ_Angle_Left_V_9 : 7708|1@1+ (1,0) [0|1] "bool" MCU
 SG_ Reserved_16_9 : 7709|3@1+ (1,0) [0|0] "NA" MCU
 SG_ OBJ_Angle_Left_STD_9 : 7712|13@1+ (0.0002,0) [0|1.571] "rad" MCU
 SG_ OBJ_Angle_Left_STD_V_9 : 7725|1@1+ (1,0) [0|1] "bool" MCU
 SG_ OBJ_Angle_Side_9 : 7726|14@1+ (0.0002,-1.571) [-1.571|1.571] "rad" MCU
 SG_ OBJ_Angle_Side_V_9 : 7740|1@1+ (1,0) [0|1] "bool" MCU
 SG_ Reserved_17_9 : 7741|3@1+ (1,0) [0|0] "NA" MCU
 SG_ OBJ_Angle_Side_STD_9 : 7744|13@1+ (0.0002,0) [0|1.571] "rad" MCU
 SG_ OBJ_Angle_Side_STD_V_9 : 7757|1@1+ (1,0) [0|1] "bool" MCU
 SG_ OBJ_Angle_Mid_V_9 : 7758|1@1+ (1,0) [0|1] "bool" MCU
 SG_ OBJ_Angle_Mid_9 : 7759|14@1+ (0.0002,-1.571) [-1.571|1.571] "rad" MCU
 SG_ Reserved_18_9 : 7773|3@1+ (1,0) [0|0] "NA" MCU
 SG_ OBJ_Angle_Mid_STD_9 : 7776|13@1+ (0.0002,0) [0|1.571] "rad" MCU
 SG_ OBJ_Angle_Mid_STD_V_9 : 7789|1@1+ (1,0) [0|1] "bool" MCU
 SG_ OBJ_Angle_Bottom_V_9 : 7790|1@1+ (1,0) [0|1] "bool" MCU
 SG_ OBJ_Angle_Bottom_9 : 7791|14@1+ (0.0002,-1.571) [-1.571|1.571] "rad" MCU
 SG_ Reserved_19_9 : 7805|3@1+ (1,0) [0|0] "NA" MCU
 SG_ OBJ_Angle_Bottom_STD_9 : 7808|13@1+ (0.0002,0) [0|1.571] "rad" MCU
 SG_ OBJ_Angle_Bottom_STD_V_9 : 7821|1@1+ (1,0) [0|1] "bool" MCU
 SG_ OBJ_Visibility_Side_V_9 : 7822|1@1+ (1,0) [0|1] "Bool" MCU
 SG_ OBJ_Visibility_Side_9 : 7823|2@1+ (1,0) [0|2] "ENUM" MCU
 SG_ OBJ_Is_In_Drivable_Area_9 : 7825|1@1+ (1,0) [0|1] "bool" MCU
 SG_ OBJ_Is_In_Drivable_Area_V_9 : 7826|1@1+ (1,0) [0|1] "bool" MCU
 SG_ OBJ_Is_VeryClose_9 : 7827|1@1+ (1,0) [0|1] "bool" MCU
 SG_ OBJ_Is_VeryClose_V_9 : 7828|1@1+ (1,0) [0|1] "bool" MCU
 SG_ OBJ_Occlusion_RL_9 : 7829|2@1+ (1,0) [0|2] "ENUM" MCU
 SG_ OBJ_Occlusion_RR_9 : 7831|2@1+ (1,0) [0|2] "ENUM" MCU
 SG_ OBJ_Occlusion_FR_9 : 7833|2@1+ (1,0) [0|2] "ENUM" MCU
 SG_ OBJ_Occlusion_FL_9 : 7835|2@1+ (1,0) [0|2] "ENUM" MCU
 SG_ OBJ_Buffer_9 : 7837|3@1+ (1,0) [0|0] "NA" MCU
 SG_ OBJ_CRC_10 : 7840|32@1+ (1,0) [0|4294967295] "NA" MCU
 SG_ OBJ_ID_10 : 7872|8@1+ (1,0) [0|255] "counter" MCU
 SG_ OBJ_Existence_Probability_10 : 7880|8@1+ (0.01,0) [0|1] "NA" MCU
 SG_ OBJ_Fusion_Source_10 : 7888|16@1+ (1,0) [0|65535] "BITWIZE" MCU
 SG_ OBJ_Triggered_SDM_10 : 7904|2@1+ (1,0) [0|2] "ENUM " MCU
 SG_ OBJ_Motion_Category_10 : 7906|4@1+ (1,0) [0|13] "ENUM " MCU
 SG_ OBJ_Buffer_C0_10 : 7910|7@1+ (1,0) [0|127] "NA" MCU
 SG_ OBJ_Object_Age_10 : 7917|11@1+ (1,0) [0|2047] "Frames" MCU
 SG_ OBJ_Measuring_Status_10 : 7928|3@1+ (1,0) [0|7] "BITWIZE" MCU
 SG_ OBJ_Object_Class_10 : 7931|4@1+ (1,0) [0|8] "ENUM" MCU
 SG_ Reserved_3_10 : 7935|1@1+ (1,0) [0|0] "NA" MCU
 SG_ OBJ_Class_Probability_10 : 7936|7@1+ (0.01,0) [0|1] "NA" MCU
 SG_ OBJ_Buffer_C1_10 : 7943|7@1+ (1,0) [0|127] "NA" MCU
 SG_ OBJ_Buffer_C2_10 : 7950|7@1+ (1,0) [0|127] "NA" MCU
 SG_ OBJ_Buffer_C3_10 : 7957|7@1+ (1,0) [0|127] "NA" MCU
 SG_ OBJ_Camera_Source_10 : 7964|4@1+ (1,0) [0|15] "ENUM" MCU
 SG_ OBJ_Motion_Status_10 : 7968|3@1+ (1,0) [0|5] "ENUM " MCU
 SG_ OBJ_Motion_Orientation_10 : 7971|4@1+ (1,0) [0|13] "ENUM " MCU
 SG_ OBJ_Has_Cut_Lane_10 : 7975|1@1+ (1,0) [0|1] "bool" MCU
 SG_ OBJ_Has_Cut_Path_10 : 7976|1@1+ (1,0) [0|1] "bool" MCU
 SG_ OBJ_Brake_Light_10 : 7977|1@1+ (1,0) [0|1] "bool" MCU
 SG_ OBJ_Turn_Indicator_Right_10 : 7978|1@1+ (1,0) [0|1] "bool" MCU
 SG_ OBJ_Turn_Indicator_Left_10 : 7979|1@1+ (1,0) [0|1] "bool" MCU
 SG_ OBJ_Light_Indicator_Validity_10 : 7980|1@1+ (1,0) [0|1] "bool" MCU
 SG_ OBJ_Right_Out_Of_Image_10 : 7981|1@1+ (1,0) [0|1] "bool" MCU
 SG_ OBJ_Left_Out_Of_Image_10 : 7982|1@1+ (1,0) [0|1] "bool" MCU
 SG_ OBJ_Right_Out_Of_Image_V_10 : 7983|1@1+ (1,0) [0|1] "bool" MCU
 SG_ OBJ_Left_Out_Of_Image_V_10 : 7984|1@1+ (1,0) [0|1] "bool" MCU
 SG_ OBJ_Top_Out_Of_Image_10 : 7985|1@1+ (1,0) [0|1] "bool" MCU
 SG_ OBJ_Bottom_Out_Of_Image_10 : 7986|1@1+ (1,0) [0|1] "bool" MCU
 SG_ OBJ_Top_Out_Of_Image_V_10 : 7987|1@1+ (1,0) [0|1] "bool" MCU
 SG_ OBJ_Bottom_Out_Of_Image_V_10 : 7988|1@1+ (1,0) [0|1] "bool" MCU
 SG_ OBJ_Lane_Assignment_10 : 7989|3@1+ (1,0) [0|5] "ENUM" MCU
 SG_ OBJ_Lane_Assignment_V_10 : 7992|1@1+ (1,0) [0|1] "bool" MCU
 SG_ OBJ_Age_Seconds_10 : 7993|7@1+ (1,0) [0|100] "s" MCU
 SG_ OBJ_Age_Seconds_V_10 : 8000|1@1+ (1,0) [0|1] "bool" MCU
 SG_ OBJ_Width_10 : 8001|9@1+ (0.01,0) [0.4|2.95] "m" MCU
 SG_ OBJ_Width_V_10 : 8010|1@1+ (1,0) [0|1] "bool" MCU
 SG_ OBJ_Width_STD_10 : 8011|8@1+ (0.01,0) [0|2] "m" MCU
 SG_ OBJ_Width_STD_V_10 : 8019|1@1+ (1,0) [0|1] "bool" MCU
 SG_ OBJ_Length_10 : 8020|9@1+ (0.05,0) [1.2|21] "m" MCU
 SG_ OBJ_Length_V_10 : 8029|1@1+ (1,0) [0|1] "bool" MCU
 SG_ Reserved_4_10 : 8030|2@1+ (1,0) [0|0] "NA" MCU
 SG_ OBJ_Length_STD_10 : 8032|8@1+ (0.05,0) [0|10] "m" MCU
 SG_ OBJ_Length_STD_V_10 : 8040|1@1+ (1,0) [0|1] "bool" MCU
 SG_ OBJ_Height_10 : 8041|9@1+ (0.01,0) [0|2.95] "m" MCU
 SG_ OBJ_Height_V_10 : 8050|1@1+ (1,0) [0|1] "bool" MCU
 SG_ OBJ_Height_STD_10 : 8051|8@1+ (0.01,0) [0|2] "m" MCU
 SG_ OBJ_Height_STD_V_10 : 8059|1@1+ (1,0) [0|1] "bool" MCU
 SG_ Reserved_5_10 : 8060|4@1+ (1,0) [0|0] "NA" MCU
 SG_ OBJ_Abs_Long_Velocity_10 : 8064|12@1+ (0.05,-30) [-30|100] "MPS" MCU
 SG_ OBJ_Abs_Long_Velocity_V_10 : 8076|1@1+ (1,0) [0|1] "bool" MCU
 SG_ OBJ_Abs_Long_Velocity_STD_10 : 8077|11@1+ (0.05,0) [0|65] "MPS" MCU
 SG_ OBJ_Abs_Long_Vel_STD_V_10 : 8088|1@1+ (1,0) [0|1] "bool" MCU
 SG_ Reserved_6_10 : 8089|7@1+ (1,0) [0|0] "NA" MCU
 SG_ OBJ_Abs_Lat_Velocity_10 : 8096|11@1+ (0.05,-50) [-50|50] "MPS" MCU
 SG_ OBJ_Abs_Lat_Velocity_V_10 : 8107|1@1+ (1,0) [0|1] "bool" MCU
 SG_ OBJ_Abs_Lat_Velocity_STD_10 : 8108|10@1+ (0.05,0) [0|50] "MPS" MCU
 SG_ OBJ_Abs_Lat_Vel_STD_V_10 : 8118|1@1+ (1,0) [0|1] "bool" MCU
 SG_ OBJ_Abs_Long_Acc_10 : 8119|9@1+ (0.05,-10.3) [-10.3|7.3] "MPS2" MCU
 SG_ OBJ_Abs_Long_Acc_V_10 : 8128|1@1+ (1,0) [0|1] "bool" MCU
 SG_ OBJ_Abs_Long_Acc_STD_10 : 8129|8@1+ (0.05,0) [0|7.3] "MPS2" MCU
 SG_ OBJ_Abs_Long_Acc_STD_V_10 : 8137|1@1+ (1,0) [0|1] "bool" MCU
 SG_ OBJ_Abs_Lat_Acc_10 : 8138|9@1+ (0.05,-10.3) [-10.3|7.3] "MPS2" MCU
 SG_ OBJ_Abs_Lat_Acc_V_10 : 8147|1@1+ (1,0) [0|1] "bool" MCU
 SG_ OBJ_Abs_Lat_Acc_STD_10 : 8148|8@1+ (0.05,0) [0|7.3] "MPS2" MCU
 SG_ OBJ_Abs_Lat_Acc_STD_V_10 : 8156|1@1+ (1,0) [0|1] "bool" MCU
 SG_ Reserved_7_10 : 8157|3@1+ (1,0) [0|0] "NA" MCU
 SG_ OBJ_Abs_Acceleration_10 : 8160|9@1+ (0.05,-10.3) [-10.3|7.3] "MPS2" MCU
 SG_ OBJ_Abs_Acceleration_V_10 : 8169|1@1+ (1,0) [0|1] "bool" MCU
 SG_ OBJ_Abs_Acc_STD_10 : 8170|8@1+ (0.05,0) [0|7.3] "MPS2" MCU
 SG_ OBJ_Abs_Acc_STD_V_10 : 8178|1@1+ (1,0) [0|1] "bool" MCU
 SG_ OBJ_Inv_TTC_10 : 8179|11@1+ (0.01,-8) [-8|8] "INV(s)" MCU
 SG_ OBJ_Inv_TTC_V_10 : 8190|1@1+ (1,0) [0|1] "bool" MCU
 SG_ Reserved_8_10 : 8191|1@1+ (1,0) [0|0] "NA" MCU
 SG_ OBJ_Inv_TTC_STD_10 : 8192|11@1+ (0.01,0) [0|4] "INV(s)" MCU
 SG_ OBJ_Inv_TTC_STD_V_10 : 8203|1@1+ (1,0) [0|1] "bool" MCU
 SG_ OBJ_Relative_Long_Acc_10 : 8204|9@1+ (0.05,-10.3) [-10.3|7.3] "MPS2" MCU
 SG_ OBJ_Relative_Long_Acc_V_10 : 8213|1@1+ (1,0) [0|1] "bool" MCU
 SG_ OBJ_Relative_Long_Acc_STD_10 : 8214|8@1+ (0.05,0) [0|7.3] "MPS2" MCU
 SG_ OBJ_Rel_Long_Acc_STD_V_10 : 8222|1@1+ (1,0) [0|1] "bool" MCU
 SG_ Reserved_9_10 : 8223|1@1+ (1,0) [0|0] "NA" MCU
 SG_ OBJ_Relative_Long_Velocity_10 : 8224|13@1+ (0.05,-120) [-120|130] "MPS" MCU
 SG_ OBJ_Relative_Long_Velocity_V_10 : 8237|1@1+ (1,0) [0|1] "bool" MCU
 SG_ OBJ_Relative_Long_Vel_STD_10 : 8238|12@1+ (0.05,0) [0|130] "MPS" MCU
 SG_ OBJ_Rel_Long_Vel_STD_V_10 : 8250|1@1+ (1,0) [0|1] "bool" MCU
 SG_ Reserved_10_10 : 8251|5@1+ (1,0) [0|0] "NA" MCU
 SG_ OBJ_Relative_Lat_Velocity_10 : 8256|11@1+ (0.05,-50) [-50|50] "MPS" MCU
 SG_ OBJ_Relative_Lat_Velocity_V_10 : 8267|1@1+ (1,0) [0|1] "bool" MCU
 SG_ OBJ_Relative_Lat_Velocity_STD_10 : 8268|10@1+ (0.05,0) [0|50] "MPS" MCU
 SG_ OBJ_Rel_Lat_Vel_STD_V_10 : 8278|1@1+ (1,0) [0|1] "bool" MCU
 SG_ Reserved_11_10 : 8279|9@1+ (1,0) [0|0] "NA" MCU
 SG_ OBJ_Long_Distance_10 : 8288|14@1+ (0.05,-200) [-200|250] "m" MCU
 SG_ OBJ_Long_Distance_V_10 : 8302|1@1+ (1,0) [0|1] "bool" MCU
 SG_ OBJ_Long_Distance_STD_10 : 8303|13@1+ (0.05,0) [0|250] "m" MCU
 SG_ OBJ_Long_Distance_STD_V_10 : 8316|1@1+ (1,0) [0|1] "bool" MCU
 SG_ Reserved_12_10 : 8317|3@1+ (1,0) [0|0] "NA" MCU
 SG_ OBJ_Lat_Distance_10 : 8320|12@1+ (0.05,-100) [-100|100] "m" MCU
 SG_ OBJ_Lat_Distance_V_10 : 8332|1@1+ (1,0) [0|1] "bool" MCU
 SG_ OBJ_Lat_Distance_STD_10 : 8333|11@1+ (0.05,0) [0|100] "m" MCU
 SG_ OBJ_Lat_Distance_STD_V_10 : 8344|1@1+ (1,0) [0|1] "bool" MCU
 SG_ Reserved_13_10 : 8345|7@1+ (1,0) [0|0] "NA" MCU
 SG_ OBJ_Absolute_Speed_10 : 8352|12@1+ (0.05,-65) [-65|65] "MPS" MCU
 SG_ OBJ_Absolute_Speed_V_10 : 8364|1@1+ (1,0) [0|1] "bool" MCU
 SG_ OBJ_Absolute_Speed_STD_10 : 8365|11@1+ (0.05,0) [0|65] "MPS" MCU
 SG_ OBJ_Absolute_Speed_STD_V_10 : 8376|1@1+ (1,0) [0|1] "bool" MCU
 SG_ Reserved_14_10 : 8377|7@1+ (1,0) [0|0] "NA" MCU
 SG_ OBJ_Heading_10 : 8384|10@1+ (0.01,-3.14) [-3.14|3.14] "rad" MCU
 SG_ OBJ_Heading_V_10 : 8394|1@1+ (1,0) [0|1] "bool" MCU
 SG_ OBJ_Heading_STD_10 : 8395|9@1+ (0.01,0) [0|3.14] "rad" MCU
 SG_ OBJ_Heading_STD_V_10 : 8404|1@1+ (1,0) [0|1] "bool" MCU
 SG_ OBJ_Angle_Rate_STD_10 : 8405|11@1+ (0.002,0) [0|2.2318] "RPS" MCU
 SG_ OBJ_Angle_Rate_STD_V_10 : 8416|1@1+ (1,0) [0|1] "bool" MCU
 SG_ OBJ_Angle_Rate_10 : 8417|12@1+ (0.002,-2.234) [-2.234|2.2318] "RPS" MCU
 SG_ OBJ_Angle_Rate_V_10 : 8429|1@1+ (1,0) [0|1] "bool" MCU
 SG_ OBJ_Angle_Right_10 : 8430|14@1+ (0.0002,-1.571) [-1.571|1.571] "rad " MCU
 SG_ OBJ_Angle_Right_V_10 : 8444|1@1+ (1,0) [0|1] "bool" MCU
 SG_ Reserved_15_10 : 8445|3@1+ (1,0) [0|0] "NA" MCU
 SG_ OBJ_Angle_Right_STD_10 : 8448|13@1+ (0.0002,0) [0|1.571] "rad " MCU
 SG_ OBJ_Angle_Right_STD_V_10 : 8461|1@1+ (1,0) [0|1] "bool" MCU
 SG_ OBJ_Angle_Left_10 : 8462|14@1+ (0.0002,-1.571) [-1.571|1.571] "rad " MCU
 SG_ OBJ_Angle_Left_V_10 : 8476|1@1+ (1,0) [0|1] "bool" MCU
 SG_ Reserved_16_10 : 8477|3@1+ (1,0) [0|0] "NA" MCU
 SG_ OBJ_Angle_Left_STD_10 : 8480|13@1+ (0.0002,0) [0|1.571] "rad" MCU
 SG_ OBJ_Angle_Left_STD_V_10 : 8493|1@1+ (1,0) [0|1] "bool" MCU
 SG_ OBJ_Angle_Side_10 : 8494|14@1+ (0.0002,-1.571) [-1.571|1.571] "rad" MCU
 SG_ OBJ_Angle_Side_V_10 : 8508|1@1+ (1,0) [0|1] "bool" MCU
 SG_ Reserved_17_10 : 8509|3@1+ (1,0) [0|0] "NA" MCU
 SG_ OBJ_Angle_Side_STD_10 : 8512|13@1+ (0.0002,0) [0|1.571] "rad" MCU
 SG_ OBJ_Angle_Side_STD_V_10 : 8525|1@1+ (1,0) [0|1] "bool" MCU
 SG_ OBJ_Angle_Mid_V_10 : 8526|1@1+ (1,0) [0|1] "bool" MCU
 SG_ OBJ_Angle_Mid_10 : 8527|14@1+ (0.0002,-1.571) [-1.571|1.571] "rad" MCU
 SG_ Reserved_18_10 : 8541|3@1+ (1,0) [0|0] "NA" MCU
 SG_ OBJ_Angle_Mid_STD_10 : 8544|13@1+ (0.0002,0) [0|1.571] "rad" MCU
 SG_ OBJ_Angle_Mid_STD_V_10 : 8557|1@1+ (1,0) [0|1] "bool" MCU
 SG_ OBJ_Angle_Bottom_V_10 : 8558|1@1+ (1,0) [0|1] "bool" MCU
 SG_ OBJ_Angle_Bottom_10 : 8559|14@1+ (0.0002,-1.571) [-1.571|1.571] "rad" MCU
 SG_ Reserved_19_10 : 8573|3@1+ (1,0) [0|0] "NA" MCU
 SG_ OBJ_Angle_Bottom_STD_10 : 8576|13@1+ (0.0002,0) [0|1.571] "rad" MCU
 SG_ OBJ_Angle_Bottom_STD_V_10 : 8589|1@1+ (1,0) [0|1] "bool" MCU
 SG_ OBJ_Visibility_Side_V_10 : 8590|1@1+ (1,0) [0|1] "Bool" MCU
 SG_ OBJ_Visibility_Side_10 : 8591|2@1+ (1,0) [0|2] "ENUM" MCU
 SG_ OBJ_Is_In_Drivable_Area_10 : 8593|1@1+ (1,0) [0|1] "bool" MCU
 SG_ OBJ_Is_In_Drivable_Area_V_10 : 8594|1@1+ (1,0) [0|1] "bool" MCU
 SG_ OBJ_Is_VeryClose_10 : 8595|1@1+ (1,0) [0|1] "bool" MCU
 SG_ OBJ_Is_VeryClose_V_10 : 8596|1@1+ (1,0) [0|1] "bool" MCU
 SG_ OBJ_Occlusion_RL_10 : 8597|2@1+ (1,0) [0|2] "ENUM" MCU
 SG_ OBJ_Occlusion_RR_10 : 8599|2@1+ (1,0) [0|2] "ENUM" MCU
 SG_ OBJ_Occlusion_FR_10 : 8601|2@1+ (1,0) [0|2] "ENUM" MCU
 SG_ OBJ_Occlusion_FL_10 : 8603|2@1+ (1,0) [0|2] "ENUM" MCU
 SG_ OBJ_Buffer_10 : 8605|3@1+ (1,0) [0|0] "NA" MCU
 SG_ OBJ_CRC_11 : 8608|32@1+ (1,0) [0|4294967295] "NA" MCU
 SG_ OBJ_ID_11 : 8640|8@1+ (1,0) [0|255] "counter" MCU
 SG_ OBJ_Existence_Probability_11 : 8648|8@1+ (0.01,0) [0|1] "NA" MCU
 SG_ OBJ_Fusion_Source_11 : 8656|16@1+ (1,0) [0|65535] "BITWIZE" MCU
 SG_ OBJ_Triggered_SDM_11 : 8672|2@1+ (1,0) [0|2] "ENUM " MCU
 SG_ OBJ_Motion_Category_11 : 8674|4@1+ (1,0) [0|13] "ENUM " MCU
 SG_ OBJ_Buffer_C0_11 : 8678|7@1+ (1,0) [0|127] "NA" MCU
 SG_ OBJ_Object_Age_11 : 8685|11@1+ (1,0) [0|2047] "Frames" MCU
 SG_ OBJ_Measuring_Status_11 : 8696|3@1+ (1,0) [0|7] "BITWIZE" MCU
 SG_ OBJ_Object_Class_11 : 8699|4@1+ (1,0) [0|8] "ENUM" MCU
 SG_ Reserved_3_11 : 8703|1@1+ (1,0) [0|0] "NA" MCU
 SG_ OBJ_Class_Probability_11 : 8704|7@1+ (0.01,0) [0|1] "NA" MCU
 SG_ OBJ_Buffer_C1_11 : 8711|7@1+ (1,0) [0|127] "NA" MCU
 SG_ OBJ_Buffer_C2_11 : 8718|7@1+ (1,0) [0|127] "NA" MCU
 SG_ OBJ_Buffer_C3_11 : 8725|7@1+ (1,0) [0|127] "NA" MCU
 SG_ OBJ_Camera_Source_11 : 8732|4@1+ (1,0) [0|15] "ENUM" MCU
 SG_ OBJ_Motion_Status_11 : 8736|3@1+ (1,0) [0|5] "ENUM " MCU
 SG_ OBJ_Motion_Orientation_11 : 8739|4@1+ (1,0) [0|13] "ENUM " MCU
 SG_ OBJ_Has_Cut_Lane_11 : 8743|1@1+ (1,0) [0|1] "bool" MCU
 SG_ OBJ_Has_Cut_Path_11 : 8744|1@1+ (1,0) [0|1] "bool" MCU
 SG_ OBJ_Brake_Light_11 : 8745|1@1+ (1,0) [0|1] "bool" MCU
 SG_ OBJ_Turn_Indicator_Right_11 : 8746|1@1+ (1,0) [0|1] "bool" MCU
 SG_ OBJ_Turn_Indicator_Left_11 : 8747|1@1+ (1,0) [0|1] "bool" MCU
 SG_ OBJ_Light_Indicator_Validity_11 : 8748|1@1+ (1,0) [0|1] "bool" MCU
 SG_ OBJ_Right_Out_Of_Image_11 : 8749|1@1+ (1,0) [0|1] "bool" MCU
 SG_ OBJ_Left_Out_Of_Image_11 : 8750|1@1+ (1,0) [0|1] "bool" MCU
 SG_ OBJ_Right_Out_Of_Image_V_11 : 8751|1@1+ (1,0) [0|1] "bool" MCU
 SG_ OBJ_Left_Out_Of_Image_V_11 : 8752|1@1+ (1,0) [0|1] "bool" MCU
 SG_ OBJ_Top_Out_Of_Image_11 : 8753|1@1+ (1,0) [0|1] "bool" MCU
 SG_ OBJ_Bottom_Out_Of_Image_11 : 8754|1@1+ (1,0) [0|1] "bool" MCU
 SG_ OBJ_Top_Out_Of_Image_V_11 : 8755|1@1+ (1,0) [0|1] "bool" MCU
 SG_ OBJ_Bottom_Out_Of_Image_V_11 : 8756|1@1+ (1,0) [0|1] "bool" MCU
 SG_ OBJ_Lane_Assignment_11 : 8757|3@1+ (1,0) [0|5] "ENUM" MCU
 SG_ OBJ_Lane_Assignment_V_11 : 8760|1@1+ (1,0) [0|1] "bool" MCU
 SG_ OBJ_Age_Seconds_11 : 8761|7@1+ (1,0) [0|100] "s" MCU
 SG_ OBJ_Age_Seconds_V_11 : 8768|1@1+ (1,0) [0|1] "bool" MCU
 SG_ OBJ_Width_11 : 8769|9@1+ (0.01,0) [0.4|2.95] "m" MCU
 SG_ OBJ_Width_V_11 : 8778|1@1+ (1,0) [0|1] "bool" MCU
 SG_ OBJ_Width_STD_11 : 8779|8@1+ (0.01,0) [0|2] "m" MCU
 SG_ OBJ_Width_STD_V_11 : 8787|1@1+ (1,0) [0|1] "bool" MCU
 SG_ OBJ_Length_11 : 8788|9@1+ (0.05,0) [1.2|21] "m" MCU
 SG_ OBJ_Length_V_11 : 8797|1@1+ (1,0) [0|1] "bool" MCU
 SG_ Reserved_4_11 : 8798|2@1+ (1,0) [0|0] "NA" MCU
 SG_ OBJ_Length_STD_11 : 8800|8@1+ (0.05,0) [0|10] "m" MCU
 SG_ OBJ_Length_STD_V_11 : 8808|1@1+ (1,0) [0|1] "bool" MCU
 SG_ OBJ_Height_11 : 8809|9@1+ (0.01,0) [0|2.95] "m" MCU
 SG_ OBJ_Height_V_11 : 8818|1@1+ (1,0) [0|1] "bool" MCU
 SG_ OBJ_Height_STD_11 : 8819|8@1+ (0.01,0) [0|2] "m" MCU
 SG_ OBJ_Height_STD_V_11 : 8827|1@1+ (1,0) [0|1] "bool" MCU
 SG_ Reserved_5_11 : 8828|4@1+ (1,0) [0|0] "NA" MCU
 SG_ OBJ_Abs_Long_Velocity_11 : 8832|12@1+ (0.05,-30) [-30|100] "MPS" MCU
 SG_ OBJ_Abs_Long_Velocity_V_11 : 8844|1@1+ (1,0) [0|1] "bool" MCU
 SG_ OBJ_Abs_Long_Velocity_STD_11 : 8845|11@1+ (0.05,0) [0|65] "MPS" MCU
 SG_ OBJ_Abs_Long_Vel_STD_V_11 : 8856|1@1+ (1,0) [0|1] "bool" MCU
 SG_ Reserved_6_11 : 8857|7@1+ (1,0) [0|0] "NA" MCU
 SG_ OBJ_Abs_Lat_Velocity_11 : 8864|11@1+ (0.05,-50) [-50|50] "MPS" MCU
 SG_ OBJ_Abs_Lat_Velocity_V_11 : 8875|1@1+ (1,0) [0|1] "bool" MCU
 SG_ OBJ_Abs_Lat_Velocity_STD_11 : 8876|10@1+ (0.05,0) [0|50] "MPS" MCU
 SG_ OBJ_Abs_Lat_Vel_STD_V_11 : 8886|1@1+ (1,0) [0|1] "bool" MCU
 SG_ OBJ_Abs_Long_Acc_11 : 8887|9@1+ (0.05,-10.3) [-10.3|7.3] "MPS2" MCU
 SG_ OBJ_Abs_Long_Acc_V_11 : 8896|1@1+ (1,0) [0|1] "bool" MCU
 SG_ OBJ_Abs_Long_Acc_STD_11 : 8897|8@1+ (0.05,0) [0|7.3] "MPS2" MCU
 SG_ OBJ_Abs_Long_Acc_STD_V_11 : 8905|1@1+ (1,0) [0|1] "bool" MCU
 SG_ OBJ_Abs_Lat_Acc_11 : 8906|9@1+ (0.05,-10.3) [-10.3|7.3] "MPS2" MCU
 SG_ OBJ_Abs_Lat_Acc_V_11 : 8915|1@1+ (1,0) [0|1] "bool" MCU
 SG_ OBJ_Abs_Lat_Acc_STD_11 : 8916|8@1+ (0.05,0) [0|7.3] "MPS2" MCU
 SG_ OBJ_Abs_Lat_Acc_STD_V_11 : 8924|1@1+ (1,0) [0|1] "bool" MCU
 SG_ Reserved_7_11 : 8925|3@1+ (1,0) [0|0] "NA" MCU
 SG_ OBJ_Abs_Acceleration_11 : 8928|9@1+ (0.05,-10.3) [-10.3|7.3] "MPS2" MCU
 SG_ OBJ_Abs_Acceleration_V_11 : 8937|1@1+ (1,0) [0|1] "bool" MCU
 SG_ OBJ_Abs_Acc_STD_11 : 8938|8@1+ (0.05,0) [0|7.3] "MPS2" MCU
 SG_ OBJ_Abs_Acc_STD_V_11 : 8946|1@1+ (1,0) [0|1] "bool" MCU
 SG_ OBJ_Inv_TTC_11 : 8947|11@1+ (0.01,-8) [-8|8] "INV(s)" MCU
 SG_ OBJ_Inv_TTC_V_11 : 8958|1@1+ (1,0) [0|1] "bool" MCU
 SG_ Reserved_8_11 : 8959|1@1+ (1,0) [0|0] "NA" MCU
 SG_ OBJ_Inv_TTC_STD_11 : 8960|11@1+ (0.01,0) [0|4] "INV(s)" MCU
 SG_ OBJ_Inv_TTC_STD_V_11 : 8971|1@1+ (1,0) [0|1] "bool" MCU
 SG_ OBJ_Relative_Long_Acc_11 : 8972|9@1+ (0.05,-10.3) [-10.3|7.3] "MPS2" MCU
 SG_ OBJ_Relative_Long_Acc_V_11 : 8981|1@1+ (1,0) [0|1] "bool" MCU
 SG_ OBJ_Relative_Long_Acc_STD_11 : 8982|8@1+ (0.05,0) [0|7.3] "MPS2" MCU
 SG_ OBJ_Rel_Long_Acc_STD_V_11 : 8990|1@1+ (1,0) [0|1] "bool" MCU
 SG_ Reserved_9_11 : 8991|1@1+ (1,0) [0|0] "NA" MCU
 SG_ OBJ_Relative_Long_Velocity_11 : 8992|13@1+ (0.05,-120) [-120|130] "MPS" MCU
 SG_ OBJ_Relative_Long_Velocity_V_11 : 9005|1@1+ (1,0) [0|1] "bool" MCU
 SG_ OBJ_Relative_Long_Vel_STD_11 : 9006|12@1+ (0.05,0) [0|130] "MPS" MCU
 SG_ OBJ_Rel_Long_Vel_STD_V_11 : 9018|1@1+ (1,0) [0|1] "bool" MCU
 SG_ Reserved_10_11 : 9019|5@1+ (1,0) [0|0] "NA" MCU
 SG_ OBJ_Relative_Lat_Velocity_11 : 9024|11@1+ (0.05,-50) [-50|50] "MPS" MCU
 SG_ OBJ_Relative_Lat_Velocity_V_11 : 9035|1@1+ (1,0) [0|1] "bool" MCU
 SG_ OBJ_Relative_Lat_Velocity_STD_11 : 9036|10@1+ (0.05,0) [0|50] "MPS" MCU
 SG_ OBJ_Rel_Lat_Vel_STD_V_11 : 9046|1@1+ (1,0) [0|1] "bool" MCU
 SG_ Reserved_11_11 : 9047|9@1+ (1,0) [0|0] "NA" MCU
 SG_ OBJ_Long_Distance_11 : 9056|14@1+ (0.05,-200) [-200|250] "m" MCU
 SG_ OBJ_Long_Distance_V_11 : 9070|1@1+ (1,0) [0|1] "bool" MCU
 SG_ OBJ_Long_Distance_STD_11 : 9071|13@1+ (0.05,0) [0|250] "m" MCU
 SG_ OBJ_Long_Distance_STD_V_11 : 9084|1@1+ (1,0) [0|1] "bool" MCU
 SG_ Reserved_12_11 : 9085|3@1+ (1,0) [0|0] "NA" MCU
 SG_ OBJ_Lat_Distance_11 : 9088|12@1+ (0.05,-100) [-100|100] "m" MCU
 SG_ OBJ_Lat_Distance_V_11 : 9100|1@1+ (1,0) [0|1] "bool" MCU
 SG_ OBJ_Lat_Distance_STD_11 : 9101|11@1+ (0.05,0) [0|100] "m" MCU
 SG_ OBJ_Lat_Distance_STD_V_11 : 9112|1@1+ (1,0) [0|1] "bool" MCU
 SG_ Reserved_13_11 : 9113|7@1+ (1,0) [0|0] "NA" MCU
 SG_ OBJ_Absolute_Speed_11 : 9120|12@1+ (0.05,-65) [-65|65] "MPS" MCU
 SG_ OBJ_Absolute_Speed_V_11 : 9132|1@1+ (1,0) [0|1] "bool" MCU
 SG_ OBJ_Absolute_Speed_STD_11 : 9133|11@1+ (0.05,0) [0|65] "MPS" MCU
 SG_ OBJ_Absolute_Speed_STD_V_11 : 9144|1@1+ (1,0) [0|1] "bool" MCU
 SG_ Reserved_14_11 : 9145|7@1+ (1,0) [0|0] "NA" MCU
 SG_ OBJ_Heading_11 : 9152|10@1+ (0.01,-3.14) [-3.14|3.14] "rad" MCU
 SG_ OBJ_Heading_V_11 : 9162|1@1+ (1,0) [0|1] "bool" MCU
 SG_ OBJ_Heading_STD_11 : 9163|9@1+ (0.01,0) [0|3.14] "rad" MCU
 SG_ OBJ_Heading_STD_V_11 : 9172|1@1+ (1,0) [0|1] "bool" MCU
 SG_ OBJ_Angle_Rate_STD_11 : 9173|11@1+ (0.002,0) [0|2.2318] "RPS" MCU
 SG_ OBJ_Angle_Rate_STD_V_11 : 9184|1@1+ (1,0) [0|1] "bool" MCU
 SG_ OBJ_Angle_Rate_11 : 9185|12@1+ (0.002,-2.234) [-2.234|2.2318] "RPS" MCU
 SG_ OBJ_Angle_Rate_V_11 : 9197|1@1+ (1,0) [0|1] "bool" MCU
 SG_ OBJ_Angle_Right_11 : 9198|14@1+ (0.0002,-1.571) [-1.571|1.571] "rad " MCU
 SG_ OBJ_Angle_Right_V_11 : 9212|1@1+ (1,0) [0|1] "bool" MCU
 SG_ Reserved_15_11 : 9213|3@1+ (1,0) [0|0] "NA" MCU
 SG_ OBJ_Angle_Right_STD_11 : 9216|13@1+ (0.0002,0) [0|1.571] "rad " MCU
 SG_ OBJ_Angle_Right_STD_V_11 : 9229|1@1+ (1,0) [0|1] "bool" MCU
 SG_ OBJ_Angle_Left_11 : 9230|14@1+ (0.0002,-1.571) [-1.571|1.571] "rad " MCU
 SG_ OBJ_Angle_Left_V_11 : 9244|1@1+ (1,0) [0|1] "bool" MCU
 SG_ Reserved_16_11 : 9245|3@1+ (1,0) [0|0] "NA" MCU
 SG_ OBJ_Angle_Left_STD_11 : 9248|13@1+ (0.0002,0) [0|1.571] "rad" MCU
 SG_ OBJ_Angle_Left_STD_V_11 : 9261|1@1+ (1,0) [0|1] "bool" MCU
 SG_ OBJ_Angle_Side_11 : 9262|14@1+ (0.0002,-1.571) [-1.571|1.571] "rad" MCU
 SG_ OBJ_Angle_Side_V_11 : 9276|1@1+ (1,0) [0|1] "bool" MCU
 SG_ Reserved_17_11 : 9277|3@1+ (1,0) [0|0] "NA" MCU
 SG_ OBJ_Angle_Side_STD_11 : 9280|13@1+ (0.0002,0) [0|1.571] "rad" MCU
 SG_ OBJ_Angle_Side_STD_V_11 : 9293|1@1+ (1,0) [0|1] "bool" MCU
 SG_ OBJ_Angle_Mid_V_11 : 9294|1@1+ (1,0) [0|1] "bool" MCU
 SG_ OBJ_Angle_Mid_11 : 9295|14@1+ (0.0002,-1.571) [-1.571|1.571] "rad" MCU
 SG_ Reserved_18_11 : 9309|3@1+ (1,0) [0|0] "NA" MCU
 SG_ OBJ_Angle_Mid_STD_11 : 9312|13@1+ (0.0002,0) [0|1.571] "rad" MCU
 SG_ OBJ_Angle_Mid_STD_V_11 : 9325|1@1+ (1,0) [0|1] "bool" MCU
 SG_ OBJ_Angle_Bottom_V_11 : 9326|1@1+ (1,0) [0|1] "bool" MCU
 SG_ OBJ_Angle_Bottom_11 : 9327|14@1+ (0.0002,-1.571) [-1.571|1.571] "rad" MCU
 SG_ Reserved_19_11 : 9341|3@1+ (1,0) [0|0] "NA" MCU
 SG_ OBJ_Angle_Bottom_STD_11 : 9344|13@1+ (0.0002,0) [0|1.571] "rad" MCU
 SG_ OBJ_Angle_Bottom_STD_V_11 : 9357|1@1+ (1,0) [0|1] "bool" MCU
 SG_ OBJ_Visibility_Side_V_11 : 9358|1@1+ (1,0) [0|1] "Bool" MCU
 SG_ OBJ_Visibility_Side_11 : 9359|2@1+ (1,0) [0|2] "ENUM" MCU
 SG_ OBJ_Is_In_Drivable_Area_11 : 9361|1@1+ (1,0) [0|1] "bool" MCU
 SG_ OBJ_Is_In_Drivable_Area_V_11 : 9362|1@1+ (1,0) [0|1] "bool" MCU
 SG_ OBJ_Is_VeryClose_11 : 9363|1@1+ (1,0) [0|1] "bool" MCU
 SG_ OBJ_Is_VeryClose_V_11 : 9364|1@1+ (1,0) [0|1] "bool" MCU
 SG_ OBJ_Occlusion_RL_11 : 9365|2@1+ (1,0) [0|2] "ENUM" MCU
 SG_ OBJ_Occlusion_RR_11 : 9367|2@1+ (1,0) [0|2] "ENUM" MCU
 SG_ OBJ_Occlusion_FR_11 : 9369|2@1+ (1,0) [0|2] "ENUM" MCU
 SG_ OBJ_Occlusion_FL_11 : 9371|2@1+ (1,0) [0|2] "ENUM" MCU
 SG_ OBJ_Buffer_11 : 9373|3@1+ (1,0) [0|0] "NA" MCU
 SG_ OBJ_CRC_12 : 9376|32@1+ (1,0) [0|4294967295] "NA" MCU
 SG_ OBJ_ID_12 : 9408|8@1+ (1,0) [0|255] "counter" MCU
 SG_ OBJ_Existence_Probability_12 : 9416|8@1+ (0.01,0) [0|1] "NA" MCU
 SG_ OBJ_Fusion_Source_12 : 9424|16@1+ (1,0) [0|65535] "BITWIZE" MCU
 SG_ OBJ_Triggered_SDM_12 : 9440|2@1+ (1,0) [0|2] "ENUM " MCU
 SG_ OBJ_Motion_Category_12 : 9442|4@1+ (1,0) [0|13] "ENUM " MCU
 SG_ OBJ_Buffer_C0_12 : 9446|7@1+ (1,0) [0|127] "NA" MCU
 SG_ OBJ_Object_Age_12 : 9453|11@1+ (1,0) [0|2047] "Frames" MCU
 SG_ OBJ_Measuring_Status_12 : 9464|3@1+ (1,0) [0|7] "BITWIZE" MCU
 SG_ OBJ_Object_Class_12 : 9467|4@1+ (1,0) [0|8] "ENUM" MCU
 SG_ Reserved_3_12 : 9471|1@1+ (1,0) [0|0] "NA" MCU
 SG_ OBJ_Class_Probability_12 : 9472|7@1+ (0.01,0) [0|1] "NA" MCU
 SG_ OBJ_Buffer_C1_12 : 9479|7@1+ (1,0) [0|127] "NA" MCU
 SG_ OBJ_Buffer_C2_12 : 9486|7@1+ (1,0) [0|127] "NA" MCU
 SG_ OBJ_Buffer_C3_12 : 9493|7@1+ (1,0) [0|127] "NA" MCU
 SG_ OBJ_Camera_Source_12 : 9500|4@1+ (1,0) [0|15] "ENUM" MCU
 SG_ OBJ_Motion_Status_12 : 9504|3@1+ (1,0) [0|5] "ENUM " MCU
 SG_ OBJ_Motion_Orientation_12 : 9507|4@1+ (1,0) [0|13] "ENUM " MCU
 SG_ OBJ_Has_Cut_Lane_12 : 9511|1@1+ (1,0) [0|1] "bool" MCU
 SG_ OBJ_Has_Cut_Path_12 : 9512|1@1+ (1,0) [0|1] "bool" MCU
 SG_ OBJ_Brake_Light_12 : 9513|1@1+ (1,0) [0|1] "bool" MCU
 SG_ OBJ_Turn_Indicator_Right_12 : 9514|1@1+ (1,0) [0|1] "bool" MCU
 SG_ OBJ_Turn_Indicator_Left_12 : 9515|1@1+ (1,0) [0|1] "bool" MCU
 SG_ OBJ_Light_Indicator_Validity_12 : 9516|1@1+ (1,0) [0|1] "bool" MCU
 SG_ OBJ_Right_Out_Of_Image_12 : 9517|1@1+ (1,0) [0|1] "bool" MCU
 SG_ OBJ_Left_Out_Of_Image_12 : 9518|1@1+ (1,0) [0|1] "bool" MCU
 SG_ OBJ_Right_Out_Of_Image_V_12 : 9519|1@1+ (1,0) [0|1] "bool" MCU
 SG_ OBJ_Left_Out_Of_Image_V_12 : 9520|1@1+ (1,0) [0|1] "bool" MCU
 SG_ OBJ_Top_Out_Of_Image_12 : 9521|1@1+ (1,0) [0|1] "bool" MCU
 SG_ OBJ_Bottom_Out_Of_Image_12 : 9522|1@1+ (1,0) [0|1] "bool" MCU
 SG_ OBJ_Top_Out_Of_Image_V_12 : 9523|1@1+ (1,0) [0|1] "bool" MCU
 SG_ OBJ_Bottom_Out_Of_Image_V_12 : 9524|1@1+ (1,0) [0|1] "bool" MCU
 SG_ OBJ_Lane_Assignment_12 : 9525|3@1+ (1,0) [0|5] "ENUM" MCU
 SG_ OBJ_Lane_Assignment_V_12 : 9528|1@1+ (1,0) [0|1] "bool" MCU
 SG_ OBJ_Age_Seconds_12 : 9529|7@1+ (1,0) [0|100] "s" MCU
 SG_ OBJ_Age_Seconds_V_12 : 9536|1@1+ (1,0) [0|1] "bool" MCU
 SG_ OBJ_Width_12 : 9537|9@1+ (0.01,0) [0.4|2.95] "m" MCU
 SG_ OBJ_Width_V_12 : 9546|1@1+ (1,0) [0|1] "bool" MCU
 SG_ OBJ_Width_STD_12 : 9547|8@1+ (0.01,0) [0|2] "m" MCU
 SG_ OBJ_Width_STD_V_12 : 9555|1@1+ (1,0) [0|1] "bool" MCU
 SG_ OBJ_Length_12 : 9556|9@1+ (0.05,0) [1.2|21] "m" MCU
 SG_ OBJ_Length_V_12 : 9565|1@1+ (1,0) [0|1] "bool" MCU
 SG_ Reserved_4_12 : 9566|2@1+ (1,0) [0|0] "NA" MCU
 SG_ OBJ_Length_STD_12 : 9568|8@1+ (0.05,0) [0|10] "m" MCU
 SG_ OBJ_Length_STD_V_12 : 9576|1@1+ (1,0) [0|1] "bool" MCU
 SG_ OBJ_Height_12 : 9577|9@1+ (0.01,0) [0|2.95] "m" MCU
 SG_ OBJ_Height_V_12 : 9586|1@1+ (1,0) [0|1] "bool" MCU
 SG_ OBJ_Height_STD_12 : 9587|8@1+ (0.01,0) [0|2] "m" MCU
 SG_ OBJ_Height_STD_V_12 : 9595|1@1+ (1,0) [0|1] "bool" MCU
 SG_ Reserved_5_12 : 9596|4@1+ (1,0) [0|0] "NA" MCU
 SG_ OBJ_Abs_Long_Velocity_12 : 9600|12@1+ (0.05,-30) [-30|100] "MPS" MCU
 SG_ OBJ_Abs_Long_Velocity_V_12 : 9612|1@1+ (1,0) [0|1] "bool" MCU
 SG_ OBJ_Abs_Long_Velocity_STD_12 : 9613|11@1+ (0.05,0) [0|65] "MPS" MCU
 SG_ OBJ_Abs_Long_Vel_STD_V_12 : 9624|1@1+ (1,0) [0|1] "bool" MCU
 SG_ Reserved_6_12 : 9625|7@1+ (1,0) [0|0] "NA" MCU
 SG_ OBJ_Abs_Lat_Velocity_12 : 9632|11@1+ (0.05,-50) [-50|50] "MPS" MCU
 SG_ OBJ_Abs_Lat_Velocity_V_12 : 9643|1@1+ (1,0) [0|1] "bool" MCU
 SG_ OBJ_Abs_Lat_Velocity_STD_12 : 9644|10@1+ (0.05,0) [0|50] "MPS" MCU
 SG_ OBJ_Abs_Lat_Vel_STD_V_12 : 9654|1@1+ (1,0) [0|1] "bool" MCU
 SG_ OBJ_Abs_Long_Acc_12 : 9655|9@1+ (0.05,-10.3) [-10.3|7.3] "MPS2" MCU
 SG_ OBJ_Abs_Long_Acc_V_12 : 9664|1@1+ (1,0) [0|1] "bool" MCU
 SG_ OBJ_Abs_Long_Acc_STD_12 : 9665|8@1+ (0.05,0) [0|7.3] "MPS2" MCU
 SG_ OBJ_Abs_Long_Acc_STD_V_12 : 9673|1@1+ (1,0) [0|1] "bool" MCU
 SG_ OBJ_Abs_Lat_Acc_12 : 9674|9@1+ (0.05,-10.3) [-10.3|7.3] "MPS2" MCU
 SG_ OBJ_Abs_Lat_Acc_V_12 : 9683|1@1+ (1,0) [0|1] "bool" MCU
 SG_ OBJ_Abs_Lat_Acc_STD_12 : 9684|8@1+ (0.05,0) [0|7.3] "MPS2" MCU
 SG_ OBJ_Abs_Lat_Acc_STD_V_12 : 9692|1@1+ (1,0) [0|1] "bool" MCU
 SG_ Reserved_7_12 : 9693|3@1+ (1,0) [0|0] "NA" MCU
 SG_ OBJ_Abs_Acceleration_12 : 9696|9@1+ (0.05,-10.3) [-10.3|7.3] "MPS2" MCU
 SG_ OBJ_Abs_Acceleration_V_12 : 9705|1@1+ (1,0) [0|1] "bool" MCU
 SG_ OBJ_Abs_Acc_STD_12 : 9706|8@1+ (0.05,0) [0|7.3] "MPS2" MCU
 SG_ OBJ_Abs_Acc_STD_V_12 : 9714|1@1+ (1,0) [0|1] "bool" MCU
 SG_ OBJ_Inv_TTC_12 : 9715|11@1+ (0.01,-8) [-8|8] "INV(s)" MCU
 SG_ OBJ_Inv_TTC_V_12 : 9726|1@1+ (1,0) [0|1] "bool" MCU
 SG_ Reserved_8_12 : 9727|1@1+ (1,0) [0|0] "NA" MCU
 SG_ OBJ_Inv_TTC_STD_12 : 9728|11@1+ (0.01,0) [0|4] "INV(s)" MCU
 SG_ OBJ_Inv_TTC_STD_V_12 : 9739|1@1+ (1,0) [0|1] "bool" MCU
 SG_ OBJ_Relative_Long_Acc_12 : 9740|9@1+ (0.05,-10.3) [-10.3|7.3] "MPS2" MCU
 SG_ OBJ_Relative_Long_Acc_V_12 : 9749|1@1+ (1,0) [0|1] "bool" MCU
 SG_ OBJ_Relative_Long_Acc_STD_12 : 9750|8@1+ (0.05,0) [0|7.3] "MPS2" MCU
 SG_ OBJ_Rel_Long_Acc_STD_V_12 : 9758|1@1+ (1,0) [0|1] "bool" MCU
 SG_ Reserved_9_12 : 9759|1@1+ (1,0) [0|0] "NA" MCU
 SG_ OBJ_Relative_Long_Velocity_12 : 9760|13@1+ (0.05,-120) [-120|130] "MPS" MCU
 SG_ OBJ_Relative_Long_Velocity_V_12 : 9773|1@1+ (1,0) [0|1] "bool" MCU
 SG_ OBJ_Relative_Long_Vel_STD_12 : 9774|12@1+ (0.05,0) [0|130] "MPS" MCU
 SG_ OBJ_Rel_Long_Vel_STD_V_12 : 9786|1@1+ (1,0) [0|1] "bool" MCU
 SG_ Reserved_10_12 : 9787|5@1+ (1,0) [0|0] "NA" MCU
 SG_ OBJ_Relative_Lat_Velocity_12 : 9792|11@1+ (0.05,-50) [-50|50] "MPS" MCU
 SG_ OBJ_Relative_Lat_Velocity_V_12 : 9803|1@1+ (1,0) [0|1] "bool" MCU
 SG_ OBJ_Relative_Lat_Velocity_STD_12 : 9804|10@1+ (0.05,0) [0|50] "MPS" MCU
 SG_ OBJ_Rel_Lat_Vel_STD_V_12 : 9814|1@1+ (1,0) [0|1] "bool" MCU
 SG_ Reserved_11_12 : 9815|9@1+ (1,0) [0|0] "NA" MCU
 SG_ OBJ_Long_Distance_12 : 9824|14@1+ (0.05,-200) [-200|250] "m" MCU
 SG_ OBJ_Long_Distance_V_12 : 9838|1@1+ (1,0) [0|1] "bool" MCU
 SG_ OBJ_Long_Distance_STD_12 : 9839|13@1+ (0.05,0) [0|250] "m" MCU
 SG_ OBJ_Long_Distance_STD_V_12 : 9852|1@1+ (1,0) [0|1] "bool" MCU
 SG_ Reserved_12_12 : 9853|3@1+ (1,0) [0|0] "NA" MCU
 SG_ OBJ_Lat_Distance_12 : 9856|12@1+ (0.05,-100) [-100|100] "m" MCU
 SG_ OBJ_Lat_Distance_V_12 : 9868|1@1+ (1,0) [0|1] "bool" MCU
 SG_ OBJ_Lat_Distance_STD_12 : 9869|11@1+ (0.05,0) [0|100] "m" MCU
 SG_ OBJ_Lat_Distance_STD_V_12 : 9880|1@1+ (1,0) [0|1] "bool" MCU
 SG_ Reserved_13_12 : 9881|7@1+ (1,0) [0|0] "NA" MCU
 SG_ OBJ_Absolute_Speed_12 : 9888|12@1+ (0.05,-65) [-65|65] "MPS" MCU
 SG_ OBJ_Absolute_Speed_V_12 : 9900|1@1+ (1,0) [0|1] "bool" MCU
 SG_ OBJ_Absolute_Speed_STD_12 : 9901|11@1+ (0.05,0) [0|65] "MPS" MCU
 SG_ OBJ_Absolute_Speed_STD_V_12 : 9912|1@1+ (1,0) [0|1] "bool" MCU
 SG_ Reserved_14_12 : 9913|7@1+ (1,0) [0|0] "NA" MCU
 SG_ OBJ_Heading_12 : 9920|10@1+ (0.01,-3.14) [-3.14|3.14] "rad" MCU
 SG_ OBJ_Heading_V_12 : 9930|1@1+ (1,0) [0|1] "bool" MCU
 SG_ OBJ_Heading_STD_12 : 9931|9@1+ (0.01,0) [0|3.14] "rad" MCU
 SG_ OBJ_Heading_STD_V_12 : 9940|1@1+ (1,0) [0|1] "bool" MCU
 SG_ OBJ_Angle_Rate_STD_12 : 9941|11@1+ (0.002,0) [0|2.2318] "RPS" MCU
 SG_ OBJ_Angle_Rate_STD_V_12 : 9952|1@1+ (1,0) [0|1] "bool" MCU
 SG_ OBJ_Angle_Rate_12 : 9953|12@1+ (0.002,-2.234) [-2.234|2.2318] "RPS" MCU
 SG_ OBJ_Angle_Rate_V_12 : 9965|1@1+ (1,0) [0|1] "bool" MCU
 SG_ OBJ_Angle_Right_12 : 9966|14@1+ (0.0002,-1.571) [-1.571|1.571] "rad " MCU
 SG_ OBJ_Angle_Right_V_12 : 9980|1@1+ (1,0) [0|1] "bool" MCU
 SG_ Reserved_15_12 : 9981|3@1+ (1,0) [0|0] "NA" MCU
 SG_ OBJ_Angle_Right_STD_12 : 9984|13@1+ (0.0002,0) [0|1.571] "rad " MCU
 SG_ OBJ_Angle_Right_STD_V_12 : 9997|1@1+ (1,0) [0|1] "bool" MCU
 SG_ OBJ_Angle_Left_12 : 9998|14@1+ (0.0002,-1.571) [-1.571|1.571] "rad " MCU
 SG_ OBJ_Angle_Left_V_12 : 10012|1@1+ (1,0) [0|1] "bool" MCU
 SG_ Reserved_16_12 : 10013|3@1+ (1,0) [0|0] "NA" MCU
 SG_ OBJ_Angle_Left_STD_12 : 10016|13@1+ (0.0002,0) [0|1.571] "rad" MCU
 SG_ OBJ_Angle_Left_STD_V_12 : 10029|1@1+ (1,0) [0|1] "bool" MCU
 SG_ OBJ_Angle_Side_12 : 10030|14@1+ (0.0002,-1.571) [-1.571|1.571] "rad" MCU
 SG_ OBJ_Angle_Side_V_12 : 10044|1@1+ (1,0) [0|1] "bool" MCU
 SG_ Reserved_17_12 : 10045|3@1+ (1,0) [0|0] "NA" MCU
 SG_ OBJ_Angle_Side_STD_12 : 10048|13@1+ (0.0002,0) [0|1.571] "rad" MCU
 SG_ OBJ_Angle_Side_STD_V_12 : 10061|1@1+ (1,0) [0|1] "bool" MCU
 SG_ OBJ_Angle_Mid_V_12 : 10062|1@1+ (1,0) [0|1] "bool" MCU
 SG_ OBJ_Angle_Mid_12 : 10063|14@1+ (0.0002,-1.571) [-1.571|1.571] "rad" MCU
 SG_ Reserved_18_12 : 10077|3@1+ (1,0) [0|0] "NA" MCU
 SG_ OBJ_Angle_Mid_STD_12 : 10080|13@1+ (0.0002,0) [0|1.571] "rad" MCU
 SG_ OBJ_Angle_Mid_STD_V_12 : 10093|1@1+ (1,0) [0|1] "bool" MCU
 SG_ OBJ_Angle_Bottom_V_12 : 10094|1@1+ (1,0) [0|1] "bool" MCU
 SG_ OBJ_Angle_Bottom_12 : 10095|14@1+ (0.0002,-1.571) [-1.571|1.571] "rad" MCU
 SG_ Reserved_19_12 : 10109|3@1+ (1,0) [0|0] "NA" MCU
 SG_ OBJ_Angle_Bottom_STD_12 : 10112|13@1+ (0.0002,0) [0|1.571] "rad" MCU
 SG_ OBJ_Angle_Bottom_STD_V_12 : 10125|1@1+ (1,0) [0|1] "bool" MCU
 SG_ OBJ_Visibility_Side_V_12 : 10126|1@1+ (1,0) [0|1] "Bool" MCU
 SG_ OBJ_Visibility_Side_12 : 10127|2@1+ (1,0) [0|2] "ENUM" MCU
 SG_ OBJ_Is_In_Drivable_Area_12 : 10129|1@1+ (1,0) [0|1] "bool" MCU
 SG_ OBJ_Is_In_Drivable_Area_V_12 : 10130|1@1+ (1,0) [0|1] "bool" MCU
 SG_ OBJ_Is_VeryClose_12 : 10131|1@1+ (1,0) [0|1] "bool" MCU
 SG_ OBJ_Is_VeryClose_V_12 : 10132|1@1+ (1,0) [0|1] "bool" MCU
 SG_ OBJ_Occlusion_RL_12 : 10133|2@1+ (1,0) [0|2] "ENUM" MCU
 SG_ OBJ_Occlusion_RR_12 : 10135|2@1+ (1,0) [0|2] "ENUM" MCU
 SG_ OBJ_Occlusion_FR_12 : 10137|2@1+ (1,0) [0|2] "ENUM" MCU
 SG_ OBJ_Occlusion_FL_12 : 10139|2@1+ (1,0) [0|2] "ENUM" MCU
 SG_ OBJ_Buffer_12 : 10141|3@1+ (1,0) [0|0] "NA" MCU
 SG_ OBJ_CRC_13 : 10144|32@1+ (1,0) [0|4294967295] "NA" MCU
 SG_ OBJ_ID_13 : 10176|8@1+ (1,0) [0|255] "counter" MCU
 SG_ OBJ_Existence_Probability_13 : 10184|8@1+ (0.01,0) [0|1] "NA" MCU
 SG_ OBJ_Fusion_Source_13 : 10192|16@1+ (1,0) [0|65535] "BITWIZE" MCU
 SG_ OBJ_Triggered_SDM_13 : 10208|2@1+ (1,0) [0|2] "ENUM " MCU
 SG_ OBJ_Motion_Category_13 : 10210|4@1+ (1,0) [0|13] "ENUM " MCU
 SG_ OBJ_Buffer_C0_13 : 10214|7@1+ (1,0) [0|127] "NA" MCU
 SG_ OBJ_Object_Age_13 : 10221|11@1+ (1,0) [0|2047] "Frames" MCU
 SG_ OBJ_Measuring_Status_13 : 10232|3@1+ (1,0) [0|7] "BITWIZE" MCU
 SG_ OBJ_Object_Class_13 : 10235|4@1+ (1,0) [0|8] "ENUM" MCU
 SG_ Reserved_3_13 : 10239|1@1+ (1,0) [0|0] "NA" MCU
 SG_ OBJ_Class_Probability_13 : 10240|7@1+ (0.01,0) [0|1] "NA" MCU
 SG_ OBJ_Buffer_C1_13 : 10247|7@1+ (1,0) [0|127] "NA" MCU
 SG_ OBJ_Buffer_C2_13 : 10254|7@1+ (1,0) [0|127] "NA" MCU
 SG_ OBJ_Buffer_C3_13 : 10261|7@1+ (1,0) [0|127] "NA" MCU
 SG_ OBJ_Camera_Source_13 : 10268|4@1+ (1,0) [0|15] "ENUM" MCU
 SG_ OBJ_Motion_Status_13 : 10272|3@1+ (1,0) [0|5] "ENUM " MCU
 SG_ OBJ_Motion_Orientation_13 : 10275|4@1+ (1,0) [0|13] "ENUM " MCU
 SG_ OBJ_Has_Cut_Lane_13 : 10279|1@1+ (1,0) [0|1] "bool" MCU
 SG_ OBJ_Has_Cut_Path_13 : 10280|1@1+ (1,0) [0|1] "bool" MCU
 SG_ OBJ_Brake_Light_13 : 10281|1@1+ (1,0) [0|1] "bool" MCU
 SG_ OBJ_Turn_Indicator_Right_13 : 10282|1@1+ (1,0) [0|1] "bool" MCU
 SG_ OBJ_Turn_Indicator_Left_13 : 10283|1@1+ (1,0) [0|1] "bool" MCU
 SG_ OBJ_Light_Indicator_Validity_13 : 10284|1@1+ (1,0) [0|1] "bool" MCU
 SG_ OBJ_Right_Out_Of_Image_13 : 10285|1@1+ (1,0) [0|1] "bool" MCU
 SG_ OBJ_Left_Out_Of_Image_13 : 10286|1@1+ (1,0) [0|1] "bool" MCU
 SG_ OBJ_Right_Out_Of_Image_V_13 : 10287|1@1+ (1,0) [0|1] "bool" MCU
 SG_ OBJ_Left_Out_Of_Image_V_13 : 10288|1@1+ (1,0) [0|1] "bool" MCU
 SG_ OBJ_Top_Out_Of_Image_13 : 10289|1@1+ (1,0) [0|1] "bool" MCU
 SG_ OBJ_Bottom_Out_Of_Image_13 : 10290|1@1+ (1,0) [0|1] "bool" MCU
 SG_ OBJ_Top_Out_Of_Image_V_13 : 10291|1@1+ (1,0) [0|1] "bool" MCU
 SG_ OBJ_Bottom_Out_Of_Image_V_13 : 10292|1@1+ (1,0) [0|1] "bool" MCU
 SG_ OBJ_Lane_Assignment_13 : 10293|3@1+ (1,0) [0|5] "ENUM" MCU
 SG_ OBJ_Lane_Assignment_V_13 : 10296|1@1+ (1,0) [0|1] "bool" MCU
 SG_ OBJ_Age_Seconds_13 : 10297|7@1+ (1,0) [0|100] "s" MCU
 SG_ OBJ_Age_Seconds_V_13 : 10304|1@1+ (1,0) [0|1] "bool" MCU
 SG_ OBJ_Width_13 : 10305|9@1+ (0.01,0) [0.4|2.95] "m" MCU
 SG_ OBJ_Width_V_13 : 10314|1@1+ (1,0) [0|1] "bool" MCU
 SG_ OBJ_Width_STD_13 : 10315|8@1+ (0.01,0) [0|2] "m" MCU
 SG_ OBJ_Width_STD_V_13 : 10323|1@1+ (1,0) [0|1] "bool" MCU
 SG_ OBJ_Length_13 : 10324|9@1+ (0.05,0) [1.2|21] "m" MCU
 SG_ OBJ_Length_V_13 : 10333|1@1+ (1,0) [0|1] "bool" MCU
 SG_ Reserved_4_13 : 10334|2@1+ (1,0) [0|0] "NA" MCU
 SG_ OBJ_Length_STD_13 : 10336|8@1+ (0.05,0) [0|10] "m" MCU
 SG_ OBJ_Length_STD_V_13 : 10344|1@1+ (1,0) [0|1] "bool" MCU
 SG_ OBJ_Height_13 : 10345|9@1+ (0.01,0) [0|2.95] "m" MCU
 SG_ OBJ_Height_V_13 : 10354|1@1+ (1,0) [0|1] "bool" MCU
 SG_ OBJ_Height_STD_13 : 10355|8@1+ (0.01,0) [0|2] "m" MCU
 SG_ OBJ_Height_STD_V_13 : 10363|1@1+ (1,0) [0|1] "bool" MCU
 SG_ Reserved_5_13 : 10364|4@1+ (1,0) [0|0] "NA" MCU
 SG_ OBJ_Abs_Long_Velocity_13 : 10368|12@1+ (0.05,-30) [-30|100] "MPS" MCU
 SG_ OBJ_Abs_Long_Velocity_V_13 : 10380|1@1+ (1,0) [0|1] "bool" MCU
 SG_ OBJ_Abs_Long_Velocity_STD_13 : 10381|11@1+ (0.05,0) [0|65] "MPS" MCU
 SG_ OBJ_Abs_Long_Vel_STD_V_13 : 10392|1@1+ (1,0) [0|1] "bool" MCU
 SG_ Reserved_6_13 : 10393|7@1+ (1,0) [0|0] "NA" MCU
 SG_ OBJ_Abs_Lat_Velocity_13 : 10400|11@1+ (0.05,-50) [-50|50] "MPS" MCU
 SG_ OBJ_Abs_Lat_Velocity_V_13 : 10411|1@1+ (1,0) [0|1] "bool" MCU
 SG_ OBJ_Abs_Lat_Velocity_STD_13 : 10412|10@1+ (0.05,0) [0|50] "MPS" MCU
 SG_ OBJ_Abs_Lat_Vel_STD_V_13 : 10422|1@1+ (1,0) [0|1] "bool" MCU
 SG_ OBJ_Abs_Long_Acc_13 : 10423|9@1+ (0.05,-10.3) [-10.3|7.3] "MPS2" MCU
 SG_ OBJ_Abs_Long_Acc_V_13 : 10432|1@1+ (1,0) [0|1] "bool" MCU
 SG_ OBJ_Abs_Long_Acc_STD_13 : 10433|8@1+ (0.05,0) [0|7.3] "MPS2" MCU
 SG_ OBJ_Abs_Long_Acc_STD_V_13 : 10441|1@1+ (1,0) [0|1] "bool" MCU

CM_ SG_ 154 OBJ_Absolute_Speed_STD_6 "STD of the absolute ground speed.";
CM_ SG_ 154 OBJ_Absolute_Speed_STD_V_6 "Validator for the STD of the absolute ground speed.";
CM_ SG_ 154 OBJ_Heading_6 "The angle beetweenthe host longitudinal axis and target's heading (clockwise, e.g. PI/2 is a target crossing from left to right).";
CM_ SG_ 154 OBJ_Heading_V_6 "Validator for the object heading.";
CM_ SG_ 154 OBJ_Heading_STD_6 "STD of the object heading.";
CM_ SG_ 154 OBJ_Heading_STD_V_6 "Validator for the STD of the object heading.";
CM_ SG_ 154 OBJ_Angle_Rate_STD_6 "Standard deviation of the angular speed. (radians)";
CM_ SG_ 154 OBJ_Angle_Rate_STD_V_6 "Validator for the STD of the angular speed.";
CM_ SG_ 154 OBJ_Angle_Rate_6 "The momentary angular speed of the object. (radians)";
CM_ SG_ 154 OBJ_Angle_Rate_V_6 "Validator for the angular speed.";
CM_ SG_ 154 OBJ_Angle_Right_6 "The angle between the host longitudinal axis and the right side of the front / rear of the target (the visible one). The positive side is to the host's right.";
CM_ SG_ 154 OBJ_Angle_Right_V_6 "Validator for angleRight";
CM_ SG_ 154 OBJ_Angle_Right_STD_6 "Standard deviation of angleRight";
CM_ SG_ 154 OBJ_Angle_Right_STD_V_6 "Validator for the standard deviation of angleRight.";
CM_ SG_ 154 OBJ_Angle_Left_6 "The angle between the host longitudinal axis and the left side of the front / rear of the target (the visible one). The positive side is to the host's right.";
CM_ SG_ 154 OBJ_Angle_Left_V_6 "Validator for angleLeft.";
CM_ SG_ 154 OBJ_Angle_Left_STD_6 "Standard deviation of angleLeft.";
CM_ SG_ 154 OBJ_Angle_Left_STD_V_6 "Validator for the standard deviation of angleLeft.";
CM_ SG_ 154 OBJ_Angle_Side_6 "The angle between the host longitudinal axis and the far visible edge - the visible edge of the front / rear of the target that is not visible. Currently supported for vehicles only.";
CM_ SG_ 154 OBJ_Angle_Side_V_6 "Validator for angleSide.";
CM_ SG_ 154 OBJ_Angle_Side_STD_6 "Standard deviation of angleSide.";
CM_ SG_ 154 OBJ_Angle_Side_STD_V_6 "Validator for the STD of angleSide.";
CM_ SG_ 154 OBJ_Angle_Mid_V_6 "Validator for angleMid.";
CM_ SG_ 154 OBJ_Angle_Mid_6 "The angle between the host longitudinal axis and the middle of the front / rear of the target (the visible one). The positive side is to the host's right.";
CM_ SG_ 154 OBJ_Angle_Mid_STD_6 "Standard deviation of angleMid.";
CM_ SG_ 154 OBJ_Angle_Mid_STD_V_6 "Validator for the STD of angleMid.";
CM_ SG_ 154 OBJ_Angle_Bottom_V_6 "Validator for OBJAngle_Bottom. ";
CM_ SG_ 154 OBJ_Angle_Bottom_6 "The angle between the logitudinal axis and the Bottom of the front / rear of the target (the visible one). The positive side is to the hosts right";
CM_ SG_ 154 OBJ_Angle_Bottom_STD_6 "STD for OBJAngle_Bottom. ";
CM_ SG_ 154 OBJ_Angle_Bottom_STD_V_6 "Validator for OBJAngle_Bottom_STD. ";
CM_ SG_ 154 OBJ_Visibility_Side_V_6 "Currently Supported for VD only";
CM_ SG_ 154 OBJ_Visibility_Side_6 "From what car  side is the object visible";
CM_ SG_ 154 OBJ_Is_In_Drivable_Area_6 "Indicates whether the target is in a driveable area.";
CM_ SG_ 154 OBJ_Is_In_Drivable_Area_V_6 "Validator for OBJ_Is_In_Drivable_Area.";
CM_ SG_ 154 OBJ_Is_VeryClose_6 "Indicates whether the target is very close to the host such that it is hard to measure it's distance. Currently relevant for peds only. ";
CM_ SG_ 154 OBJ_Is_VeryClose_V_6 "Validator for OBJ_Is_VeryClose. ";
CM_ SG_ 154 OBJ_Occlusion_RL_6 "Was Rear left of the 3D detection of theobject occluded";
CM_ SG_ 154 OBJ_Occlusion_RR_6 "Was Rear Right of the 3D detection of theobject occluded";
CM_ SG_ 154 OBJ_Occlusion_FR_6 "Was front Right of the 3D detection of theobject occluded";
CM_ SG_ 154 OBJ_Occlusion_FL_6 "Was Front left of the 3D detection of theobject occluded";
CM_ SG_ 154 OBJ_CRC_7 "Calculated over each object signal";
CM_ SG_ 154 OBJ_ID_7 "The detected object ID. Range is 1-255, while 0 indicates that the field in unfilled.";
CM_ SG_ 154 OBJ_Existence_Probability_7 "The existence probability of the vehicle";
CM_ SG_ 154 OBJ_Fusion_Source_7 "sources ids used for fusion";
CM_ SG_ 154 OBJ_Triggered_SDM_7 "Indicates whether the object has trigered the SDM (Safety Diagnostic Manager) alert.";
CM_ SG_ 154 OBJ_Motion_Category_7 "Relevant for VD only. Full description of values can be found at the ACC guide.";
CM_ SG_ 154 OBJ_Object_Age_7 "The number of frames in which the object was recognized.";
CM_ SG_ 154 OBJ_Measuring_Status_7 "Measurment status. Old vs New marks if this is the first frame in which the object is reported. Predicted vs Measured marks if the report is raw or has been predicted forward in time using the measured dynamics and ego motion.";
CM_ SG_ 154 OBJ_Object_Class_7 "Indicates the object type. Uncertain is outputted in case the probability that a vehicle is a truck is very similar to the probability that it is a car. ";
CM_ SG_ 154 OBJ_Class_Probability_7 "The probability of this type classification.";
CM_ SG_ 154 OBJ_Camera_Source_7 "The camera in which this object was detected (best choice).";
CM_ SG_ 154 OBJ_Motion_Status_7 "MOVING - the object is moving STATIONARY - the object was never seen moving STOPPED -  the object was moving and has stopped MOVING_SLOWLY - the object is moving very slowly";
CM_ SG_ 154 OBJ_Motion_Orientation_7 "The direction of the target's heading compared to the host. ";
CM_ SG_ 154 OBJ_Has_Cut_Lane_7 "Indicates whether the object cut the host's (right or left) lane. In case there are no lanes, indicates whether the objects is at most 1 meters away from the host.";
CM_ SG_ 154 OBJ_Has_Cut_Path_7 "Indicates whether the object is in the host's path.";
CM_ SG_ 154 OBJ_Brake_Light_7 "Indication for brake lights ";
CM_ SG_ 154 OBJ_Turn_Indicator_Right_7 "Indication for blinking right light.";
CM_ SG_ 154 OBJ_Turn_Indicator_Left_7 "Indication for blinking left light ";
CM_ SG_ 154 OBJ_Light_Indicator_Validity_7 "Validator for light indicators";
CM_ SG_ 154 OBJ_Right_Out_Of_Image_7 "Indicates whether the measurment are predicted out of the right side of the image bounderies.";
CM_ SG_ 154 OBJ_Left_Out_Of_Image_7 "Indicates whether if measurment are predicted out of  the left side of the image bounderies";
CM_ SG_ 154 OBJ_Right_Out_Of_Image_V_7 "validator";
CM_ SG_ 154 OBJ_Left_Out_Of_Image_V_7 "validator";
CM_ SG_ 154 OBJ_Top_Out_Of_Image_7 "Indicates whether if measurment are predicted out of  the top of the image bounderies";
CM_ SG_ 154 OBJ_Bottom_Out_Of_Image_7 "validator";
CM_ SG_ 154 OBJ_Top_Out_Of_Image_V_7 "Indicates whether if measurment are predicted out of  the bottom of the image bounderies";
CM_ SG_ 154 OBJ_Bottom_Out_Of_Image_V_7 "validator";
CM_ SG_ 154 OBJ_Lane_Assignment_7 "The object's lane relative to the host lane.";
CM_ SG_ 154 OBJ_Lane_Assignment_V_7 "Validator for lane assignment";
CM_ SG_ 154 OBJ_Age_Seconds_7 "Time in seconds in which the object was recognized. Currently available for peds only. ";
CM_ SG_ 154 OBJ_Age_Seconds_V_7 "Validator for object age";
CM_ SG_ 154 OBJ_Width_7 "The width of the target vehicle in the world (not to be mistaken with the width of the visible part of the vehicle).";
CM_ SG_ 154 OBJ_Width_V_7 "Validator for object width";
CM_ SG_ 154 OBJ_Width_STD_7 "Standard deviation for object width";
CM_ SG_ 154 OBJ_Width_STD_V_7 "Validator for the standard deviation of object width";
CM_ SG_ 154 OBJ_Length_7 "The length of the vehicle in the world. For crossing bicycles it gives the viewed length of the bicycle.";
CM_ SG_ 154 OBJ_Length_V_7 "Validator for object length.";
CM_ SG_ 154 OBJ_Length_STD_7 "Standard deviation for object length.";
CM_ SG_ 154 OBJ_Length_STD_V_7 "Validator for the standard deviation of object length.";
CM_ SG_ 154 OBJ_Height_7 "The height of the object in the world. ";
CM_ SG_ 154 OBJ_Height_V_7 "Validator for object height.";
CM_ SG_ 154 OBJ_Height_STD_7 "Standard deviation for object height.";
CM_ SG_ 154 OBJ_Height_STD_V_7 "Validator for the standard deviation of object height.";
CM_ SG_ 154 OBJ_Abs_Long_Velocity_7 "Absolute longitudinal velocity.";
CM_ SG_ 154 OBJ_Abs_Long_Velocity_V_7 "Validator for absolute longitudinal velocity.";
CM_ SG_ 154 OBJ_Abs_Long_Velocity_STD_7 "Standard deviation of absolute longitudinal velocity.";
CM_ SG_ 154 OBJ_Abs_Long_Vel_STD_V_7 "Validator for the standard deviation of the absolute longitudinal velocity.";
CM_ SG_ 154 OBJ_Abs_Lat_Velocity_7 "The lateral ground speed of the object.";
CM_ SG_ 154 OBJ_Abs_Lat_Velocity_V_7 "Validator for the lateral ground speed of the object.";
CM_ SG_ 154 OBJ_Abs_Lat_Velocity_STD_7 "STD of the lateral ground speed of the object.";
CM_ SG_ 154 OBJ_Abs_Lat_Vel_STD_V_7 "Validator for the STD of the lateral ground speed of the object.";
CM_ SG_ 154 OBJ_Abs_Long_Acc_7 "The longitudinal ground acceleration of the object.";
CM_ SG_ 154 OBJ_Abs_Long_Acc_V_7 "Validator for the longitudinal ground acceleration of the object.";
CM_ SG_ 154 OBJ_Abs_Long_Acc_STD_7 "STD of the longitudinal ground acceleration of the object.";
CM_ SG_ 154 OBJ_Abs_Long_Acc_STD_V_7 "Validator for the STD of the longitudinal ground acceleration of the object.";
CM_ SG_ 154 OBJ_Abs_Lat_Acc_7 "The lateral ground acceleration of the object.";
CM_ SG_ 154 OBJ_Abs_Lat_Acc_V_7 "Validator for the lateral ground acceleration of the object.";
CM_ SG_ 154 OBJ_Abs_Lat_Acc_STD_7 "STD of the lateral ground acceleration of the object.";
CM_ SG_ 154 OBJ_Abs_Lat_Acc_STD_V_7 "Validator for the STD of the lateral ground acceleration of the object.";
CM_ SG_ 154 OBJ_Abs_Acceleration_7 "The absolute ground acceleration in the target's heading direction.";
CM_ SG_ 154 OBJ_Abs_Acceleration_V_7 "Validator for the absolute ground acceleration.";
CM_ SG_ 154 OBJ_Abs_Acc_STD_7 "STD of the absolute ground acceleration.";
CM_ SG_ 154 OBJ_Abs_Acc_STD_V_7 "Validator for the STD of the absolute ground acceleration.";
CM_ SG_ 154 OBJ_Inv_TTC_7 "Inverse TTC (time to collision).";
CM_ SG_ 154 OBJ_Inv_TTC_V_7 "Validator for Inverse TTC.";
CM_ SG_ 154 OBJ_Inv_TTC_STD_7 "STD for inverse TTC .";
CM_ SG_ 154 OBJ_Inv_TTC_STD_V_7 "Validator for the STD for inverse TTC .";
CM_ SG_ 154 OBJ_Relative_Long_Acc_7 "The relative lateral ground acceleration of the object.";
CM_ SG_ 154 OBJ_Relative_Long_Acc_V_7 "Validator for the relative lateral ground acceleration of the object.";
CM_ SG_ 154 OBJ_Relative_Long_Acc_STD_7 "STD of the relative lateral ground acceleration of the object.";
CM_ SG_ 154 OBJ_Rel_Long_Acc_STD_V_7 "Validator for the STD of the relative lateral ground acceleration.";
CM_ SG_ 154 OBJ_Relative_Long_Velocity_7 "The relative longtitudinal speed between the target and ego vehicle. ";
CM_ SG_ 154 OBJ_Relative_Long_Velocity_V_7 "Validator for the relative longtitudinal speed.";
CM_ SG_ 154 OBJ_Relative_Long_Vel_STD_7 "STD of the relative longtitudinal speed.";
CM_ SG_ 154 OBJ_Rel_Long_Vel_STD_V_7 "Validator for the STD of the relative longtitudinal speed.";
CM_ SG_ 154 OBJ_Relative_Lat_Velocity_7 "The relative lateral speed between the target and ego vehicle. ";
CM_ SG_ 154 OBJ_Relative_Lat_Velocity_V_7 "Validator for the relative lateral speed. ";
CM_ SG_ 154 OBJ_Relative_Lat_Velocity_STD_7 "STD of the relative lateral speed. ";
CM_ SG_ 154 OBJ_Rel_Lat_Vel_STD_V_7 "Validator for the STD of the relative lateral speed. ";
CM_ SG_ 154 OBJ_Long_Distance_7 "The longtitudinal distance from the object to the middle of the Rear-Left and Rear-Right corners of the host vehicle.  ";
CM_ SG_ 154 OBJ_Long_Distance_V_7 "Validator of the longtitudinal distance from the object to the middle of the rear-axle of the host.  ";
CM_ SG_ 154 OBJ_Long_Distance_STD_7 "STD of the  longtitudinal distance.";
CM_ SG_ 154 OBJ_Long_Distance_STD_V_7 "Validator for the STD of the  longtitudinal distance.";
CM_ SG_ 154 OBJ_Lat_Distance_7 "Lateral distance to the middle of the RL and RR corners.  ";
CM_ SG_ 154 OBJ_Lat_Distance_V_7 "Validator for the lateral distance of the object.";
CM_ SG_ 154 OBJ_Lat_Distance_STD_7 "STD of the lateral distance of the object.";
CM_ SG_ 154 OBJ_Lat_Distance_STD_V_7 "Validator for the STD of the lateral distance of the object.";
CM_ SG_ 154 OBJ_Absolute_Speed_7 "The absolute ground speed in the targets' heading direction.";
CM_ SG_ 154 OBJ_Absolute_Speed_V_7 "Validator for the absolute ground speed.";
CM_ SG_ 154 OBJ_Absolute_Speed_STD_7 "STD of the absolute ground speed.";
CM_ SG_ 154 OBJ_Absolute_Speed_STD_V_7 "Validator for the STD of the absolute ground speed.";
CM_ SG_ 154 OBJ_Heading_7 "The angle beetweenthe host longitudinal axis and target's heading (clockwise, e.g. PI/2 is a target crossing from left to right).";
CM_ SG_ 154 OBJ_Heading_V_7 "Validator for the object heading.";
CM_ SG_ 154 OBJ_Heading_STD_7 "STD of the object heading.";
CM_ SG_ 154 OBJ_Heading_STD_V_7 "Validator for the STD of the object heading.";
CM_ SG_ 154 OBJ_Angle_Rate_STD_7 "Standard deviation of the angular speed. (radians)";
CM_ SG_ 154 OBJ_Angle_Rate_STD_V_7 "Validator for the STD of the angular speed.";
CM_ SG_ 154 OBJ_Angle_Rate_7 "The momentary angular speed of the object. (radians)";
CM_ SG_ 154 OBJ_Angle_Rate_V_7 "Validator for the angular speed.";
CM_ SG_ 154 OBJ_Angle_Right_7 "The angle between the host longitudinal axis and the right side of the front / rear of the target (the visible one). The positive side is to the host's right.";
CM_ SG_ 154 OBJ_Angle_Right_V_7 "Validator for angleRight";
CM_ SG_ 154 OBJ_Angle_Right_STD_7 "Standard deviation of angleRight";
CM_ SG_ 154 OBJ_Angle_Right_STD_V_7 "Validator for the standard deviation of angleRight.";
CM_ SG_ 154 OBJ_Angle_Left_7 "The angle between the host longitudinal axis and the left side of the front / rear of the target (the visible one). The positive side is to the host's right.";
CM_ SG_ 154 OBJ_Angle_Left_V_7 "Validator for angleLeft.";
CM_ SG_ 154 OBJ_Angle_Left_STD_7 "Standard deviation of angleLeft.";
CM_ SG_ 154 OBJ_Angle_Left_STD_V_7 "Validator for the standard deviation of angleLeft.";
CM_ SG_ 154 OBJ_Angle_Side_7 "The angle between the host longitudinal axis and the far visible edge - the visible edge of the front / rear of the target that is not visible. Currently supported for vehicles only.";
CM_ SG_ 154 OBJ_Angle_Side_V_7 "Validator for angleSide.";
CM_ SG_ 154 OBJ_Angle_Side_STD_7 "Standard deviation of angleSide.";
CM_ SG_ 154 OBJ_Angle_Side_STD_V_7 "Validator for the STD of angleSide.";
CM_ SG_ 154 OBJ_Angle_Mid_V_7 "Validator for angleMid.";
CM_ SG_ 154 OBJ_Angle_Mid_7 "The angle between the host longitudinal axis and the middle of the front / rear of the target (the visible one). The positive side is to the host's right.";
CM_ SG_ 154 OBJ_Angle_Mid_STD_7 "Standard deviation of angleMid.";
CM_ SG_ 154 OBJ_Angle_Mid_STD_V_7 "Validator for the STD of angleMid.";
CM_ SG_ 154 OBJ_Angle_Bottom_V_7 "Validator for OBJAngle_Bottom. ";
CM_ SG_ 154 OBJ_Angle_Bottom_7 "The angle between the logitudinal axis and the Bottom of the front / rear of the target (the visible one). The positive side is to the hosts right";
CM_ SG_ 154 OBJ_Angle_Bottom_STD_7 "STD for OBJAngle_Bottom. ";
CM_ SG_ 154 OBJ_Angle_Bottom_STD_V_7 "Validator for OBJAngle_Bottom_STD. ";
CM_ SG_ 154 OBJ_Visibility_Side_V_7 "Currently Supported for VD only";
CM_ SG_ 154 OBJ_Visibility_Side_7 "From what car  side is the object visible";
CM_ SG_ 154 OBJ_Is_In_Drivable_Area_7 "Indicates whether the target is in a driveable area.";
CM_ SG_ 154 OBJ_Is_In_Drivable_Area_V_7 "Validator for OBJ_Is_In_Drivable_Area.";
CM_ SG_ 154 OBJ_Is_VeryClose_7 "Indicates whether the target is very close to the host such that it is hard to measure it's distance. Currently relevant for peds only. ";
CM_ SG_ 154 OBJ_Is_VeryClose_V_7 "Validator for OBJ_Is_VeryClose. ";
CM_ SG_ 154 OBJ_Occlusion_RL_7 "Was Rear left of the 3D detection of theobject occluded";
CM_ SG_ 154 OBJ_Occlusion_RR_7 "Was Rear Right of the 3D detection of theobject occluded";
CM_ SG_ 154 OBJ_Occlusion_FR_7 "Was front Right of the 3D detection of theobject occluded";
CM_ SG_ 154 OBJ_Occlusion_FL_7 "Was Front left of the 3D detection of theobject occluded";
CM_ SG_ 154 OBJ_CRC_8 "Calculated over each object signal";
CM_ SG_ 154 OBJ_ID_8 "The detected object ID. Range is 1-255, while 0 indicates that the field in unfilled.";
CM_ SG_ 154 OBJ_Existence_Probability_8 "The existence probability of the vehicle";
CM_ SG_ 154 OBJ_Fusion_Source_8 "sources ids used for fusion";
CM_ SG_ 154 OBJ_Triggered_SDM_8 "Indicates whether the object has trigered the SDM (Safety Diagnostic Manager) alert.";
CM_ SG_ 154 OBJ_Motion_Category_8 "Relevant for VD only. Full description of values can be found at the ACC guide.";
CM_ SG_ 154 OBJ_Object_Age_8 "The number of frames in which the object was recognized.";
CM_ SG_ 154 OBJ_Measuring_Status_8 "Measurment status. Old vs New marks if this is the first frame in which the object is reported. Predicted vs Measured marks if the report is raw or has been predicted forward in time using the measured dynamics and ego motion.";
CM_ SG_ 154 OBJ_Object_Class_8 "Indicates the object type. Uncertain is outputted in case the probability that a vehicle is a truck is very similar to the probability that it is a car. ";
CM_ SG_ 154 OBJ_Class_Probability_8 "The probability of this type classification.";
CM_ SG_ 154 OBJ_Camera_Source_8 "The camera in which this object was detected (best choice).";
CM_ SG_ 154 OBJ_Motion_Status_8 "MOVING - the object is moving STATIONARY - the object was never seen moving STOPPED -  the object was moving and has stopped MOVING_SLOWLY - the object is moving very slowly";
CM_ SG_ 154 OBJ_Motion_Orientation_8 "The direction of the target's heading compared to the host. ";
CM_ SG_ 154 OBJ_Has_Cut_Lane_8 "Indicates whether the object cut the host's (right or left) lane. In case there are no lanes, indicates whether the objects is at most 1 meters away from the host.";
CM_ SG_ 154 OBJ_Has_Cut_Path_8 "Indicates whether the object is in the host's path.";
CM_ SG_ 154 OBJ_Brake_Light_8 "Indication for brake lights ";
CM_ SG_ 154 OBJ_Turn_Indicator_Right_8 "Indication for blinking right light.";
CM_ SG_ 154 OBJ_Turn_Indicator_Left_8 "Indication for blinking left light ";
CM_ SG_ 154 OBJ_Light_Indicator_Validity_8 "Validator for light indicators";
CM_ SG_ 154 OBJ_Right_Out_Of_Image_8 "Indicates whether the measurment are predicted out of the right side of the image bounderies.";
CM_ SG_ 154 OBJ_Left_Out_Of_Image_8 "Indicates whether if measurment are predicted out of  the left side of the image bounderies";
CM_ SG_ 154 OBJ_Right_Out_Of_Image_V_8 "validator";
CM_ SG_ 154 OBJ_Left_Out_Of_Image_V_8 "validator";
CM_ SG_ 154 OBJ_Top_Out_Of_Image_8 "Indicates whether if measurment are predicted out of  the top of the image bounderies";
CM_ SG_ 154 OBJ_Bottom_Out_Of_Image_8 "validator";
CM_ SG_ 154 OBJ_Top_Out_Of_Image_V_8 "Indicates whether if measurment are predicted out of  the bottom of the image bounderies";
CM_ SG_ 154 OBJ_Bottom_Out_Of_Image_V_8 "validator";
CM_ SG_ 154 OBJ_Lane_Assignment_8 "The object's lane relative to the host lane.";
CM_ SG_ 154 OBJ_Lane_Assignment_V_8 "Validator for lane assignment";
CM_ SG_ 154 OBJ_Age_Seconds_8 "Time in seconds in which the object was recognized. Currently available for peds only. ";
CM_ SG_ 154 OBJ_Age_Seconds_V_8 "Validator for object age";
CM_ SG_ 154 OBJ_Width_8 "The width of the target vehicle in the world (not to be mistaken with the width of the visible part of the vehicle).";
CM_ SG_ 154 OBJ_Width_V_8 "Validator for object width";
CM_ SG_ 154 OBJ_Width_STD_8 "Standard deviation for object width";
CM_ SG_ 154 OBJ_Width_STD_V_8 "Validator for the standard deviation of object width";
CM_ SG_ 154 OBJ_Length_8 "The length of the vehicle in the world. For crossing bicycles it gives the viewed length of the bicycle.";
CM_ SG_ 154 OBJ_Length_V_8 "Validator for object length.";
CM_ SG_ 154 OBJ_Length_STD_8 "Standard deviation for object length.";
CM_ SG_ 154 OBJ_Length_STD_V_8 "Validator for the standard deviation of object length.";
CM_ SG_ 154 OBJ_Height_8 "The height of the object in the world. ";
CM_ SG_ 154 OBJ_Height_V_8 "Validator for object height.";
CM_ SG_ 154 OBJ_Height_STD_8 "Standard deviation for object height.";
CM_ SG_ 154 OBJ_Height_STD_V_8 "Validator for the standard deviation of object height.";
CM_ SG_ 154 OBJ_Abs_Long_Velocity_8 "Absolute longitudinal velocity.";
CM_ SG_ 154 OBJ_Abs_Long_Velocity_V_8 "Validator for absolute longitudinal velocity.";
CM_ SG_ 154 OBJ_Abs_Long_Velocity_STD_8 "Standard deviation of absolute longitudinal velocity.";
CM_ SG_ 154 OBJ_Abs_Long_Vel_STD_V_8 "Validator for the standard deviation of the absolute longitudinal velocity.";
CM_ SG_ 154 OBJ_Abs_Lat_Velocity_8 "The lateral ground speed of the object.";
CM_ SG_ 154 OBJ_Abs_Lat_Velocity_V_8 "Validator for the lateral ground speed of the object.";
CM_ SG_ 154 OBJ_Abs_Lat_Velocity_STD_8 "STD of the lateral ground speed of the object.";
CM_ SG_ 154 OBJ_Abs_Lat_Vel_STD_V_8 "Validator for the STD of the lateral ground speed of the object.";
CM_ SG_ 154 OBJ_Abs_Long_Acc_8 "The longitudinal ground acceleration of the object.";
CM_ SG_ 154 OBJ_Abs_Long_Acc_V_8 "Validator for the longitudinal ground acceleration of the object.";
CM_ SG_ 154 OBJ_Abs_Long_Acc_STD_8 "STD of the longitudinal ground acceleration of the object.";
CM_ SG_ 154 OBJ_Abs_Long_Acc_STD_V_8 "Validator for the STD of the longitudinal ground acceleration of the object.";
CM_ SG_ 154 OBJ_Abs_Lat_Acc_8 "The lateral ground acceleration of the object.";
CM_ SG_ 154 OBJ_Abs_Lat_Acc_V_8 "Validator for the lateral ground acceleration of the object.";
CM_ SG_ 154 OBJ_Abs_Lat_Acc_STD_8 "STD of the lateral ground acceleration of the object.";
CM_ SG_ 154 OBJ_Abs_Lat_Acc_STD_V_8 "Validator for the STD of the lateral ground acceleration of the object.";
CM_ SG_ 154 OBJ_Abs_Acceleration_8 "The absolute ground acceleration in the target's heading direction.";
CM_ SG_ 154 OBJ_Abs_Acceleration_V_8 "Validator for the absolute ground acceleration.";
CM_ SG_ 154 OBJ_Abs_Acc_STD_8 "STD of the absolute ground acceleration.";
CM_ SG_ 154 OBJ_Abs_Acc_STD_V_8 "Validator for the STD of the absolute ground acceleration.";
CM_ SG_ 154 OBJ_Inv_TTC_8 "Inverse TTC (time to collision).";
CM_ SG_ 154 OBJ_Inv_TTC_V_8 "Validator for Inverse TTC.";
CM_ SG_ 154 OBJ_Inv_TTC_STD_8 "STD for inverse TTC .";
CM_ SG_ 154 OBJ_Inv_TTC_STD_V_8 "Validator for the STD for inverse TTC .";
CM_ SG_ 154 OBJ_Relative_Long_Acc_8 "The relative lateral ground acceleration of the object.";
CM_ SG_ 154 OBJ_Relative_Long_Acc_V_8 "Validator for the relative lateral ground acceleration of the object.";
CM_ SG_ 154 OBJ_Relative_Long_Acc_STD_8 "STD of the relative lateral ground acceleration of the object.";
CM_ SG_ 154 OBJ_Rel_Long_Acc_STD_V_8 "Validator for the STD of the relative lateral ground acceleration.";
CM_ SG_ 154 OBJ_Relative_Long_Velocity_8 "The relative longtitudinal speed between the target and ego vehicle. ";
CM_ SG_ 154 OBJ_Relative_Long_Velocity_V_8 "Validator for the relative longtitudinal speed.";
CM_ SG_ 154 OBJ_Relative_Long_Vel_STD_8 "STD of the relative longtitudinal speed.";
CM_ SG_ 154 OBJ_Rel_Long_Vel_STD_V_8 "Validator for the STD of the relative longtitudinal speed.";
CM_ SG_ 154 OBJ_Relative_Lat_Velocity_8 "The relative lateral speed between the target and ego vehicle. ";
CM_ SG_ 154 OBJ_Relative_Lat_Velocity_V_8 "Validator for the relative lateral speed. ";
CM_ SG_ 154 OBJ_Relative_Lat_Velocity_STD_8 "STD of the relative lateral speed. ";
CM_ SG_ 154 OBJ_Rel_Lat_Vel_STD_V_8 "Validator for the STD of the relative lateral speed. ";
CM_ SG_ 154 OBJ_Long_Distance_8 "The longtitudinal distance from the object to the middle of the Rear-Left and Rear-Right corners of the host vehicle.  ";
CM_ SG_ 154 OBJ_Long_Distance_V_8 "Validator of the longtitudinal distance from the object to the middle of the rear-axle of the host.  ";
CM_ SG_ 154 OBJ_Long_Distance_STD_8 "STD of the  longtitudinal distance.";
CM_ SG_ 154 OBJ_Long_Distance_STD_V_8 "Validator for the STD of the  longtitudinal distance.";
CM_ SG_ 154 OBJ_Lat_Distance_8 "Lateral distance to the middle of the RL and RR corners.  ";
CM_ SG_ 154 OBJ_Lat_Distance_V_8 "Validator for the lateral distance of the object.";
CM_ SG_ 154 OBJ_Lat_Distance_STD_8 "STD of the lateral distance of the object.";
CM_ SG_ 154 OBJ_Lat_Distance_STD_V_8 "Validator for the STD of the lateral distance of the object.";
CM_ SG_ 154 OBJ_Absolute_Speed_8 "The absolute ground speed in the targets' heading direction.";
CM_ SG_ 154 OBJ_Absolute_Speed_V_8 "Validator for the absolute ground speed.";
CM_ SG_ 154 OBJ_Absolute_Speed_STD_8 "STD of the absolute ground speed.";
CM_ SG_ 154 OBJ_Absolute_Speed_STD_V_8 "Validator for the STD of the absolute ground speed.";
CM_ SG_ 154 OBJ_Heading_8 "The angle beetweenthe host longitudinal axis and target's heading (clockwise, e.g. PI/2 is a target crossing from left to right).";
CM_ SG_ 154 OBJ_Heading_V_8 "Validator for the object heading.";
CM_ SG_ 154 OBJ_Heading_STD_8 "STD of the object heading.";
CM_ SG_ 154 OBJ_Heading_STD_V_8 "Validator for the STD of the object heading.";
CM_ SG_ 154 OBJ_Angle_Rate_STD_8 "Standard deviation of the angular speed. (radians)";
CM_ SG_ 154 OBJ_Angle_Rate_STD_V_8 "Validator for the STD of the angular speed.";
CM_ SG_ 154 OBJ_Angle_Rate_8 "The momentary angular speed of the object. (radians)";
CM_ SG_ 154 OBJ_Angle_Rate_V_8 "Validator for the angular speed.";
CM_ SG_ 154 OBJ_Angle_Right_8 "The angle between the host longitudinal axis and the right side of the front / rear of the target (the visible one). The positive side is to the host's right.";
CM_ SG_ 154 OBJ_Angle_Right_V_8 "Validator for angleRight";
CM_ SG_ 154 OBJ_Angle_Right_STD_8 "Standard deviation of angleRight";
CM_ SG_ 154 OBJ_Angle_Right_STD_V_8 "Validator for the standard deviation of angleRight.";
CM_ SG_ 154 OBJ_Angle_Left_8 "The angle between the host longitudinal axis and the left side of the front / rear of the target (the visible one). The positive side is to the host's right.";
CM_ SG_ 154 OBJ_Angle_Left_V_8 "Validator for angleLeft.";
CM_ SG_ 154 OBJ_Angle_Left_STD_8 "Standard deviation of angleLeft.";
CM_ SG_ 154 OBJ_Angle_Left_STD_V_8 "Validator for the standard deviation of angleLeft.";
CM_ SG_ 154 OBJ_Angle_Side_8 "The angle between the host longitudinal axis and the far visible edge - the visible edge of the front / rear of the target that is not visible. Currently supported for vehicles only.";
CM_ SG_ 154 OBJ_Angle_Side_V_8 "Validator for angleSide.";
CM_ SG_ 154 OBJ_Angle_Side_STD_8 "Standard deviation of angleSide.";
CM_ SG_ 154 OBJ_Angle_Side_STD_V_8 "Validator for the STD of angleSide.";
CM_ SG_ 154 OBJ_Angle_Mid_V_8 "Validator for angleMid.";
CM_ SG_ 154 OBJ_Angle_Mid_8 "The angle between the host longitudinal axis and the middle of the front / rear of the target (the visible one). The positive side is to the host's right.";
CM_ SG_ 154 OBJ_Angle_Mid_STD_8 "Standard deviation of angleMid.";
CM_ SG_ 154 OBJ_Angle_Mid_STD_V_8 "Validator for the STD of angleMid.";
CM_ SG_ 154 OBJ_Angle_Bottom_V_8 "Validator for OBJAngle_Bottom. ";
CM_ SG_ 154 OBJ_Angle_Bottom_8 "The angle between the logitudinal axis and the Bottom of the front / rear of the target (the visible one). The positive side is to the hosts right";
CM_ SG_ 154 OBJ_Angle_Bottom_STD_8 "STD for OBJAngle_Bottom. ";
CM_ SG_ 154 OBJ_Angle_Bottom_STD_V_8 "Validator for OBJAngle_Bottom_STD. ";
CM_ SG_ 154 OBJ_Visibility_Side_V_8 "Currently Supported for VD only";
CM_ SG_ 154 OBJ_Visibility_Side_8 "From what car  side is the object visible";
CM_ SG_ 154 OBJ_Is_In_Drivable_Area_8 "Indicates whether the target is in a driveable area.";
CM_ SG_ 154 OBJ_Is_In_Drivable_Area_V_8 "Validator for OBJ_Is_In_Drivable_Area.";
CM_ SG_ 154 OBJ_Is_VeryClose_8 "Indicates whether the target is very close to the host such that it is hard to measure it's distance. Currently relevant for peds only. ";
CM_ SG_ 154 OBJ_Is_VeryClose_V_8 "Validator for OBJ_Is_VeryClose. ";
CM_ SG_ 154 OBJ_Occlusion_RL_8 "Was Rear left of the 3D detection of theobject occluded";
CM_ SG_ 154 OBJ_Occlusion_RR_8 "Was Rear Right of the 3D detection of theobject occluded";
CM_ SG_ 154 OBJ_Occlusion_FR_8 "Was front Right of the 3D detection of theobject occluded";
CM_ SG_ 154 OBJ_Occlusion_FL_8 "Was Front left of the 3D detection of theobject occluded";
CM_ SG_ 154 OBJ_CRC_9 "Calculated over each object signal";
CM_ SG_ 154 OBJ_ID_9 "The detected object ID. Range is 1-255, while 0 indicates that the field in unfilled.";
CM_ SG_ 154 OBJ_Existence_Probability_9 "The existence probability of the vehicle";
CM_ SG_ 154 OBJ_Fusion_Source_9 "sources ids used for fusion";
CM_ SG_ 154 OBJ_Triggered_SDM_9 "Indicates whether the object has trigered the SDM (Safety Diagnostic Manager) alert.";
CM_ SG_ 154 OBJ_Motion_Category_9 "Relevant for VD only. Full description of values can be found at the ACC guide.";
CM_ SG_ 154 OBJ_Object_Age_9 "The number of frames in which the object was recognized.";
CM_ SG_ 154 OBJ_Measuring_Status_9 "Measurment status. Old vs New marks if this is the first frame in which the object is reported. Predicted vs Measured marks if the report is raw or has been predicted forward in time using the measured dynamics and ego motion.";
CM_ SG_ 154 OBJ_Object_Class_9 "Indicates the object type. Uncertain is outputted in case the probability that a vehicle is a truck is very similar to the probability that it is a car. ";
CM_ SG_ 154 OBJ_Class_Probability_9 "The probability of this type classification.";
CM_ SG_ 154 OBJ_Camera_Source_9 "The camera in which this object was detected (best choice).";
CM_ SG_ 154 OBJ_Motion_Status_9 "MOVING - the object is moving STATIONARY - the object was never seen moving STOPPED -  the object was moving and has stopped MOVING_SLOWLY - the object is moving very slowly";
CM_ SG_ 154 OBJ_Motion_Orientation_9 "The direction of the target's heading compared to the host. ";
CM_ SG_ 154 OBJ_Has_Cut_Lane_9 "Indicates whether the object cut the host's (right or left) lane. In case there are no lanes, indicates whether the objects is at most 1 meters away from the host.";
CM_ SG_ 154 OBJ_Has_Cut_Path_9 "Indicates whether the object is in the host's path.";
CM_ SG_ 154 OBJ_Brake_Light_9 "Indication for brake lights ";
CM_ SG_ 154 OBJ_Turn_Indicator_Right_9 "Indication for blinking right light.";
CM_ SG_ 154 OBJ_Turn_Indicator_Left_9 "Indication for blinking left light ";
CM_ SG_ 154 OBJ_Light_Indicator_Validity_9 "Validator for light indicators";
CM_ SG_ 154 OBJ_Right_Out_Of_Image_9 "Indicates whether the measurment are predicted out of the right side of the image bounderies.";
CM_ SG_ 154 OBJ_Left_Out_Of_Image_9 "Indicates whether if measurment are predicted out of  the left side of the image bounderies";
CM_ SG_ 154 OBJ_Right_Out_Of_Image_V_9 "validator";
CM_ SG_ 154 OBJ_Left_Out_Of_Image_V_9 "validator";
CM_ SG_ 154 OBJ_Top_Out_Of_Image_9 "Indicates whether if measurment are predicted out of  the top of the image bounderies";
CM_ SG_ 154 OBJ_Bottom_Out_Of_Image_9 "validator";
CM_ SG_ 154 OBJ_Top_Out_Of_Image_V_9 "Indicates whether if measurment are predicted out of  the bottom of the image bounderies";
CM_ SG_ 154 OBJ_Bottom_Out_Of_Image_V_9 "validator";
CM_ SG_ 154 OBJ_Lane_Assignment_9 "The object's lane relative to the host lane.";
CM_ SG_ 154 OBJ_Lane_Assignment_V_9 "Validator for lane assignment";
CM_ SG_ 154 OBJ_Age_Seconds_9 "Time in seconds in which the object was recognized. Currently available for peds only. ";
CM_ SG_ 154 OBJ_Age_Seconds_V_9 "Validator for object age";
CM_ SG_ 154 OBJ_Width_9 "The width of the target vehicle in the world (not to be mistaken with the width of the visible part of the vehicle).";
CM_ SG_ 154 OBJ_Width_V_9 "Validator for object width";
CM_ SG_ 154 OBJ_Width_STD_9 "Standard deviation for object width";
CM_ SG_ 154 OBJ_Width_STD_V_9 "Validator for the standard deviation of object width";
CM_ SG_ 154 OBJ_Length_9 "The length of the vehicle in the world. For crossing bicycles it gives the viewed length of the bicycle.";
CM_ SG_ 154 OBJ_Length_V_9 "Validator for object length.";
CM_ SG_ 154 OBJ_Length_STD_9 "Standard deviation for object length.";
CM_ SG_ 154 OBJ_Length_STD_V_9 "Validator for the standard deviation of object length.";
CM_ SG_ 154 OBJ_Height_9 "The height of the object in the world. ";
CM_ SG_ 154 OBJ_Height_V_9 "Validator for object height.";
CM_ SG_ 154 OBJ_Height_STD_9 "Standard deviation for object height.";
CM_ SG_ 154 OBJ_Height_STD_V_9 "Validator for the standard deviation of object height.";
CM_ SG_ 154 OBJ_Abs_Long_Velocity_9 "Absolute longitudinal velocity.";
CM_ SG_ 154 OBJ_Abs_Long_Velocity_V_9 "Validator for absolute longitudinal velocity.";
CM_ SG_ 154 OBJ_Abs_Long_Velocity_STD_9 "Standard deviation of absolute longitudinal velocity.";
CM_ SG_ 154 OBJ_Abs_Long_Vel_STD_V_9 "Validator for the standard deviation of the absolute longitudinal velocity.";
CM_ SG_ 154 OBJ_Abs_Lat_Velocity_9 "The lateral ground speed of the object.";
CM_ SG_ 154 OBJ_Abs_Lat_Velocity_V_9 "Validator for the lateral ground speed of the object.";
CM_ SG_ 154 OBJ_Abs_Lat_Velocity_STD_9 "STD of the lateral ground speed of the object.";
CM_ SG_ 154 OBJ_Abs_Lat_Vel_STD_V_9 "Validator for the STD of the lateral ground speed of the object.";
CM_ SG_ 154 OBJ_Abs_Long_Acc_9 "The longitudinal ground acceleration of the object.";
CM_ SG_ 154 OBJ_Abs_Long_Acc_V_9 "Validator for the longitudinal ground acceleration of the object.";
CM_ SG_ 154 OBJ_Abs_Long_Acc_STD_9 "STD of the longitudinal ground acceleration of the object.";
CM_ SG_ 154 OBJ_Abs_Long_Acc_STD_V_9 "Validator for the STD of the longitudinal ground acceleration of the object.";
CM_ SG_ 154 OBJ_Abs_Lat_Acc_9 "The lateral ground acceleration of the object.";
CM_ SG_ 154 OBJ_Abs_Lat_Acc_V_9 "Validator for the lateral ground acceleration of the object.";
CM_ SG_ 154 OBJ_Abs_Lat_Acc_STD_9 "STD of the lateral ground acceleration of the object.";
CM_ SG_ 154 OBJ_Abs_Lat_Acc_STD_V_9 "Validator for the STD of the lateral ground acceleration of the object.";
CM_ SG_ 154 OBJ_Abs_Acceleration_9 "The absolute ground acceleration in the target's heading direction.";
CM_ SG_ 154 OBJ_Abs_Acceleration_V_9 "Validator for the absolute ground acceleration.";
CM_ SG_ 154 OBJ_Abs_Acc_STD_9 "STD of the absolute ground acceleration.";
CM_ SG_ 154 OBJ_Abs_Acc_STD_V_9 "Validator for the STD of the absolute ground acceleration.";
CM_ SG_ 154 OBJ_Inv_TTC_9 "Inverse TTC (time to collision).";
CM_ SG_ 154 OBJ_Inv_TTC_V_9 "Validator for Inverse TTC.";
CM_ SG_ 154 OBJ_Inv_TTC_STD_9 "STD for inverse TTC .";
CM_ SG_ 154 OBJ_Inv_TTC_STD_V_9 "Validator for the STD for inverse TTC .";
CM_ SG_ 154 OBJ_Relative_Long_Acc_9 "The relative lateral ground acceleration of the object.";
CM_ SG_ 154 OBJ_Relative_Long_Acc_V_9 "Validator for the relative lateral ground acceleration of the object.";
CM_ SG_ 154 OBJ_Relative_Long_Acc_STD_9 "STD of the relative lateral ground acceleration of the object.";
CM_ SG_ 154 OBJ_Rel_Long_Acc_STD_V_9 "Validator for the STD of the relative lateral ground acceleration.";
CM_ SG_ 154 OBJ_Relative_Long_Velocity_9 "The relative longtitudinal speed between the target and ego vehicle. ";
CM_ SG_ 154 OBJ_Relative_Long_Velocity_V_9 "Validator for the relative longtitudinal speed.";
CM_ SG_ 154 OBJ_Relative_Long_Vel_STD_9 "STD of the relative longtitudinal speed.";
CM_ SG_ 154 OBJ_Rel_Long_Vel_STD_V_9 "Validator for the STD of the relative longtitudinal speed.";
CM_ SG_ 154 OBJ_Relative_Lat_Velocity_9 "The relative lateral speed between the target and ego vehicle. ";
CM_ SG_ 154 OBJ_Relative_Lat_Velocity_V_9 "Validator for the relative lateral speed. ";
CM_ SG_ 154 OBJ_Relative_Lat_Velocity_STD_9 "STD of the relative lateral speed. ";
CM_ SG_ 154 OBJ_Rel_Lat_Vel_STD_V_9 "Validator for the STD of the relative lateral speed. ";
CM_ SG_ 154 OBJ_Long_Distance_9 "The longtitudinal distance from the object to the middle of the Rear-Left and Rear-Right corners of the host vehicle.  ";
CM_ SG_ 154 OBJ_Long_Distance_V_9 "Validator of the longtitudinal distance from the object to the middle of the rear-axle of the host.  ";
CM_ SG_ 154 OBJ_Long_Distance_STD_9 "STD of the  longtitudinal distance.";
CM_ SG_ 154 OBJ_Long_Distance_STD_V_9 "Validator for the STD of the  longtitudinal distance.";
CM_ SG_ 154 OBJ_Lat_Distance_9 "Lateral distance to the middle of the RL and RR corners.  ";
CM_ SG_ 154 OBJ_Lat_Distance_V_9 "Validator for the lateral distance of the object.";
CM_ SG_ 154 OBJ_Lat_Distance_STD_9 "STD of the lateral distance of the object.";
CM_ SG_ 154 OBJ_Lat_Distance_STD_V_9 "Validator for the STD of the lateral distance of the object.";
CM_ SG_ 154 OBJ_Absolute_Speed_9 "The absolute ground speed in the targets' heading direction.";
CM_ SG_ 154 OBJ_Absolute_Speed_V_9 "Validator for the absolute ground speed.";
CM_ SG_ 154 OBJ_Absolute_Speed_STD_9 "STD of the absolute ground speed.";
CM_ SG_ 154 OBJ_Absolute_Speed_STD_V_9 "Validator for the STD of the absolute ground speed.";
CM_ SG_ 154 OBJ_Heading_9 "The angle beetweenthe host longitudinal axis and target's heading (clockwise, e.g. PI/2 is a target crossing from left to right).";
CM_ SG_ 154 OBJ_Heading_V_9 "Validator for the object heading.";
CM_ SG_ 154 OBJ_Heading_STD_9 "STD of the object heading.";
CM_ SG_ 154 OBJ_Heading_STD_V_9 "Validator for the STD of the object heading.";
CM_ SG_ 154 OBJ_Angle_Rate_STD_9 "Standard deviation of the angular speed. (radians)";
CM_ SG_ 154 OBJ_Angle_Rate_STD_V_9 "Validator for the STD of the angular speed.";
CM_ SG_ 154 OBJ_Angle_Rate_9 "The momentary angular speed of the object. (radians)";
CM_ SG_ 154 OBJ_Angle_Rate_V_9 "Validator for the angular speed.";
CM_ SG_ 154 OBJ_Angle_Right_9 "The angle between the host longitudinal axis and the right side of the front / rear of the target (the visible one). The positive side is to the host's right.";
CM_ SG_ 154 OBJ_Angle_Right_V_9 "Validator for angleRight";
CM_ SG_ 154 OBJ_Angle_Right_STD_9 "Standard deviation of angleRight";
CM_ SG_ 154 OBJ_Angle_Right_STD_V_9 "Validator for the standard deviation of angleRight.";
CM_ SG_ 154 OBJ_Angle_Left_9 "The angle between the host longitudinal axis and the left side of the front / rear of the target (the visible one). The positive side is to the host's right.";
CM_ SG_ 154 OBJ_Angle_Left_V_9 "Validator for angleLeft.";
CM_ SG_ 154 OBJ_Angle_Left_STD_9 "Standard deviation of angleLeft.";
CM_ SG_ 154 OBJ_Angle_Left_STD_V_9 "Validator for the standard deviation of angleLeft.";
CM_ SG_ 154 OBJ_Angle_Side_9 "The angle between the host longitudinal axis and the far visible edge - the visible edge of the front / rear of the target that is not visible. Currently supported for vehicles only.";
CM_ SG_ 154 OBJ_Angle_Side_V_9 "Validator for angleSide.";
CM_ SG_ 154 OBJ_Angle_Side_STD_9 "Standard deviation of angleSide.";
CM_ SG_ 154 OBJ_Angle_Side_STD_V_9 "Validator for the STD of angleSide.";
CM_ SG_ 154 OBJ_Angle_Mid_V_9 "Validator for angleMid.";
CM_ SG_ 154 OBJ_Angle_Mid_9 "The angle between the host longitudinal axis and the middle of the front / rear of the target (the visible one). The positive side is to the host's right.";
CM_ SG_ 154 OBJ_Angle_Mid_STD_9 "Standard deviation of angleMid.";
CM_ SG_ 154 OBJ_Angle_Mid_STD_V_9 "Validator for the STD of angleMid.";
CM_ SG_ 154 OBJ_Angle_Bottom_V_9 "Validator for OBJAngle_Bottom. ";
CM_ SG_ 154 OBJ_Angle_Bottom_9 "The angle between the logitudinal axis and the Bottom of the front / rear of the target (the visible one). The positive side is to the hosts right";
CM_ SG_ 154 OBJ_Angle_Bottom_STD_9 "STD for OBJAngle_Bottom. ";
CM_ SG_ 154 OBJ_Angle_Bottom_STD_V_9 "Validator for OBJAngle_Bottom_STD. ";
CM_ SG_ 154 OBJ_Visibility_Side_V_9 "Currently Supported for VD only";
CM_ SG_ 154 OBJ_Visibility_Side_9 "From what car  side is the object visible";
CM_ SG_ 154 OBJ_Is_In_Drivable_Area_9 "Indicates whether the target is in a driveable area.";
CM_ SG_ 154 OBJ_Is_In_Drivable_Area_V_9 "Validator for OBJ_Is_In_Drivable_Area.";
CM_ SG_ 154 OBJ_Is_VeryClose_9 "Indicates whether the target is very close to the host such that it is hard to measure it's distance. Currently relevant for peds only. ";
CM_ SG_ 154 OBJ_Is_VeryClose_V_9 "Validator for OBJ_Is_VeryClose. ";
CM_ SG_ 154 OBJ_Occlusion_RL_9 "Was Rear left of the 3D detection of theobject occluded";
CM_ SG_ 154 OBJ_Occlusion_RR_9 "Was Rear Right of the 3D detection of theobject occluded";
CM_ SG_ 154 OBJ_Occlusion_FR_9 "Was front Right of the 3D detection of theobject occluded";
CM_ SG_ 154 OBJ_Occlusion_FL_9 "Was Front left of the 3D detection of theobject occluded";
CM_ SG_ 154 OBJ_CRC_10 "Calculated over each object signal";
CM_ SG_ 154 OBJ_ID_10 "The detected object ID. Range is 1-255, while 0 indicates that the field in unfilled.";
CM_ SG_ 154 OBJ_Existence_Probability_10 "The existence probability of the vehicle";
CM_ SG_ 154 OBJ_Fusion_Source_10 "sources ids used for fusion";
CM_ SG_ 154 OBJ_Triggered_SDM_10 "Indicates whether the object has trigered the SDM (Safety Diagnostic Manager) alert.";
CM_ SG_ 154 OBJ_Motion_Category_10 "Relevant for VD only. Full description of values can be found at the ACC guide.";
CM_ SG_ 154 OBJ_Object_Age_10 "The number of frames in which the object was recognized.";
CM_ SG_ 154 OBJ_Measuring_Status_10 "Measurment status. Old vs New marks if this is the first frame in which the object is reported. Predicted vs Measured marks if the report is raw or has been predicted forward in time using the measured dynamics and ego motion.";
CM_ SG_ 154 OBJ_Object_Class_10 "Indicates the object type. Uncertain is outputted in case the probability that a vehicle is a truck is very similar to the probability that it is a car. ";
CM_ SG_ 154 OBJ_Class_Probability_10 "The probability of this type classification.";
CM_ SG_ 154 OBJ_Camera_Source_10 "The camera in which this object was detected (best choice).";
CM_ SG_ 154 OBJ_Motion_Status_10 "MOVING - the object is moving STATIONARY - the object was never seen moving STOPPED -  the object was moving and has stopped MOVING_SLOWLY - the object is moving very slowly";
CM_ SG_ 154 OBJ_Motion_Orientation_10 "The direction of the target's heading compared to the host. ";
CM_ SG_ 154 OBJ_Has_Cut_Lane_10 "Indicates whether the object cut the host's (right or left) lane. In case there are no lanes, indicates whether the objects is at most 1 meters away from the host.";
CM_ SG_ 154 OBJ_Has_Cut_Path_10 "Indicates whether the object is in the host's path.";
CM_ SG_ 154 OBJ_Brake_Light_10 "Indication for brake lights ";
CM_ SG_ 154 OBJ_Turn_Indicator_Right_10 "Indication for blinking right light.";
CM_ SG_ 154 OBJ_Turn_Indicator_Left_10 "Indication for blinking left light ";
CM_ SG_ 154 OBJ_Light_Indicator_Validity_10 "Validator for light indicators";
CM_ SG_ 154 OBJ_Right_Out_Of_Image_10 "Indicates whether the measurment are predicted out of the right side of the image bounderies.";
CM_ SG_ 154 OBJ_Left_Out_Of_Image_10 "Indicates whether if measurment are predicted out of  the left side of the image bounderies";
CM_ SG_ 154 OBJ_Right_Out_Of_Image_V_10 "validator";
CM_ SG_ 154 OBJ_Left_Out_Of_Image_V_10 "validator";
CM_ SG_ 154 OBJ_Top_Out_Of_Image_10 "Indicates whether if measurment are predicted out of  the top of the image bounderies";
CM_ SG_ 154 OBJ_Bottom_Out_Of_Image_10 "validator";
CM_ SG_ 154 OBJ_Top_Out_Of_Image_V_10 "Indicates whether if measurment are predicted out of  the bottom of the image bounderies";
CM_ SG_ 154 OBJ_Bottom_Out_Of_Image_V_10 "validator";
CM_ SG_ 154 OBJ_Lane_Assignment_10 "The object's lane relative to the host lane.";
CM_ SG_ 154 OBJ_Lane_Assignment_V_10 "Validator for lane assignment";
CM_ SG_ 154 OBJ_Age_Seconds_10 "Time in seconds in which the object was recognized. Currently available for peds only. ";
CM_ SG_ 154 OBJ_Age_Seconds_V_10 "Validator for object age";
CM_ SG_ 154 OBJ_Width_10 "The width of the target vehicle in the world (not to be mistaken with the width of the visible part of the vehicle).";
CM_ SG_ 154 OBJ_Width_V_10 "Validator for object width";
CM_ SG_ 154 OBJ_Width_STD_10 "Standard deviation for object width";
CM_ SG_ 154 OBJ_Width_STD_V_10 "Validator for the standard deviation of object width";
CM_ SG_ 154 OBJ_Length_10 "The length of the vehicle in the world. For crossing bicycles it gives the viewed length of the bicycle.";
CM_ SG_ 154 OBJ_Length_V_10 "Validator for object length.";
CM_ SG_ 154 OBJ_Length_STD_10 "Standard deviation for object length.";
CM_ SG_ 154 OBJ_Length_STD_V_10 "Validator for the standard deviation of object length.";
CM_ SG_ 154 OBJ_Height_10 "The height of the object in the world. ";
CM_ SG_ 154 OBJ_Height_V_10 "Validator for object height.";
CM_ SG_ 154 OBJ_Height_STD_10 "Standard deviation for object height.";
CM_ SG_ 154 OBJ_Height_STD_V_10 "Validator for the standard deviation of object height.";
CM_ SG_ 154 OBJ_Abs_Long_Velocity_10 "Absolute longitudinal velocity.";
CM_ SG_ 154 OBJ_Abs_Long_Velocity_V_10 "Validator for absolute longitudinal velocity.";
CM_ SG_ 154 OBJ_Abs_Long_Velocity_STD_10 "Standard deviation of absolute longitudinal velocity.";
CM_ SG_ 154 OBJ_Abs_Long_Vel_STD_V_10 "Validator for the standard deviation of the absolute longitudinal velocity.";
CM_ SG_ 154 OBJ_Abs_Lat_Velocity_10 "The lateral ground speed of the object.";
CM_ SG_ 154 OBJ_Abs_Lat_Velocity_V_10 "Validator for the lateral ground speed of the object.";
CM_ SG_ 154 OBJ_Abs_Lat_Velocity_STD_10 "STD of the lateral ground speed of the object.";
CM_ SG_ 154 OBJ_Abs_Lat_Vel_STD_V_10 "Validator for the STD of the lateral ground speed of the object.";
CM_ SG_ 154 OBJ_Abs_Long_Acc_10 "The longitudinal ground acceleration of the object.";
CM_ SG_ 154 OBJ_Abs_Long_Acc_V_10 "Validator for the longitudinal ground acceleration of the object.";
CM_ SG_ 154 OBJ_Abs_Long_Acc_STD_10 "STD of the longitudinal ground acceleration of the object.";
CM_ SG_ 154 OBJ_Abs_Long_Acc_STD_V_10 "Validator for the STD of the longitudinal ground acceleration of the object.";
CM_ SG_ 154 OBJ_Abs_Lat_Acc_10 "The lateral ground acceleration of the object.";
CM_ SG_ 154 OBJ_Abs_Lat_Acc_V_10 "Validator for the lateral ground acceleration of the object.";
CM_ SG_ 154 OBJ_Abs_Lat_Acc_STD_10 "STD of the lateral ground acceleration of the object.";
CM_ SG_ 154 OBJ_Abs_Lat_Acc_STD_V_10 "Validator for the STD of the lateral ground acceleration of the object.";
CM_ SG_ 154 OBJ_Abs_Acceleration_10 "The absolute ground acceleration in the target's heading direction.";
CM_ SG_ 154 OBJ_Abs_Acceleration_V_10 "Validator for the absolute ground acceleration.";
CM_ SG_ 154 OBJ_Abs_Acc_STD_10 "STD of the absolute ground acceleration.";
CM_ SG_ 154 OBJ_Abs_Acc_STD_V_10 "Validator for the STD of the absolute ground acceleration.";
CM_ SG_ 154 OBJ_Inv_TTC_10 "Inverse TTC (time to collision).";
CM_ SG_ 154 OBJ_Inv_TTC_V_10 "Validator for Inverse TTC.";
CM_ SG_ 154 OBJ_Inv_TTC_STD_10 "STD for inverse TTC .";
CM_ SG_ 154 OBJ_Inv_TTC_STD_V_10 "Validator for the STD for inverse TTC .";
CM_ SG_ 154 OBJ_Relative_Long_Acc_10 "The relative lateral ground acceleration of the object.";
CM_ SG_ 154 OBJ_Relative_Long_Acc_V_10 "Validator for the relative lateral ground acceleration of the object.";
CM_ SG_ 154 OBJ_Relative_Long_Acc_STD_10 "STD of the relative lateral ground acceleration of the object.";
CM_ SG_ 154 OBJ_Rel_Long_Acc_STD_V_10 "Validator for the STD of the relative lateral ground acceleration.";
CM_ SG_ 154 OBJ_Relative_Long_Velocity_10 "The relative longtitudinal speed between the target and ego vehicle. ";
CM_ SG_ 154 OBJ_Relative_Long_Velocity_V_10 "Validator for the relative longtitudinal speed.";
CM_ SG_ 154 OBJ_Relative_Long_Vel_STD_10 "STD of the relative longtitudinal speed.";
CM_ SG_ 154 OBJ_Rel_Long_Vel_STD_V_10 "Validator for the STD of the relative longtitudinal speed.";
CM_ SG_ 154 OBJ_Relative_Lat_Velocity_10 "The relative lateral speed between the target and ego vehicle. ";
CM_ SG_ 154 OBJ_Relative_Lat_Velocity_V_10 "Validator for the relative lateral speed. ";
CM_ SG_ 154 OBJ_Relative_Lat_Velocity_STD_10 "STD of the relative lateral speed. ";
CM_ SG_ 154 OBJ_Rel_Lat_Vel_STD_V_10 "Validator for the STD of the relative lateral speed. ";
CM_ SG_ 154 OBJ_Long_Distance_10 "The longtitudinal distance from the object to the middle of the Rear-Left and Rear-Right corners of the host vehicle.  ";
CM_ SG_ 154 OBJ_Long_Distance_V_10 "Validator of the longtitudinal distance from the object to the middle of the rear-axle of the host.  ";
CM_ SG_ 154 OBJ_Long_Distance_STD_10 "STD of the  longtitudinal distance.";
CM_ SG_ 154 OBJ_Long_Distance_STD_V_10 "Validator for the STD of the  longtitudinal distance.";
CM_ SG_ 154 OBJ_Lat_Distance_10 "Lateral distance to the middle of the RL and RR corners.  ";
CM_ SG_ 154 OBJ_Lat_Distance_V_10 "Validator for the lateral distance of the object.";
CM_ SG_ 154 OBJ_Lat_Distance_STD_10 "STD of the lateral distance of the object.";
CM_ SG_ 154 OBJ_Lat_Distance_STD_V_10 "Validator for the STD of the lateral distance of the object.";
CM_ SG_ 154 OBJ_Absolute_Speed_10 "The absolute ground speed in the targets' heading direction.";
CM_ SG_ 154 OBJ_Absolute_Speed_V_10 "Validator for the absolute ground speed.";
CM_ SG_ 154 OBJ_Absolute_Speed_STD_10 "STD of the absolute ground speed.";
CM_ SG_ 154 OBJ_Absolute_Speed_STD_V_10 "Validator for the STD of the absolute ground speed.";
CM_ SG_ 154 OBJ_Heading_10 "The angle beetweenthe host longitudinal axis and target's heading (clockwise, e.g. PI/2 is a target crossing from left to right).";
CM_ SG_ 154 OBJ_Heading_V_10 "Validator for the object heading.";
CM_ SG_ 154 OBJ_Heading_STD_10 "STD of the object heading.";
CM_ SG_ 154 OBJ_Heading_STD_V_10 "Validator for the STD of the object heading.";
CM_ SG_ 154 OBJ_Angle_Rate_STD_10 "Standard deviation of the angular speed. (radians)";
CM_ SG_ 154 OBJ_Angle_Rate_STD_V_10 "Validator for the STD of the angular speed.";
CM_ SG_ 154 OBJ_Angle_Rate_10 "The momentary angular speed of the object. (radians)";
CM_ SG_ 154 OBJ_Angle_Rate_V_10 "Validator for the angular speed.";
CM_ SG_ 154 OBJ_Angle_Right_10 "The angle between the host longitudinal axis and the right side of the front / rear of the target (the visible one). The positive side is to the host's right.";
CM_ SG_ 154 OBJ_Angle_Right_V_10 "Validator for angleRight";
CM_ SG_ 154 OBJ_Angle_Right_STD_10 "Standard deviation of angleRight";
CM_ SG_ 154 OBJ_Angle_Right_STD_V_10 "Validator for the standard deviation of angleRight.";
CM_ SG_ 154 OBJ_Angle_Left_10 "The angle between the host longitudinal axis and the left side of the front / rear of the target (the visible one). The positive side is to the host's right.";
CM_ SG_ 154 OBJ_Angle_Left_V_10 "Validator for angleLeft.";
CM_ SG_ 154 OBJ_Angle_Left_STD_10 "Standard deviation of angleLeft.";
CM_ SG_ 154 OBJ_Angle_Left_STD_V_10 "Validator for the standard deviation of angleLeft.";
CM_ SG_ 154 OBJ_Angle_Side_10 "The angle between the host longitudinal axis and the far visible edge - the visible edge of the front / rear of the target that is not visible. Currently supported for vehicles only.";
CM_ SG_ 154 OBJ_Angle_Side_V_10 "Validator for angleSide.";
CM_ SG_ 154 OBJ_Angle_Side_STD_10 "Standard deviation of angleSide.";
CM_ SG_ 154 OBJ_Angle_Side_STD_V_10 "Validator for the STD of angleSide.";
CM_ SG_ 154 OBJ_Angle_Mid_V_10 "Validator for angleMid.";
CM_ SG_ 154 OBJ_Angle_Mid_10 "The angle between the host longitudinal axis and the middle of the front / rear of the target (the visible one). The positive side is to the host's right.";
CM_ SG_ 154 OBJ_Angle_Mid_STD_10 "Standard deviation of angleMid.";
CM_ SG_ 154 OBJ_Angle_Mid_STD_V_10 "Validator for the STD of angleMid.";
CM_ SG_ 154 OBJ_Angle_Bottom_V_10 "Validator for OBJAngle_Bottom. ";
CM_ SG_ 154 OBJ_Angle_Bottom_10 "The angle between the logitudinal axis and the Bottom of the front / rear of the target (the visible one). The positive side is to the hosts right";
CM_ SG_ 154 OBJ_Angle_Bottom_STD_10 "STD for OBJAngle_Bottom. ";
CM_ SG_ 154 OBJ_Angle_Bottom_STD_V_10 "Validator for OBJAngle_Bottom_STD. ";
CM_ SG_ 154 OBJ_Visibility_Side_V_10 "Currently Supported for VD only";
CM_ SG_ 154 OBJ_Visibility_Side_10 "From what car  side is the object visible";
CM_ SG_ 154 OBJ_Is_In_Drivable_Area_10 "Indicates whether the target is in a driveable area.";
CM_ SG_ 154 OBJ_Is_In_Drivable_Area_V_10 "Validator for OBJ_Is_In_Drivable_Area.";
CM_ SG_ 154 OBJ_Is_VeryClose_10 "Indicates whether the target is very close to the host such that it is hard to measure it's distance. Currently relevant for peds only. ";
CM_ SG_ 154 OBJ_Is_VeryClose_V_10 "Validator for OBJ_Is_VeryClose. ";
CM_ SG_ 154 OBJ_Occlusion_RL_10 "Was Rear left of the 3D detection of theobject occluded";
CM_ SG_ 154 OBJ_Occlusion_RR_10 "Was Rear Right of the 3D detection of theobject occluded";
CM_ SG_ 154 OBJ_Occlusion_FR_10 "Was front Right of the 3D detection of theobject occluded";
CM_ SG_ 154 OBJ_Occlusion_FL_10 "Was Front left of the 3D detection of theobject occluded";
CM_ SG_ 154 OBJ_CRC_11 "Calculated over each object signal";
CM_ SG_ 154 OBJ_ID_11 "The detected object ID. Range is 1-255, while 0 indicates that the field in unfilled.";
CM_ SG_ 154 OBJ_Existence_Probability_11 "The existence probability of the vehicle";
CM_ SG_ 154 OBJ_Fusion_Source_11 "sources ids used for fusion";
CM_ SG_ 154 OBJ_Triggered_SDM_11 "Indicates whether the object has trigered the SDM (Safety Diagnostic Manager) alert.";
CM_ SG_ 154 OBJ_Motion_Category_11 "Relevant for VD only. Full description of values can be found at the ACC guide.";
CM_ SG_ 154 OBJ_Object_Age_11 "The number of frames in which the object was recognized.";
CM_ SG_ 154 OBJ_Measuring_Status_11 "Measurment status. Old vs New marks if this is the first frame in which the object is reported. Predicted vs Measured marks if the report is raw or has been predicted forward in time using the measured dynamics and ego motion.";
CM_ SG_ 154 OBJ_Object_Class_11 "Indicates the object type. Uncertain is outputted in case the probability that a vehicle is a truck is very similar to the probability that it is a car. ";
CM_ SG_ 154 OBJ_Class_Probability_11 "The probability of this type classification.";
CM_ SG_ 154 OBJ_Camera_Source_11 "The camera in which this object was detected (best choice).";
CM_ SG_ 154 OBJ_Motion_Status_11 "MOVING - the object is moving STATIONARY - the object was never seen moving STOPPED -  the object was moving and has stopped MOVING_SLOWLY - the object is moving very slowly";
CM_ SG_ 154 OBJ_Motion_Orientation_11 "The direction of the target's heading compared to the host. ";
CM_ SG_ 154 OBJ_Has_Cut_Lane_11 "Indicates whether the object cut the host's (right or left) lane. In case there are no lanes, indicates whether the objects is at most 1 meters away from the host.";
CM_ SG_ 154 OBJ_Has_Cut_Path_11 "Indicates whether the object is in the host's path.";
CM_ SG_ 154 OBJ_Brake_Light_11 "Indication for brake lights ";
CM_ SG_ 154 OBJ_Turn_Indicator_Right_11 "Indication for blinking right light.";
CM_ SG_ 154 OBJ_Turn_Indicator_Left_11 "Indication for blinking left light ";
CM_ SG_ 154 OBJ_Light_Indicator_Validity_11 "Validator for light indicators";
CM_ SG_ 154 OBJ_Right_Out_Of_Image_11 "Indicates whether the measurment are predicted out of the right side of the image bounderies.";
CM_ SG_ 154 OBJ_Left_Out_Of_Image_11 "Indicates whether if measurment are predicted out of  the left side of the image bounderies";
CM_ SG_ 154 OBJ_Right_Out_Of_Image_V_11 "validator";
CM_ SG_ 154 OBJ_Left_Out_Of_Image_V_11 "validator";
CM_ SG_ 154 OBJ_Top_Out_Of_Image_11 "Indicates whether if measurment are predicted out of  the top of the image bounderies";
CM_ SG_ 154 OBJ_Bottom_Out_Of_Image_11 "validator";
CM_ SG_ 154 OBJ_Top_Out_Of_Image_V_11 "Indicates whether if measurment are predicted out of  the bottom of the image bounderies";
CM_ SG_ 154 OBJ_Bottom_Out_Of_Image_V_11 "validator";
CM_ SG_ 154 OBJ_Lane_Assignment_11 "The object's lane relative to the host lane.";
CM_ SG_ 154 OBJ_Lane_Assignment_V_11 "Validator for lane assignment";
CM_ SG_ 154 OBJ_Age_Seconds_11 "Time in seconds in which the object was recognized. Currently available for peds only. ";
CM_ SG_ 154 OBJ_Age_Seconds_V_11 "Validator for object age";
CM_ SG_ 154 OBJ_Width_11 "The width of the target vehicle in the world (not to be mistaken with the width of the visible part of the vehicle).";
CM_ SG_ 154 OBJ_Width_V_11 "Validator for object width";
CM_ SG_ 154 OBJ_Width_STD_11 "Standard deviation for object width";
CM_ SG_ 154 OBJ_Width_STD_V_11 "Validator for the standard deviation of object width";
CM_ SG_ 154 OBJ_Length_11 "The length of the vehicle in the world. For crossing bicycles it gives the viewed length of the bicycle.";
CM_ SG_ 154 OBJ_Length_V_11 "Validator for object length.";
CM_ SG_ 154 OBJ_Length_STD_11 "Standard deviation for object length.";
CM_ SG_ 154 OBJ_Length_STD_V_11 "Validator for the standard deviation of object length.";
CM_ SG_ 154 OBJ_Height_11 "The height of the object in the world. ";
CM_ SG_ 154 OBJ_Height_V_11 "Validator for object height.";
CM_ SG_ 154 OBJ_Height_STD_11 "Standard deviation for object height.";
CM_ SG_ 154 OBJ_Height_STD_V_11 "Validator for the standard deviation of object height.";
CM_ SG_ 154 OBJ_Abs_Long_Velocity_11 "Absolute longitudinal velocity.";
CM_ SG_ 154 OBJ_Abs_Long_Velocity_V_11 "Validator for absolute longitudinal velocity.";
CM_ SG_ 154 OBJ_Abs_Long_Velocity_STD_11 "Standard deviation of absolute longitudinal velocity.";
CM_ SG_ 154 OBJ_Abs_Long_Vel_STD_V_11 "Validator for the standard deviation of the absolute longitudinal velocity.";
CM_ SG_ 154 OBJ_Abs_Lat_Velocity_11 "The lateral ground speed of the object.";
CM_ SG_ 154 OBJ_Abs_Lat_Velocity_V_11 "Validator for the lateral ground speed of the object.";
CM_ SG_ 154 OBJ_Abs_Lat_Velocity_STD_11 "STD of the lateral ground speed of the object.";
CM_ SG_ 154 OBJ_Abs_Lat_Vel_STD_V_11 "Validator for the STD of the lateral ground speed of the object.";
CM_ SG_ 154 OBJ_Abs_Long_Acc_11 "The longitudinal ground acceleration of the object.";
CM_ SG_ 154 OBJ_Abs_Long_Acc_V_11 "Validator for the longitudinal ground acceleration of the object.";
CM_ SG_ 154 OBJ_Abs_Long_Acc_STD_11 "STD of the longitudinal ground acceleration of the object.";
CM_ SG_ 154 OBJ_Abs_Long_Acc_STD_V_11 "Validator for the STD of the longitudinal ground acceleration of the object.";
CM_ SG_ 154 OBJ_Abs_Lat_Acc_11 "The lateral ground acceleration of the object.";
CM_ SG_ 154 OBJ_Abs_Lat_Acc_V_11 "Validator for the lateral ground acceleration of the object.";
CM_ SG_ 154 OBJ_Abs_Lat_Acc_STD_11 "STD of the lateral ground acceleration of the object.";
CM_ SG_ 154 OBJ_Abs_Lat_Acc_STD_V_11 "Validator for the STD of the lateral ground acceleration of the object.";
CM_ SG_ 154 OBJ_Abs_Acceleration_11 "The absolute ground acceleration in the target's heading direction.";
CM_ SG_ 154 OBJ_Abs_Acceleration_V_11 "Validator for the absolute ground acceleration.";
CM_ SG_ 154 OBJ_Abs_Acc_STD_11 "STD of the absolute ground acceleration.";
CM_ SG_ 154 OBJ_Abs_Acc_STD_V_11 "Validator for the STD of the absolute ground acceleration.";
CM_ SG_ 154 OBJ_Inv_TTC_11 "Inverse TTC (time to collision).";
CM_ SG_ 154 OBJ_Inv_TTC_V_11 "Validator for Inverse TTC.";
CM_ SG_ 154 OBJ_Inv_TTC_STD_11 "STD for inverse TTC .";
CM_ SG_ 154 OBJ_Inv_TTC_STD_V_11 "Validator for the STD for inverse TTC .";
CM_ SG_ 154 OBJ_Relative_Long_Acc_11 "The relative lateral ground acceleration of the object.";
CM_ SG_ 154 OBJ_Relative_Long_Acc_V_11 "Validator for the relative lateral ground acceleration of the object.";
CM_ SG_ 154 OBJ_Relative_Long_Acc_STD_11 "STD of the relative lateral ground acceleration of the object.";
CM_ SG_ 154 OBJ_Rel_Long_Acc_STD_V_11 "Validator for the STD of the relative lateral ground acceleration.";
CM_ SG_ 154 OBJ_Relative_Long_Velocity_11 "The relative longtitudinal speed between the target and ego vehicle. ";
CM_ SG_ 154 OBJ_Relative_Long_Velocity_V_11 "Validator for the relative longtitudinal speed.";
CM_ SG_ 154 OBJ_Relative_Long_Vel_STD_11 "STD of the relative longtitudinal speed.";
CM_ SG_ 154 OBJ_Rel_Long_Vel_STD_V_11 "Validator for the STD of the relative longtitudinal speed.";
CM_ SG_ 154 OBJ_Relative_Lat_Velocity_11 "The relative lateral speed between the target and ego vehicle. ";
CM_ SG_ 154 OBJ_Relative_Lat_Velocity_V_11 "Validator for the relative lateral speed. ";
CM_ SG_ 154 OBJ_Relative_Lat_Velocity_STD_11 "STD of the relative lateral speed. ";
CM_ SG_ 154 OBJ_Rel_Lat_Vel_STD_V_11 "Validator for the STD of the relative lateral speed. ";
CM_ SG_ 154 OBJ_Long_Distance_11 "The longtitudinal distance from the object to the middle of the Rear-Left and Rear-Right corners of the host vehicle.  ";
CM_ SG_ 154 OBJ_Long_Distance_V_11 "Validator of the longtitudinal distance from the object to the middle of the rear-axle of the host.  ";
CM_ SG_ 154 OBJ_Long_Distance_STD_11 "STD of the  longtitudinal distance.";
CM_ SG_ 154 OBJ_Long_Distance_STD_V_11 "Validator for the STD of the  longtitudinal distance.";
CM_ SG_ 154 OBJ_Lat_Distance_11 "Lateral distance to the middle of the RL and RR corners.  ";
CM_ SG_ 154 OBJ_Lat_Distance_V_11 "Validator for the lateral distance of the object.";
CM_ SG_ 154 OBJ_Lat_Distance_STD_11 "STD of the lateral distance of the object.";
CM_ SG_ 154 OBJ_Lat_Distance_STD_V_11 "Validator for the STD of the lateral distance of the object.";
CM_ SG_ 154 OBJ_Absolute_Speed_11 "The absolute ground speed in the targets' heading direction.";
CM_ SG_ 154 OBJ_Absolute_Speed_V_11 "Validator for the absolute ground speed.";
CM_ SG_ 154 OBJ_Absolute_Speed_STD_11 "STD of the absolute ground speed.";
CM_ SG_ 154 OBJ_Absolute_Speed_STD_V_11 "Validator for the STD of the absolute ground speed.";
CM_ SG_ 154 OBJ_Heading_11 "The angle beetweenthe host longitudinal axis and target's heading (clockwise, e.g. PI/2 is a target crossing from left to right).";
CM_ SG_ 154 OBJ_Heading_V_11 "Validator for the object heading.";
CM_ SG_ 154 OBJ_Heading_STD_11 "STD of the object heading.";
CM_ SG_ 154 OBJ_Heading_STD_V_11 "Validator for the STD of the object heading.";
CM_ SG_ 154 OBJ_Angle_Rate_STD_11 "Standard deviation of the angular speed. (radians)";
CM_ SG_ 154 OBJ_Angle_Rate_STD_V_11 "Validator for the STD of the angular speed.";
CM_ SG_ 154 OBJ_Angle_Rate_11 "The momentary angular speed of the object. (radians)";
CM_ SG_ 154 OBJ_Angle_Rate_V_11 "Validator for the angular speed.";
CM_ SG_ 154 OBJ_Angle_Right_11 "The angle between the host longitudinal axis and the right side of the front / rear of the target (the visible one). The positive side is to the host's right.";
CM_ SG_ 154 OBJ_Angle_Right_V_11 "Validator for angleRight";
CM_ SG_ 154 OBJ_Angle_Right_STD_11 "Standard deviation of angleRight";
CM_ SG_ 154 OBJ_Angle_Right_STD_V_11 "Validator for the standard deviation of angleRight.";
CM_ SG_ 154 OBJ_Angle_Left_11 "The angle between the host longitudinal axis and the left side of the front / rear of the target (the visible one). The positive side is to the host's right.";
CM_ SG_ 154 OBJ_Angle_Left_V_11 "Validator for angleLeft.";
CM_ SG_ 154 OBJ_Angle_Left_STD_11 "Standard deviation of angleLeft.";
CM_ SG_ 154 OBJ_Angle_Left_STD_V_11 "Validator for the standard deviation of angleLeft.";
CM_ SG_ 154 OBJ_Angle_Side_11 "The angle between the host longitudinal axis and the far visible edge - the visible edge of the front / rear of the target that is not visible. Currently supported for vehicles only.";
CM_ SG_ 154 OBJ_Angle_Side_V_11 "Validator for angleSide.";
CM_ SG_ 154 OBJ_Angle_Side_STD_11 "Standard deviation of angleSide.";
CM_ SG_ 154 OBJ_Angle_Side_STD_V_11 "Validator for the STD of angleSide.";
CM_ SG_ 154 OBJ_Angle_Mid_V_11 "Validator for angleMid.";
CM_ SG_ 154 OBJ_Angle_Mid_11 "The angle between the host longitudinal axis and the middle of the front / rear of the target (the visible one). The positive side is to the host's right.";
CM_ SG_ 154 OBJ_Angle_Mid_STD_11 "Standard deviation of angleMid.";
CM_ SG_ 154 OBJ_Angle_Mid_STD_V_11 "Validator for the STD of angleMid.";
CM_ SG_ 154 OBJ_Angle_Bottom_V_11 "Validator for OBJAngle_Bottom. ";
CM_ SG_ 154 OBJ_Angle_Bottom_11 "The angle between the logitudinal axis and the Bottom of the front / rear of the target (the visible one). The positive side is to the hosts right";
CM_ SG_ 154 OBJ_Angle_Bottom_STD_11 "STD for OBJAngle_Bottom. ";
CM_ SG_ 154 OBJ_Angle_Bottom_STD_V_11 "Validator for OBJAngle_Bottom_STD. ";
CM_ SG_ 154 OBJ_Visibility_Side_V_11 "Currently Supported for VD only";
CM_ SG_ 154 OBJ_Visibility_Side_11 "From what car  side is the object visible";
CM_ SG_ 154 OBJ_Is_In_Drivable_Area_11 "Indicates whether the target is in a driveable area.";
CM_ SG_ 154 OBJ_Is_In_Drivable_Area_V_11 "Validator for OBJ_Is_In_Drivable_Area.";
CM_ SG_ 154 OBJ_Is_VeryClose_11 "Indicates whether the target is very close to the host such that it is hard to measure it's distance. Currently relevant for peds only. ";
CM_ SG_ 154 OBJ_Is_VeryClose_V_11 "Validator for OBJ_Is_VeryClose. ";
CM_ SG_ 154 OBJ_Occlusion_RL_11 "Was Rear left of the 3D detection of theobject occluded";
CM_ SG_ 154 OBJ_Occlusion_RR_11 "Was Rear Right of the 3D detection of theobject occluded";
CM_ SG_ 154 OBJ_Occlusion_FR_11 "Was front Right of the 3D detection of theobject occluded";
CM_ SG_ 154 OBJ_Occlusion_FL_11 "Was Front left of the 3D detection of theobject occluded";
CM_ SG_ 154 OBJ_CRC_12 "Calculated over each object signal";
CM_ SG_ 154 OBJ_ID_12 "The detected object ID. Range is 1-255, while 0 indicates that the field in unfilled.";
CM_ SG_ 154 OBJ_Existence_Probability_12 "The existence probability of the vehicle";
CM_ SG_ 154 OBJ_Fusion_Source_12 "sources ids used for fusion";
CM_ SG_ 154 OBJ_Triggered_SDM_12 "Indicates whether the object has trigered the SDM (Safety Diagnostic Manager) alert.";
CM_ SG_ 154 OBJ_Motion_Category_12 "Relevant for VD only. Full description of values can be found at the ACC guide.";
CM_ SG_ 154 OBJ_Object_Age_12 "The number of frames in which the object was recognized.";
CM_ SG_ 154 OBJ_Measuring_Status_12 "Measurment status. Old vs New marks if this is the first frame in which the object is reported. Predicted vs Measured marks if the report is raw or has been predicted forward in time using the measured dynamics and ego motion.";
CM_ SG_ 154 OBJ_Object_Class_12 "Indicates the object type. Uncertain is outputted in case the probability that a vehicle is a truck is very similar to the probability that it is a car. ";
CM_ SG_ 154 OBJ_Class_Probability_12 "The probability of this type classification.";
CM_ SG_ 154 OBJ_Camera_Source_12 "The camera in which this object was detected (best choice).";
CM_ SG_ 154 OBJ_Motion_Status_12 "MOVING - the object is moving STATIONARY - the object was never seen moving STOPPED -  the object was moving and has stopped MOVING_SLOWLY - the object is moving very slowly";
CM_ SG_ 154 OBJ_Motion_Orientation_12 "The direction of the target's heading compared to the host. ";
CM_ SG_ 154 OBJ_Has_Cut_Lane_12 "Indicates whether the object cut the host's (right or left) lane. In case there are no lanes, indicates whether the objects is at most 1 meters away from the host.";
CM_ SG_ 154 OBJ_Has_Cut_Path_12 "Indicates whether the object is in the host's path.";
CM_ SG_ 154 OBJ_Brake_Light_12 "Indication for brake lights ";
CM_ SG_ 154 OBJ_Turn_Indicator_Right_12 "Indication for blinking right light.";
CM_ SG_ 154 OBJ_Turn_Indicator_Left_12 "Indication for blinking left light ";
CM_ SG_ 154 OBJ_Light_Indicator_Validity_12 "Validator for light indicators";
CM_ SG_ 154 OBJ_Right_Out_Of_Image_12 "Indicates whether the measurment are predicted out of the right side of the image bounderies.";
CM_ SG_ 154 OBJ_Left_Out_Of_Image_12 "Indicates whether if measurment are predicted out of  the left side of the image bounderies";
CM_ SG_ 154 OBJ_Right_Out_Of_Image_V_12 "validator";
CM_ SG_ 154 OBJ_Left_Out_Of_Image_V_12 "validator";
CM_ SG_ 154 OBJ_Top_Out_Of_Image_12 "Indicates whether if measurment are predicted out of  the top of the image bounderies";
CM_ SG_ 154 OBJ_Bottom_Out_Of_Image_12 "validator";
CM_ SG_ 154 OBJ_Top_Out_Of_Image_V_12 "Indicates whether if measurment are predicted out of  the bottom of the image bounderies";
CM_ SG_ 154 OBJ_Bottom_Out_Of_Image_V_12 "validator";
CM_ SG_ 154 OBJ_Lane_Assignment_12 "The object's lane relative to the host lane.";
CM_ SG_ 154 OBJ_Lane_Assignment_V_12 "Validator for lane assignment";
CM_ SG_ 154 OBJ_Age_Seconds_12 "Time in seconds in which the object was recognized. Currently available for peds only. ";
CM_ SG_ 154 OBJ_Age_Seconds_V_12 "Validator for object age";
CM_ SG_ 154 OBJ_Width_12 "The width of the target vehicle in the world (not to be mistaken with the width of the visible part of the vehicle).";
CM_ SG_ 154 OBJ_Width_V_12 "Validator for object width";
CM_ SG_ 154 OBJ_Width_STD_12 "Standard deviation for object width";
CM_ SG_ 154 OBJ_Width_STD_V_12 "Validator for the standard deviation of object width";
CM_ SG_ 154 OBJ_Length_12 "The length of the vehicle in the world. For crossing bicycles it gives the viewed length of the bicycle.";
CM_ SG_ 154 OBJ_Length_V_12 "Validator for object length.";
CM_ SG_ 154 OBJ_Length_STD_12 "Standard deviation for object length.";
CM_ SG_ 154 OBJ_Length_STD_V_12 "Validator for the standard deviation of object length.";
CM_ SG_ 154 OBJ_Height_12 "The height of the object in the world. ";
CM_ SG_ 154 OBJ_Height_V_12 "Validator for object height.";
CM_ SG_ 154 OBJ_Height_STD_12 "Standard deviation for object height.";
CM_ SG_ 154 OBJ_Height_STD_V_12 "Validator for the standard deviation of object height.";
CM_ SG_ 154 OBJ_Abs_Long_Velocity_12 "Absolute longitudinal velocity.";
CM_ SG_ 154 OBJ_Abs_Long_Velocity_V_12 "Validator for absolute longitudinal velocity.";
CM_ SG_ 154 OBJ_Abs_Long_Velocity_STD_12 "Standard deviation of absolute longitudinal velocity.";
CM_ SG_ 154 OBJ_Abs_Long_Vel_STD_V_12 "Validator for the standard deviation of the absolute longitudinal velocity.";
CM_ SG_ 154 OBJ_Abs_Lat_Velocity_12 "The lateral ground speed of the object.";
CM_ SG_ 154 OBJ_Abs_Lat_Velocity_V_12 "Validator for the lateral ground speed of the object.";
CM_ SG_ 154 OBJ_Abs_Lat_Velocity_STD_12 "STD of the lateral ground speed of the object.";
CM_ SG_ 154 OBJ_Abs_Lat_Vel_STD_V_12 "Validator for the STD of the lateral ground speed of the object.";
CM_ SG_ 154 OBJ_Abs_Long_Acc_12 "The longitudinal ground acceleration of the object.";
CM_ SG_ 154 OBJ_Abs_Long_Acc_V_12 "Validator for the longitudinal ground acceleration of the object.";
CM_ SG_ 154 OBJ_Abs_Long_Acc_STD_12 "STD of the longitudinal ground acceleration of the object.";
CM_ SG_ 154 OBJ_Abs_Long_Acc_STD_V_12 "Validator for the STD of the longitudinal ground acceleration of the object.";
CM_ SG_ 154 OBJ_Abs_Lat_Acc_12 "The lateral ground acceleration of the object.";
CM_ SG_ 154 OBJ_Abs_Lat_Acc_V_12 "Validator for the lateral ground acceleration of the object.";
CM_ SG_ 154 OBJ_Abs_Lat_Acc_STD_12 "STD of the lateral ground acceleration of the object.";
CM_ SG_ 154 OBJ_Abs_Lat_Acc_STD_V_12 "Validator for the STD of the lateral ground acceleration of the object.";
CM_ SG_ 154 OBJ_Abs_Acceleration_12 "The absolute ground acceleration in the target's heading direction.";
CM_ SG_ 154 OBJ_Abs_Acceleration_V_12 "Validator for the absolute ground acceleration.";
CM_ SG_ 154 OBJ_Abs_Acc_STD_12 "STD of the absolute ground acceleration.";
CM_ SG_ 154 OBJ_Abs_Acc_STD_V_12 "Validator for the STD of the absolute ground acceleration.";
CM_ SG_ 154 OBJ_Inv_TTC_12 "Inverse TTC (time to collision).";
CM_ SG_ 154 OBJ_Inv_TTC_V_12 "Validator for Inverse TTC.";
CM_ SG_ 154 OBJ_Inv_TTC_STD_12 "STD for inverse TTC .";
CM_ SG_ 154 OBJ_Inv_TTC_STD_V_12 "Validator for the STD for inverse TTC .";
CM_ SG_ 154 OBJ_Relative_Long_Acc_12 "The relative lateral ground acceleration of the object.";
CM_ SG_ 154 OBJ_Relative_Long_Acc_V_12 "Validator for the relative lateral ground acceleration of the object.";
CM_ SG_ 154 OBJ_Relative_Long_Acc_STD_12 "STD of the relative lateral ground acceleration of the object.";
CM_ SG_ 154 OBJ_Rel_Long_Acc_STD_V_12 "Validator for the STD of the relative lateral ground acceleration.";
CM_ SG_ 154 OBJ_Relative_Long_Velocity_12 "The relative longtitudinal speed between the target and ego vehicle. ";
CM_ SG_ 154 OBJ_Relative_Long_Velocity_V_12 "Validator for the relative longtitudinal speed.";
CM_ SG_ 154 OBJ_Relative_Long_Vel_STD_12 "STD of the relative longtitudinal speed.";
CM_ SG_ 154 OBJ_Rel_Long_Vel_STD_V_12 "Validator for the STD of the relative longtitudinal speed.";
CM_ SG_ 154 OBJ_Relative_Lat_Velocity_12 "The relative lateral speed between the target and ego vehicle. ";
CM_ SG_ 154 OBJ_Relative_Lat_Velocity_V_12 "Validator for the relative lateral speed. ";
CM_ SG_ 154 OBJ_Relative_Lat_Velocity_STD_12 "STD of the relative lateral speed. ";
CM_ SG_ 154 OBJ_Rel_Lat_Vel_STD_V_12 "Validator for the STD of the relative lateral speed. ";
CM_ SG_ 154 OBJ_Long_Distance_12 "The longtitudinal distance from the object to the middle of the Rear-Left and Rear-Right corners of the host vehicle.  ";
CM_ SG_ 154 OBJ_Long_Distance_V_12 "Validator of the longtitudinal distance from the object to the middle of the rear-axle of the host.  ";
CM_ SG_ 154 OBJ_Long_Distance_STD_12 "STD of the  longtitudinal distance.";
CM_ SG_ 154 OBJ_Long_Distance_STD_V_12 "Validator for the STD of the  longtitudinal distance.";
CM_ SG_ 154 OBJ_Lat_Distance_12 "Lateral distance to the middle of the RL and RR corners.  ";
CM_ SG_ 154 OBJ_Lat_Distance_V_12 "Validator for the lateral distance of the object.";
CM_ SG_ 154 OBJ_Lat_Distance_STD_12 "STD of the lateral distance of the object.";
CM_ SG_ 154 OBJ_Lat_Distance_STD_V_12 "Validator for the STD of the lateral distance of the object.";
CM_ SG_ 154 OBJ_Absolute_Speed_12 "The absolute ground speed in the targets' heading direction.";
CM_ SG_ 154 OBJ_Absolute_Speed_V_12 "Validator for the absolute ground speed.";
CM_ SG_ 154 OBJ_Absolute_Speed_STD_12 "STD of the absolute ground speed.";
CM_ SG_ 154 OBJ_Absolute_Speed_STD_V_12 "Validator for the STD of the absolute ground speed.";
CM_ SG_ 154 OBJ_Heading_12 "The angle beetweenthe host longitudinal axis and target's heading (clockwise, e.g. PI/2 is a target crossing from left to right).";
CM_ SG_ 154 OBJ_Heading_V_12 "Validator for the object heading.";
CM_ SG_ 154 OBJ_Heading_STD_12 "STD of the object heading.";
CM_ SG_ 154 OBJ_Heading_STD_V_12 "Validator for the STD of the object heading.";
CM_ SG_ 154 OBJ_Angle_Rate_STD_12 "Standard deviation of the angular speed. (radians)";
CM_ SG_ 154 OBJ_Angle_Rate_STD_V_12 "Validator for the STD of the angular speed.";
CM_ SG_ 154 OBJ_Angle_Rate_12 "The momentary angular speed of the object. (radians)";
CM_ SG_ 154 OBJ_Angle_Rate_V_12 "Validator for the angular speed.";
CM_ SG_ 154 OBJ_Angle_Right_12 "The angle between the host longitudinal axis and the right side of the front / rear of the target (the visible one). The positive side is to the host's right.";
CM_ SG_ 154 OBJ_Angle_Right_V_12 "Validator for angleRight";
CM_ SG_ 154 OBJ_Angle_Right_STD_12 "Standard deviation of angleRight";
CM_ SG_ 154 OBJ_Angle_Right_STD_V_12 "Validator for the standard deviation of angleRight.";
CM_ SG_ 154 OBJ_Angle_Left_12 "The angle between the host longitudinal axis and the left side of the front / rear of the target (the visible one). The positive side is to the host's right.";
CM_ SG_ 154 OBJ_Angle_Left_V_12 "Validator for angleLeft.";
CM_ SG_ 154 OBJ_Angle_Left_STD_12 "Standard deviation of angleLeft.";
CM_ SG_ 154 OBJ_Angle_Left_STD_V_12 "Validator for the standard deviation of angleLeft.";
CM_ SG_ 154 OBJ_Angle_Side_12 "The angle between the host longitudinal axis and the far visible edge - the visible edge of the front / rear of the target that is not visible. Currently supported for vehicles only.";
CM_ SG_ 154 OBJ_Angle_Side_V_12 "Validator for angleSide.";
CM_ SG_ 154 OBJ_Angle_Side_STD_12 "Standard deviation of angleSide.";
CM_ SG_ 154 OBJ_Angle_Side_STD_V_12 "Validator for the STD of angleSide.";
CM_ SG_ 154 OBJ_Angle_Mid_V_12 "Validator for angleMid.";
CM_ SG_ 154 OBJ_Angle_Mid_12 "The angle between the host longitudinal axis and the middle of the front / rear of the target (the visible one). The positive side is to the host's right.";
CM_ SG_ 154 OBJ_Angle_Mid_STD_12 "Standard deviation of angleMid.";
CM_ SG_ 154 OBJ_Angle_Mid_STD_V_12 "Validator for the STD of angleMid.";
CM_ SG_ 154 OBJ_Angle_Bottom_V_12 "Validator for OBJAngle_Bottom. ";
CM_ SG_ 154 OBJ_Angle_Bottom_12 "The angle between the logitudinal axis and the Bottom of the front / rear of the target (the visible one). The positive side is to the hosts right";
CM_ SG_ 154 OBJ_Angle_Bottom_STD_12 "STD for OBJAngle_Bottom. ";
CM_ SG_ 154 OBJ_Angle_Bottom_STD_V_12 "Validator for OBJAngle_Bottom_STD. ";
CM_ SG_ 154 OBJ_Visibility_Side_V_12 "Currently Supported for VD only";
CM_ SG_ 154 OBJ_Visibility_Side_12 "From what car  side is the object visible";
CM_ SG_ 154 OBJ_Is_In_Drivable_Area_12 "Indicates whether the target is in a driveable area.";
CM_ SG_ 154 OBJ_Is_In_Drivable_Area_V_12 "Validator for OBJ_Is_In_Drivable_Area.";
CM_ SG_ 154 OBJ_Is_VeryClose_12 "Indicates whether the target is very close to the host such that it is hard to measure it's distance. Currently relevant for peds only. ";
CM_ SG_ 154 OBJ_Is_VeryClose_V_12 "Validator for OBJ_Is_VeryClose. ";
CM_ SG_ 154 OBJ_Occlusion_RL_12 "Was Rear left of the 3D detection of theobject occluded";
CM_ SG_ 154 OBJ_Occlusion_RR_12 "Was Rear Right of the 3D detection of theobject occluded";
CM_ SG_ 154 OBJ_Occlusion_FR_12 "Was front Right of the 3D detection of theobject occluded";
CM_ SG_ 154 OBJ_Occlusion_FL_12 "Was Front left of the 3D detection of theobject occluded";
CM_ SG_ 154 OBJ_CRC_13 "Calculated over each object signal";
CM_ SG_ 154 OBJ_ID_13 "The detected object ID. Range is 1-255, while 0 indicates that the field in unfilled.";
CM_ SG_ 154 OBJ_Existence_Probability_13 "The existence probability of the vehicle";
CM_ SG_ 154 OBJ_Fusion_Source_13 "sources ids used for fusion";
CM_ SG_ 154 OBJ_Triggered_SDM_13 "Indicates whether the object has trigered the SDM (Safety Diagnostic Manager) alert.";
CM_ SG_ 154 OBJ_Motion_Category_13 "Relevant for VD only. Full description of values can be found at the ACC guide.";
CM_ SG_ 154 OBJ_Object_Age_13 "The number of frames in which the object was recognized.";
CM_ SG_ 154 OBJ_Measuring_Status_13 "Measurment status. Old vs New marks if this is the first frame in which the object is reported. Predicted vs Measured marks if the report is raw or has been predicted forward in time using the measured dynamics and ego motion.";
CM_ SG_ 154 OBJ_Object_Class_13 "Indicates the object type. Uncertain is outputted in case the probability that a vehicle is a truck is very similar to the probability that it is a car. ";
CM_ SG_ 154 OBJ_Class_Probability_13 "The probability of this type classification.";
CM_ SG_ 154 OBJ_Camera_Source_13 "The camera in which this object was detected (best choice).";
CM_ SG_ 154 OBJ_Motion_Status_13 "MOVING - the object is moving STATIONARY - the object was never seen moving STOPPED -  the object was moving and has stopped MOVING_SLOWLY - the object is moving very slowly";
CM_ SG_ 154 OBJ_Motion_Orientation_13 "The direction of the target's heading compared to the host. ";
CM_ SG_ 154 OBJ_Has_Cut_Lane_13 "Indicates whether the object cut the host's (right or left) lane. In case there are no lanes, indicates whether the objects is at most 1 meters away from the host.";
CM_ SG_ 154 OBJ_Has_Cut_Path_13 "Indicates whether the object is in the host's path.";
CM_ SG_ 154 OBJ_Brake_Light_13 "Indication for brake lights ";
CM_ SG_ 154 OBJ_Turn_Indicator_Right_13 "Indication for blinking right light.";
CM_ SG_ 154 OBJ_Turn_Indicator_Left_13 "Indication for blinking left light ";
CM_ SG_ 154 OBJ_Light_Indicator_Validity_13 "Validator for light indicators";
CM_ SG_ 154 OBJ_Right_Out_Of_Image_13 "Indicates whether the measurment are predicted out of the right side of the image bounderies.";
CM_ SG_ 154 OBJ_Left_Out_Of_Image_13 "Indicates whether if measurment are predicted out of  the left side of the image bounderies";
CM_ SG_ 154 OBJ_Right_Out_Of_Image_V_13 "validator";
CM_ SG_ 154 OBJ_Left_Out_Of_Image_V_13 "validator";
CM_ SG_ 154 OBJ_Top_Out_Of_Image_13 "Indicates whether if measurment are predicted out of  the top of the image bounderies";
CM_ SG_ 154 OBJ_Bottom_Out_Of_Image_13 "validator";
CM_ SG_ 154 OBJ_Top_Out_Of_Image_V_13 "Indicates whether if measurment are predicted out of  the bottom of the image bounderies";
CM_ SG_ 154 OBJ_Bottom_Out_Of_Image_V_13 "validator";
CM_ SG_ 154 OBJ_Lane_Assignment_13 "The object's lane relative to the host lane.";
CM_ SG_ 154 OBJ_Lane_Assignment_V_13 "Validator for lane assignment";
CM_ SG_ 154 OBJ_Age_Seconds_13 "Time in seconds in which the object was recognized. Currently available for peds only. ";
CM_ SG_ 154 OBJ_Age_Seconds_V_13 "Validator for object age";
CM_ SG_ 154 OBJ_Width_13 "The width of the target vehicle in the world (not to be mistaken with the width of the visible part of the vehicle).";
CM_ SG_ 154 OBJ_Width_V_13 "Validator for object width";
CM_ SG_ 154 OBJ_Width_STD_13 "Standard deviation for object width";
CM_ SG_ 154 OBJ_Width_STD_V_13 "Validator for the standard deviation of object width";
CM_ SG_ 154 OBJ_Length_13 "The length of the vehicle in the world. For crossing bicycles it gives the viewed length of the bicycle.";
CM_ SG_ 154 OBJ_Length_V_13 "Validator for object length.";
CM_ SG_ 154 OBJ_Length_STD_13 "Standard deviation for object length.";
CM_ SG_ 154 OBJ_Length_STD_V_13 "Validator for the standard deviation of object length.";
CM_ SG_ 154 OBJ_Height_13 "The height of the object in the world. ";
CM_ SG_ 154 OBJ_Height_V_13 "Validator for object height.";
CM_ SG_ 154 OBJ_Height_STD_13 "Standard deviation for object height.";
CM_ SG_ 154 OBJ_Height_STD_V_13 "Validator for the standard deviation of object height.";
CM_ SG_ 154 OBJ_Abs_Long_Velocity_13 "Absolute longitudinal velocity.";
CM_ SG_ 154 OBJ_Abs_Long_Velocity_V_13 "Validator for absolute longitudinal velocity.";
CM_ SG_ 154 OBJ_Abs_Long_Velocity_STD_13 "Standard deviation of absolute longitudinal velocity.";
CM_ SG_ 154 OBJ_Abs_Long_Vel_STD_V_13 "Validator for the standard deviation of the absolute longitudinal velocity.";
CM_ SG_ 154 OBJ_Abs_Lat_Velocity_13 "The lateral ground speed of the object.";
CM_ SG_ 154 OBJ_Abs_Lat_Velocity_V_13 "Validator for the lateral ground speed of the object.";
CM_ SG_ 154 OBJ_Abs_Lat_Velocity_STD_13 "STD of the lateral ground speed of the object.";
CM_ SG_ 154 OBJ_Abs_Lat_Vel_STD_V_13 "Validator for the STD of the lateral ground speed of the object.";
CM_ SG_ 154 OBJ_Abs_Long_Acc_13 "The longitudinal ground acceleration of the object.";
CM_ SG_ 154 OBJ_Abs_Long_Acc_V_13 "Validator for the longitudinal ground acceleration of the object.";
CM_ SG_ 154 OBJ_Abs_Long_Acc_STD_13 "STD of the longitudinal ground acceleration of the object.";
CM_ SG_ 154 OBJ_Abs_Long_Acc_STD_V_13 "Validator for the STD of the longitudinal ground acceleration of the object.";
BA_DEF_ SG_  "GenSigStartValue" INT 0 0;
BA_DEF_DEF_  "GenSigStartValue" 0;
BA_ "GenSigStartValue" SG_ 154 OBJ_Width_7 40;
BA_ "GenSigStartValue" SG_ 154 OBJ_Length_7 24;
BA_ "GenSigStartValue" SG_ 154 OBJ_Width_8 40;
BA_ "GenSigStartValue" SG_ 154 OBJ_Length_8 24;
BA_ "GenSigStartValue" SG_ 154 OBJ_Width_9 40;
BA_ "GenSigStartValue" SG_ 154 OBJ_Length_9 24;
BA_ "GenSigStartValue" SG_ 154 OBJ_Width_10 40;
BA_ "GenSigStartValue" SG_ 154 OBJ_Length_10 24;
BA_ "GenSigStartValue" SG_ 154 OBJ_Width_11 40;
BA_ "GenSigStartValue" SG_ 154 OBJ_Length_11 24;
BA_ "GenSigStartValue" SG_ 154 OBJ_Width_12 40;
BA_ "GenSigStartValue" SG_ 154 OBJ_Length_12 24;
BA_ "GenSigStartValue" SG_ 154 OBJ_Width_13 40;
BA_ "GenSigStartValue" SG_ 154 OBJ_Length_13 24;
VAL_ 154 OBJ_Absolute_Speed_STD_V_6 1 "VALID" 0 "INVALID" ;
VAL_ 154 OBJ_Heading_V_6 1 "VALID" 0 "INVALID" ;
VAL_ 154 OBJ_Heading_STD_V_6 1 "VALID" 0 "INVALID" ;
VAL_ 154 OBJ_Angle_Rate_STD_V_6 1 "VALID" 0 "INVALID" ;
VAL_ 154 OBJ_Angle_Rate_V_6 1 "VALID" 0 "INVALID" ;
VAL_ 154 OBJ_Angle_Right_V_6 1 "VALID" 0 "INVALID" ;
VAL_ 154 OBJ_Angle_Right_STD_V_6 1 "VALID" 0 "INVALID" ;
VAL_ 154 OBJ_Angle_Left_V_6 1 "VALID" 0 "INVALID" ;
VAL_ 154 OBJ_Angle_Left_STD_V_6 1 "VALID" 0 "INVALID" ;
VAL_ 154 OBJ_Angle_Side_V_6 1 "VALID" 0 "INVALID" ;
VAL_ 154 OBJ_Angle_Side_STD_V_6 1 "VALID" 0 "INVALID" ;
VAL_ 154 OBJ_Angle_Mid_V_6 1 "VALID" 0 "INVALID" ;
VAL_ 154 OBJ_Angle_Mid_STD_V_6 1 "VALID" 0 "INVALID" ;
VAL_ 154 OBJ_Angle_Bottom_V_6 1 "VALID" 0 "INVALID" ;
VAL_ 154 OBJ_Angle_Bottom_STD_V_6 1 "VALID" 0 "INVALID" ;
VAL_ 154 OBJ_Visibility_Side_V_6 1 "VALID" 0 "INVALID" ;
VAL_ 154 OBJ_Visibility_Side_6 2 "REAR" 1 "FRONT" 0 "NOT_VISIBLE" ;
VAL_ 154 OBJ_Is_In_Drivable_Area_6 1 "TRUE" 0 "FALSE" ;
VAL_ 154 OBJ_Is_In_Drivable_Area_V_6 1 "VALID" 0 "INVALID" ;
VAL_ 154 OBJ_Is_VeryClose_6 1 "TRUE" 0 "FALSE" ;
VAL_ 154 OBJ_Is_VeryClose_V_6 1 "VALID" 0 "INVALID" ;
VAL_ 154 OBJ_Occlusion_RL_6 2 "OCCLUDED" 1 "NOT_OCCLUDED" 0 "NOT_RELEVANT" ;
VAL_ 154 OBJ_Occlusion_RR_6 2 "OCCLUDED" 1 "NOT_OCCLUDED" 0 "NOT_RELEVANT" ;
VAL_ 154 OBJ_Occlusion_FR_6 2 "OCCLUDED" 1 "NOT_OCCLUDED" 0 "NOT_RELEVANT" ;
VAL_ 154 OBJ_Occlusion_FL_6 2 "OCCLUDED" 1 "NOT_OCCLUDED" 0 "NOT_RELEVANT" ;
VAL_ 154 OBJ_Triggered_SDM_7 2 "NOT_TRIGGERED" 1 "TRIGGERED" 0 "NOT_AVAILABLE" ;
VAL_ 154 OBJ_Motion_Category_7 13 "ONCOMING" 12 "PRECEEDING" 11 "MOVING" 10 "RTAP" 9 "LTAP" 8 "CROSSING" 7 "MOVING_OUT" 6 "MOVING_IN" 5 "CLOSE_CUT_IN" 4 "PASSING_OUT" 3 "PASSING_IN" 2 "PASSING" 1 "UNDEFINED" 0 "UNFILLED" ;
VAL_ 154 OBJ_Measuring_Status_7 2 "(BIT_2)NOT_VALID_OR_VALID" 1 "(BIT_1)PREDICTED_OR_MEASURED" 0 "(BIT_0)OLD_OR_NEW" ;
VAL_ 154 OBJ_Object_Class_7 8 "UNCERTAIN_VCL" 7 "ANIMAL" 6 "GENERAL_OBJECT" 5 "PEDESTRIAN" 4 "BICYCLE" 3 "MOTORBIKE" 2 "TRUCK" 1 "CAR" 0 "UNFILLED" ;
VAL_ 154 OBJ_Camera_Source_7 11 "PARKING_RIGHT" 10 "PARKING_LEFT" 9 "PARKING_REAR" 8 "PARKING_FRONT" 7 "FRONT_CORNER_RIGHT" 6 "FRONT_CORNER_LEFT" 5 "REAR_CORNER_RIGHT" 4 "REAR_CORNER_LEFT" 3 "REAR" 2 "FRONT_FISHEYE" 1 "FRONT_NARROW" 0 "FRONT_MAIN" ;
VAL_ 154 OBJ_Motion_Status_7 5 "MOVING_SLOWLY" 4 "STOPPED" 3 "STATIONARY" 2 "MOVING" 1 "UNKNOWN" 0 "INVALID" ;
VAL_ 154 OBJ_Motion_Orientation_7 13 "UNKNOWN" 12 "PRECEEDING" 11 "DRIFTING_LEFT" 9 "CROSSING_LEFT" 7 "OC_DRIFTING_LEFT" 6 "ONCOMING" 5 "OC_DRIFTING_RIGHT" 3 "CROSSING_RIGHT" 1 "DRIFTING_RIGHT" 0 "INVALID" ;
VAL_ 154 OBJ_Has_Cut_Lane_7 1 "TRUE" 0 "FALSE" ;
VAL_ 154 OBJ_Has_Cut_Path_7 1 "TRUE" 0 "FALSE" ;
VAL_ 154 OBJ_Brake_Light_7 1 "TRUE" 0 "FALSE" ;
VAL_ 154 OBJ_Turn_Indicator_Right_7 1 "TRUE" 0 "FALSE" ;
VAL_ 154 OBJ_Turn_Indicator_Left_7 1 "TRUE" 0 "FALSE" ;
VAL_ 154 OBJ_Light_Indicator_Validity_7 1 "TRUE" 0 "FALSE" ;
VAL_ 154 OBJ_Right_Out_Of_Image_7 1 "TRUE" 0 "FALSE" ;
VAL_ 154 OBJ_Left_Out_Of_Image_7 1 "TRUE" 0 "FALSE" ;
VAL_ 154 OBJ_Right_Out_Of_Image_V_7 1 "TRUE" 0 "FALSE" ;
VAL_ 154 OBJ_Left_Out_Of_Image_V_7 1 "TRUE" 0 "FALSE" ;
VAL_ 154 OBJ_Top_Out_Of_Image_7 1 "TRUE" 0 "FALSE" ;
VAL_ 154 OBJ_Bottom_Out_Of_Image_7 1 "TRUE" 0 "FALSE" ;
VAL_ 154 OBJ_Top_Out_Of_Image_V_7 1 "VALID" 0 "INVALID" ;
VAL_ 154 OBJ_Bottom_Out_Of_Image_V_7 1 "VALID" 0 "INVALID" ;
VAL_ 154 OBJ_Lane_Assignment_7 5 "RIGHT_RIGHT" 4 "RIGHT" 3 "HOST" 2 "LEFT" 1 "LEFT_LEFT" 0 "UNKNOWN" ;
VAL_ 154 OBJ_Lane_Assignment_V_7 1 "VALID" 0 "INVALID" ;
VAL_ 154 OBJ_Age_Seconds_V_7 1 "VALID" 0 "INVALID" ;
VAL_ 154 OBJ_Width_V_7 1 "VALID" 0 "INVALID" ;
VAL_ 154 OBJ_Width_STD_V_7 1 "VALID" 0 "INVALID" ;
VAL_ 154 OBJ_Length_V_7 1 "VALID" 0 "INVALID" ;
VAL_ 154 OBJ_Length_STD_V_7 1 "VALID" 0 "INVALID" ;
VAL_ 154 OBJ_Height_V_7 1 "VALID" 0 "INVALID" ;
VAL_ 154 OBJ_Height_STD_V_7 1 "VALID" 0 "INVALID" ;
VAL_ 154 OBJ_Abs_Long_Velocity_V_7 1 "VALID" 0 "INVALID" ;
VAL_ 154 OBJ_Abs_Long_Vel_STD_V_7 1 "VALID" 0 "INVALID" ;
VAL_ 154 OBJ_Abs_Lat_Velocity_V_7 1 "VALID" 0 "INVALID" ;
VAL_ 154 OBJ_Abs_Lat_Vel_STD_V_7 1 "VALID" 0 "INVALID" ;
VAL_ 154 OBJ_Abs_Long_Acc_V_7 1 "VALID" 0 "INVALID" ;
VAL_ 154 OBJ_Abs_Long_Acc_STD_V_7 1 "VALID" 0 "INVALID" ;
VAL_ 154 OBJ_Abs_Lat_Acc_V_7 1 "VALID" 0 "INVALID" ;
VAL_ 154 OBJ_Abs_Lat_Acc_STD_V_7 1 "VALID" 0 "INVALID" ;
VAL_ 154 OBJ_Abs_Acceleration_V_7 1 "VALID" 0 "INVALID" ;
VAL_ 154 OBJ_Abs_Acc_STD_V_7 1 "VALID" 0 "INVALID" ;
VAL_ 154 OBJ_Inv_TTC_V_7 1 "VALID" 0 "INVALID" ;
VAL_ 154 OBJ_Inv_TTC_STD_V_7 1 "VALID" 0 "INVALID" ;
VAL_ 154 OBJ_Relative_Long_Acc_V_7 1 "VALID" 0 "INVALID" ;
VAL_ 154 OBJ_Rel_Long_Acc_STD_V_7 1 "VALID" 0 "INVALID" ;
VAL_ 154 OBJ_Relative_Long_Velocity_V_7 1 "VALID" 0 "INVALID" ;
VAL_ 154 OBJ_Rel_Long_Vel_STD_V_7 1 "VALID" 0 "INVALID" ;
VAL_ 154 OBJ_Relative_Lat_Velocity_V_7 1 "VALID" 0 "INVALID" ;
VAL_ 154 OBJ_Rel_Lat_Vel_STD_V_7 1 "VALID" 0 "INVALID" ;
VAL_ 154 OBJ_Long_Distance_V_7 1 "VALID" 0 "INVALID" ;
VAL_ 154 OBJ_Long_Distance_STD_V_7 1 "VALID" 0 "INVALID" ;
VAL_ 154 OBJ_Lat_Distance_V_7 1 "VALID" 0 "INVALID" ;
VAL_ 154 OBJ_Lat_Distance_STD_V_7 1 "VALID" 0 "INVALID" ;
VAL_ 154 OBJ_Absolute_Speed_V_7 1 "VALID" 0 "INVALID" ;
VAL_ 154 OBJ_Absolute_Speed_STD_V_7 1 "VALID" 0 "INVALID" ;
VAL_ 154 OBJ_Heading_V_7 1 "VALID" 0 "INVALID" ;
VAL_ 154 OBJ_Heading_STD_V_7 1 "VALID" 0 "INVALID" ;
VAL_ 154 OBJ_Angle_Rate_STD_V_7 1 "VALID" 0 "INVALID" ;
VAL_ 154 OBJ_Angle_Rate_V_7 1 "VALID" 0 "INVALID" ;
VAL_ 154 OBJ_Angle_Right_V_7 1 "VALID" 0 "INVALID" ;
VAL_ 154 OBJ_Angle_Right_STD_V_7 1 "VALID" 0 "INVALID" ;
VAL_ 154 OBJ_Angle_Left_V_7 1 "VALID" 0 "INVALID" ;
VAL_ 154 OBJ_Angle_Left_STD_V_7 1 "VALID" 0 "INVALID" ;
VAL_ 154 OBJ_Angle_Side_V_7 1 "VALID" 0 "INVALID" ;
VAL_ 154 OBJ_Angle_Side_STD_V_7 1 "VALID" 0 "INVALID" ;
VAL_ 154 OBJ_Angle_Mid_V_7 1 "VALID" 0 "INVALID" ;
VAL_ 154 OBJ_Angle_Mid_STD_V_7 1 "VALID" 0 "INVALID" ;
VAL_ 154 OBJ_Angle_Bottom_V_7 1 "VALID" 0 "INVALID" ;
VAL_ 154 OBJ_Angle_Bottom_STD_V_7 1 "VALID" 0 "INVALID" ;
VAL_ 154 OBJ_Visibility_Side_V_7 1 "VALID" 0 "INVALID" ;
VAL_ 154 OBJ_Visibility_Side_7 2 "REAR" 1 "FRONT" 0 "NOT_VISIBLE" ;
VAL_ 154 OBJ_Is_In_Drivable_Area_7 1 "TRUE" 0 "FALSE" ;
VAL_ 154 OBJ_Is_In_Drivable_Area_V_7 1 "VALID" 0 "INVALID" ;
VAL_ 154 OBJ_Is_VeryClose_7 1 "TRUE" 0 "FALSE" ;
VAL_ 154 OBJ_Is_VeryClose_V_7 1 "VALID" 0 "INVALID" ;
VAL_ 154 OBJ_Occlusion_RL_7 2 "OCCLUDED" 1 "NOT_OCCLUDED" 0 "NOT_RELEVANT" ;
VAL_ 154 OBJ_Occlusion_RR_7 2 "OCCLUDED" 1 "NOT_OCCLUDED" 0 "NOT_RELEVANT" ;
VAL_ 154 OBJ_Occlusion_FR_7 2 "OCCLUDED" 1 "NOT_OCCLUDED" 0 "NOT_RELEVANT" ;
VAL_ 154 OBJ_Occlusion_FL_7 2 "OCCLUDED" 1 "NOT_OCCLUDED" 0 "NOT_RELEVANT" ;
VAL_ 154 OBJ_Triggered_SDM_8 2 "NOT_TRIGGERED" 1 "TRIGGERED" 0 "NOT_AVAILABLE" ;
VAL_ 154 OBJ_Motion_Category_8 13 "ONCOMING" 12 "PRECEEDING" 11 "MOVING" 10 "RTAP" 9 "LTAP" 8 "CROSSING" 7 "MOVING_OUT" 6 "MOVING_IN" 5 "CLOSE_CUT_IN" 4 "PASSING_OUT" 3 "PASSING_IN" 2 "PASSING" 1 "UNDEFINED" 0 "UNFILLED" ;
VAL_ 154 OBJ_Measuring_Status_8 2 "(BIT_2)NOT_VALID_OR_VALID" 1 "(BIT_1)PREDICTED_OR_MEASURED" 0 "(BIT_0)OLD_OR_NEW" ;
VAL_ 154 OBJ_Object_Class_8 8 "UNCERTAIN_VCL" 7 "ANIMAL" 6 "GENERAL_OBJECT" 5 "PEDESTRIAN" 4 "BICYCLE" 3 "MOTORBIKE" 2 "TRUCK" 1 "CAR" 0 "UNFILLED" ;
VAL_ 154 OBJ_Camera_Source_8 11 "PARKING_RIGHT" 10 "PARKING_LEFT" 9 "PARKING_REAR" 8 "PARKING_FRONT" 7 "FRONT_CORNER_RIGHT" 6 "FRONT_CORNER_LEFT" 5 "REAR_CORNER_RIGHT" 4 "REAR_CORNER_LEFT" 3 "REAR" 2 "FRONT_FISHEYE" 1 "FRONT_NARROW" 0 "FRONT_MAIN" ;
VAL_ 154 OBJ_Motion_Status_8 5 "MOVING_SLOWLY" 4 "STOPPED" 3 "STATIONARY" 2 "MOVING" 1 "UNKNOWN" 0 "INVALID" ;
VAL_ 154 OBJ_Motion_Orientation_8 13 "UNKNOWN" 12 "PRECEEDING" 11 "DRIFTING_LEFT" 9 "CROSSING_LEFT" 7 "OC_DRIFTING_LEFT" 6 "ONCOMING" 5 "OC_DRIFTING_RIGHT" 3 "CROSSING_RIGHT" 1 "DRIFTING_RIGHT" 0 "INVALID" ;
VAL_ 154 OBJ_Has_Cut_Lane_8 1 "TRUE" 0 "FALSE" ;
VAL_ 154 OBJ_Has_Cut_Path_8 1 "TRUE" 0 "FALSE" ;
VAL_ 154 OBJ_Brake_Light_8 1 "TRUE" 0 "FALSE" ;
VAL_ 154 OBJ_Turn_Indicator_Right_8 1 "TRUE" 0 "FALSE" ;
VAL_ 154 OBJ_Turn_Indicator_Left_8 1 "TRUE" 0 "FALSE" ;
VAL_ 154 OBJ_Light_Indicator_Validity_8 1 "TRUE" 0 "FALSE" ;
VAL_ 154 OBJ_Right_Out_Of_Image_8 1 "TRUE" 0 "FALSE" ;
VAL_ 154 OBJ_Left_Out_Of_Image_8 1 "TRUE" 0 "FALSE" ;
VAL_ 154 OBJ_Right_Out_Of_Image_V_8 1 "TRUE" 0 "FALSE" ;
VAL_ 154 OBJ_Left_Out_Of_Image_V_8 1 "TRUE" 0 "FALSE" ;
VAL_ 154 OBJ_Top_Out_Of_Image_8 1 "TRUE" 0 "FALSE" ;
VAL_ 154 OBJ_Bottom_Out_Of_Image_8 1 "TRUE" 0 "FALSE" ;
VAL_ 154 OBJ_Top_Out_Of_Image_V_8 1 "VALID" 0 "INVALID" ;
VAL_ 154 OBJ_Bottom_Out_Of_Image_V_8 1 "VALID" 0 "INVALID" ;
VAL_ 154 OBJ_Lane_Assignment_8 5 "RIGHT_RIGHT" 4 "RIGHT" 3 "HOST" 2 "LEFT" 1 "LEFT_LEFT" 0 "UNKNOWN" ;
VAL_ 154 OBJ_Lane_Assignment_V_8 1 "VALID" 0 "INVALID" ;
VAL_ 154 OBJ_Age_Seconds_V_8 1 "VALID" 0 "INVALID" ;
VAL_ 154 OBJ_Width_V_8 1 "VALID" 0 "INVALID" ;
VAL_ 154 OBJ_Width_STD_V_8 1 "VALID" 0 "INVALID" ;
VAL_ 154 OBJ_Length_V_8 1 "VALID" 0 "INVALID" ;
VAL_ 154 OBJ_Length_STD_V_8 1 "VALID" 0 "INVALID" ;
VAL_ 154 OBJ_Height_V_8 1 "VALID" 0 "INVALID" ;
VAL_ 154 OBJ_Height_STD_V_8 1 "VALID" 0 "INVALID" ;
VAL_ 154 OBJ_Abs_Long_Velocity_V_8 1 "VALID" 0 "INVALID" ;
VAL_ 154 OBJ_Abs_Long_Vel_STD_V_8 1 "VALID" 0 "INVALID" ;
VAL_ 154 OBJ_Abs_Lat_Velocity_V_8 1 "VALID" 0 "INVALID" ;
VAL_ 154 OBJ_Abs_Lat_Vel_STD_V_8 1 "VALID" 0 "INVALID" ;
VAL_ 154 OBJ_Abs_Long_Acc_V_8 1 "VALID" 0 "INVALID" ;
VAL_ 154 OBJ_Abs_Long_Acc_STD_V_8 1 "VALID" 0 "INVALID" ;
VAL_ 154 OBJ_Abs_Lat_Acc_V_8 1 "VALID" 0 "INVALID" ;
VAL_ 154 OBJ_Abs_Lat_Acc_STD_V_8 1 "VALID" 0 "INVALID" ;
VAL_ 154 OBJ_Abs_Acceleration_V_8 1 "VALID" 0 "INVALID" ;
VAL_ 154 OBJ_Abs_Acc_STD_V_8 1 "VALID" 0 "INVALID" ;
VAL_ 154 OBJ_Inv_TTC_V_8 1 "VALID" 0 "INVALID" ;
VAL_ 154 OBJ_Inv_TTC_STD_V_8 1 "VALID" 0 "INVALID" ;
VAL_ 154 OBJ_Relative_Long_Acc_V_8 1 "VALID" 0 "INVALID" ;
VAL_ 154 OBJ_Rel_Long_Acc_STD_V_8 1 "VALID" 0 "INVALID" ;
VAL_ 154 OBJ_Relative_Long_Velocity_V_8 1 "VALID" 0 "INVALID" ;
VAL_ 154 OBJ_Rel_Long_Vel_STD_V_8 1 "VALID" 0 "INVALID" ;
VAL_ 154 OBJ_Relative_Lat_Velocity_V_8 1 "VALID" 0 "INVALID" ;
VAL_ 154 OBJ_Rel_Lat_Vel_STD_V_8 1 "VALID" 0 "INVALID" ;
VAL_ 154 OBJ_Long_Distance_V_8 1 "VALID" 0 "INVALID" ;
VAL_ 154 OBJ_Long_Distance_STD_V_8 1 "VALID" 0 "INVALID" ;
VAL_ 154 OBJ_Lat_Distance_V_8 1 "VALID" 0 "INVALID" ;
VAL_ 154 OBJ_Lat_Distance_STD_V_8 1 "VALID" 0 "INVALID" ;
VAL_ 154 OBJ_Absolute_Speed_V_8 1 "VALID" 0 "INVALID" ;
VAL_ 154 OBJ_Absolute_Speed_STD_V_8 1 "VALID" 0 "INVALID" ;
VAL_ 154 OBJ_Heading_V_8 1 "VALID" 0 "INVALID" ;
VAL_ 154 OBJ_Heading_STD_V_8 1 "VALID" 0 "INVALID" ;
VAL_ 154 OBJ_Angle_Rate_STD_V_8 1 "VALID" 0 "INVALID" ;
VAL_ 154 OBJ_Angle_Rate_V_8 1 "VALID" 0 "INVALID" ;
VAL_ 154 OBJ_Angle_Right_V_8 1 "VALID" 0 "INVALID" ;
VAL_ 154 OBJ_Angle_Right_STD_V_8 1 "VALID" 0 "INVALID" ;
VAL_ 154 OBJ_Angle_Left_V_8 1 "VALID" 0 "INVALID" ;
VAL_ 154 OBJ_Angle_Left_STD_V_8 1 "VALID" 0 "INVALID" ;
VAL_ 154 OBJ_Angle_Side_V_8 1 "VALID" 0 "INVALID" ;
VAL_ 154 OBJ_Angle_Side_STD_V_8 1 "VALID" 0 "INVALID" ;
VAL_ 154 OBJ_Angle_Mid_V_8 1 "VALID" 0 "INVALID" ;
VAL_ 154 OBJ_Angle_Mid_STD_V_8 1 "VALID" 0 "INVALID" ;
VAL_ 154 OBJ_Angle_Bottom_V_8 1 "VALID" 0 "INVALID" ;
VAL_ 154 OBJ_Angle_Bottom_STD_V_8 1 "VALID" 0 "INVALID" ;
VAL_ 154 OBJ_Visibility_Side_V_8 1 "VALID" 0 "INVALID" ;
VAL_ 154 OBJ_Visibility_Side_8 2 "REAR" 1 "FRONT" 0 "NOT_VISIBLE" ;
VAL_ 154 OBJ_Is_In_Drivable_Area_8 1 "TRUE" 0 "FALSE" ;
VAL_ 154 OBJ_Is_In_Drivable_Area_V_8 1 "VALID" 0 "INVALID" ;
VAL_ 154 OBJ_Is_VeryClose_8 1 "TRUE" 0 "FALSE" ;
VAL_ 154 OBJ_Is_VeryClose_V_8 1 "VALID" 0 "INVALID" ;
VAL_ 154 OBJ_Occlusion_RL_8 2 "OCCLUDED" 1 "NOT_OCCLUDED" 0 "NOT_RELEVANT" ;
VAL_ 154 OBJ_Occlusion_RR_8 2 "OCCLUDED" 1 "NOT_OCCLUDED" 0 "NOT_RELEVANT" ;
VAL_ 154 OBJ_Occlusion_FR_8 2 "OCCLUDED" 1 "NOT_OCCLUDED" 0 "NOT_RELEVANT" ;
VAL_ 154 OBJ_Occlusion_FL_8 2 "OCCLUDED" 1 "NOT_OCCLUDED" 0 "NOT_RELEVANT" ;
VAL_ 154 OBJ_Triggered_SDM_9 2 "NOT_TRIGGERED" 1 "TRIGGERED" 0 "NOT_AVAILABLE" ;
VAL_ 154 OBJ_Motion_Category_9 13 "ONCOMING" 12 "PRECEEDING" 11 "MOVING" 10 "RTAP" 9 "LTAP" 8 "CROSSING" 7 "MOVING_OUT" 6 "MOVING_IN" 5 "CLOSE_CUT_IN" 4 "PASSING_OUT" 3 "PASSING_IN" 2 "PASSING" 1 "UNDEFINED" 0 "UNFILLED" ;
VAL_ 154 OBJ_Measuring_Status_9 2 "(BIT_2)NOT_VALID_OR_VALID" 1 "(BIT_1)PREDICTED_OR_MEASURED" 0 "(BIT_0)OLD_OR_NEW" ;
VAL_ 154 OBJ_Object_Class_9 8 "UNCERTAIN_VCL" 7 "ANIMAL" 6 "GENERAL_OBJECT" 5 "PEDESTRIAN" 4 "BICYCLE" 3 "MOTORBIKE" 2 "TRUCK" 1 "CAR" 0 "UNFILLED" ;
VAL_ 154 OBJ_Camera_Source_9 11 "PARKING_RIGHT" 10 "PARKING_LEFT" 9 "PARKING_REAR" 8 "PARKING_FRONT" 7 "FRONT_CORNER_RIGHT" 6 "FRONT_CORNER_LEFT" 5 "REAR_CORNER_RIGHT" 4 "REAR_CORNER_LEFT" 3 "REAR" 2 "FRONT_FISHEYE" 1 "FRONT_NARROW" 0 "FRONT_MAIN" ;
VAL_ 154 OBJ_Motion_Status_9 5 "MOVING_SLOWLY" 4 "STOPPED" 3 "STATIONARY" 2 "MOVING" 1 "UNKNOWN" 0 "INVALID" ;
VAL_ 154 OBJ_Motion_Orientation_9 13 "UNKNOWN" 12 "PRECEEDING" 11 "DRIFTING_LEFT" 9 "CROSSING_LEFT" 7 "OC_DRIFTING_LEFT" 6 "ONCOMING" 5 "OC_DRIFTING_RIGHT" 3 "CROSSING_RIGHT" 1 "DRIFTING_RIGHT" 0 "INVALID" ;
VAL_ 154 OBJ_Has_Cut_Lane_9 1 "TRUE" 0 "FALSE" ;
VAL_ 154 OBJ_Has_Cut_Path_9 1 "TRUE" 0 "FALSE" ;
VAL_ 154 OBJ_Brake_Light_9 1 "TRUE" 0 "FALSE" ;
VAL_ 154 OBJ_Turn_Indicator_Right_9 1 "TRUE" 0 "FALSE" ;
VAL_ 154 OBJ_Turn_Indicator_Left_9 1 "TRUE" 0 "FALSE" ;
VAL_ 154 OBJ_Light_Indicator_Validity_9 1 "TRUE" 0 "FALSE" ;
VAL_ 154 OBJ_Right_Out_Of_Image_9 1 "TRUE" 0 "FALSE" ;
VAL_ 154 OBJ_Left_Out_Of_Image_9 1 "TRUE" 0 "FALSE" ;
VAL_ 154 OBJ_Right_Out_Of_Image_V_9 1 "TRUE" 0 "FALSE" ;
VAL_ 154 OBJ_Left_Out_Of_Image_V_9 1 "TRUE" 0 "FALSE" ;
VAL_ 154 OBJ_Top_Out_Of_Image_9 1 "TRUE" 0 "FALSE" ;
VAL_ 154 OBJ_Bottom_Out_Of_Image_9 1 "TRUE" 0 "FALSE" ;
VAL_ 154 OBJ_Top_Out_Of_Image_V_9 1 "VALID" 0 "INVALID" ;
VAL_ 154 OBJ_Bottom_Out_Of_Image_V_9 1 "VALID" 0 "INVALID" ;
VAL_ 154 OBJ_Lane_Assignment_9 5 "RIGHT_RIGHT" 4 "RIGHT" 3 "HOST" 2 "LEFT" 1 "LEFT_LEFT" 0 "UNKNOWN" ;
VAL_ 154 OBJ_Lane_Assignment_V_9 1 "VALID" 0 "INVALID" ;
VAL_ 154 OBJ_Age_Seconds_V_9 1 "VALID" 0 "INVALID" ;
VAL_ 154 OBJ_Width_V_9 1 "VALID" 0 "INVALID" ;
VAL_ 154 OBJ_Width_STD_V_9 1 "VALID" 0 "INVALID" ;
VAL_ 154 OBJ_Length_V_9 1 "VALID" 0 "INVALID" ;
VAL_ 154 OBJ_Length_STD_V_9 1 "VALID" 0 "INVALID" ;
VAL_ 154 OBJ_Height_V_9 1 "VALID" 0 "INVALID" ;
VAL_ 154 OBJ_Height_STD_V_9 1 "VALID" 0 "INVALID" ;
VAL_ 154 OBJ_Abs_Long_Velocity_V_9 1 "VALID" 0 "INVALID" ;
VAL_ 154 OBJ_Abs_Long_Vel_STD_V_9 1 "VALID" 0 "INVALID" ;
VAL_ 154 OBJ_Abs_Lat_Velocity_V_9 1 "VALID" 0 "INVALID" ;
VAL_ 154 OBJ_Abs_Lat_Vel_STD_V_9 1 "VALID" 0 "INVALID" ;
VAL_ 154 OBJ_Abs_Long_Acc_V_9 1 "VALID" 0 "INVALID" ;
VAL_ 154 OBJ_Abs_Long_Acc_STD_V_9 1 "VALID" 0 "INVALID" ;
VAL_ 154 OBJ_Abs_Lat_Acc_V_9 1 "VALID" 0 "INVALID" ;
VAL_ 154 OBJ_Abs_Lat_Acc_STD_V_9 1 "VALID" 0 "INVALID" ;
VAL_ 154 OBJ_Abs_Acceleration_V_9 1 "VALID" 0 "INVALID" ;
VAL_ 154 OBJ_Abs_Acc_STD_V_9 1 "VALID" 0 "INVALID" ;
VAL_ 154 OBJ_Inv_TTC_V_9 1 "VALID" 0 "INVALID" ;
VAL_ 154 OBJ_Inv_TTC_STD_V_9 1 "VALID" 0 "INVALID" ;
VAL_ 154 OBJ_Relative_Long_Acc_V_9 1 "VALID" 0 "INVALID" ;
VAL_ 154 OBJ_Rel_Long_Acc_STD_V_9 1 "VALID" 0 "INVALID" ;
VAL_ 154 OBJ_Relative_Long_Velocity_V_9 1 "VALID" 0 "INVALID" ;
VAL_ 154 OBJ_Rel_Long_Vel_STD_V_9 1 "VALID" 0 "INVALID" ;
VAL_ 154 OBJ_Relative_Lat_Velocity_V_9 1 "VALID" 0 "INVALID" ;
VAL_ 154 OBJ_Rel_Lat_Vel_STD_V_9 1 "VALID" 0 "INVALID" ;
VAL_ 154 OBJ_Long_Distance_V_9 1 "VALID" 0 "INVALID" ;
VAL_ 154 OBJ_Long_Distance_STD_V_9 1 "VALID" 0 "INVALID" ;
VAL_ 154 OBJ_Lat_Distance_V_9 1 "VALID" 0 "INVALID" ;
VAL_ 154 OBJ_Lat_Distance_STD_V_9 1 "VALID" 0 "INVALID" ;
VAL_ 154 OBJ_Absolute_Speed_V_9 1 "VALID" 0 "INVALID" ;
VAL_ 154 OBJ_Absolute_Speed_STD_V_9 1 "VALID" 0 "INVALID" ;
VAL_ 154 OBJ_Heading_V_9 1 "VALID" 0 "INVALID" ;
VAL_ 154 OBJ_Heading_STD_V_9 1 "VALID" 0 "INVALID" ;
VAL_ 154 OBJ_Angle_Rate_STD_V_9 1 "VALID" 0 "INVALID" ;
VAL_ 154 OBJ_Angle_Rate_V_9 1 "VALID" 0 "INVALID" ;
VAL_ 154 OBJ_Angle_Right_V_9 1 "VALID" 0 "INVALID" ;
VAL_ 154 OBJ_Angle_Right_STD_V_9 1 "VALID" 0 "INVALID" ;
VAL_ 154 OBJ_Angle_Left_V_9 1 "VALID" 0 "INVALID" ;
VAL_ 154 OBJ_Angle_Left_STD_V_9 1 "VALID" 0 "INVALID" ;
VAL_ 154 OBJ_Angle_Side_V_9 1 "VALID" 0 "INVALID" ;
VAL_ 154 OBJ_Angle_Side_STD_V_9 1 "VALID" 0 "INVALID" ;
VAL_ 154 OBJ_Angle_Mid_V_9 1 "VALID" 0 "INVALID" ;
VAL_ 154 OBJ_Angle_Mid_STD_V_9 1 "VALID" 0 "INVALID" ;
VAL_ 154 OBJ_Angle_Bottom_V_9 1 "VALID" 0 "INVALID" ;
VAL_ 154 OBJ_Angle_Bottom_STD_V_9 1 "VALID" 0 "INVALID" ;
VAL_ 154 OBJ_Visibility_Side_V_9 1 "VALID" 0 "INVALID" ;
VAL_ 154 OBJ_Visibility_Side_9 2 "REAR" 1 "FRONT" 0 "NOT_VISIBLE" ;
VAL_ 154 OBJ_Is_In_Drivable_Area_9 1 "TRUE" 0 "FALSE" ;
VAL_ 154 OBJ_Is_In_Drivable_Area_V_9 1 "VALID" 0 "INVALID" ;
VAL_ 154 OBJ_Is_VeryClose_9 1 "TRUE" 0 "FALSE" ;
VAL_ 154 OBJ_Is_VeryClose_V_9 1 "VALID" 0 "INVALID" ;
VAL_ 154 OBJ_Occlusion_RL_9 2 "OCCLUDED" 1 "NOT_OCCLUDED" 0 "NOT_RELEVANT" ;
VAL_ 154 OBJ_Occlusion_RR_9 2 "OCCLUDED" 1 "NOT_OCCLUDED" 0 "NOT_RELEVANT" ;
VAL_ 154 OBJ_Occlusion_FR_9 2 "OCCLUDED" 1 "NOT_OCCLUDED" 0 "NOT_RELEVANT" ;
VAL_ 154 OBJ_Occlusion_FL_9 2 "OCCLUDED" 1 "NOT_OCCLUDED" 0 "NOT_RELEVANT" ;
VAL_ 154 OBJ_Triggered_SDM_10 2 "NOT_TRIGGERED" 1 "TRIGGERED" 0 "NOT_AVAILABLE" ;
VAL_ 154 OBJ_Motion_Category_10 13 "ONCOMING" 12 "PRECEEDING" 11 "MOVING" 10 "RTAP" 9 "LTAP" 8 "CROSSING" 7 "MOVING_OUT" 6 "MOVING_IN" 5 "CLOSE_CUT_IN" 4 "PASSING_OUT" 3 "PASSING_IN" 2 "PASSING" 1 "UNDEFINED" 0 "UNFILLED" ;
VAL_ 154 OBJ_Measuring_Status_10 2 "(BIT_2)NOT_VALID_OR_VALID" 1 "(BIT_1)PREDICTED_OR_MEASURED" 0 "(BIT_0)OLD_OR_NEW" ;
VAL_ 154 OBJ_Object_Class_10 8 "UNCERTAIN_VCL" 7 "ANIMAL" 6 "GENERAL_OBJECT" 5 "PEDESTRIAN" 4 "BICYCLE" 3 "MOTORBIKE" 2 "TRUCK" 1 "CAR" 0 "UNFILLED" ;
VAL_ 154 OBJ_Camera_Source_10 11 "PARKING_RIGHT" 10 "PARKING_LEFT" 9 "PARKING_REAR" 8 "PARKING_FRONT" 7 "FRONT_CORNER_RIGHT" 6 "FRONT_CORNER_LEFT" 5 "REAR_CORNER_RIGHT" 4 "REAR_CORNER_LEFT" 3 "REAR" 2 "FRONT_FISHEYE" 1 "FRONT_NARROW" 0 "FRONT_MAIN" ;
VAL_ 154 OBJ_Motion_Status_10 5 "MOVING_SLOWLY" 4 "STOPPED" 3 "STATIONARY" 2 "MOVING" 1 "UNKNOWN" 0 "INVALID" ;
VAL_ 154 OBJ_Motion_Orientation_10 13 "UNKNOWN" 12 "PRECEEDING" 11 "DRIFTING_LEFT" 9 "CROSSING_LEFT" 7 "OC_DRIFTING_LEFT" 6 "ONCOMING" 5 "OC_DRIFTING_RIGHT" 3 "CROSSING_RIGHT" 1 "DRIFTING_RIGHT" 0 "INVALID" ;
VAL_ 154 OBJ_Has_Cut_Lane_10 1 "TRUE" 0 "FALSE" ;
VAL_ 154 OBJ_Has_Cut_Path_10 1 "TRUE" 0 "FALSE" ;
VAL_ 154 OBJ_Brake_Light_10 1 "TRUE" 0 "FALSE" ;
VAL_ 154 OBJ_Turn_Indicator_Right_10 1 "TRUE" 0 "FALSE" ;
VAL_ 154 OBJ_Turn_Indicator_Left_10 1 "TRUE" 0 "FALSE" ;
VAL_ 154 OBJ_Light_Indicator_Validity_10 1 "TRUE" 0 "FALSE" ;
VAL_ 154 OBJ_Right_Out_Of_Image_10 1 "TRUE" 0 "FALSE" ;
VAL_ 154 OBJ_Left_Out_Of_Image_10 1 "TRUE" 0 "FALSE" ;
VAL_ 154 OBJ_Right_Out_Of_Image_V_10 1 "TRUE" 0 "FALSE" ;
VAL_ 154 OBJ_Left_Out_Of_Image_V_10 1 "TRUE" 0 "FALSE" ;
VAL_ 154 OBJ_Top_Out_Of_Image_10 1 "TRUE" 0 "FALSE" ;
VAL_ 154 OBJ_Bottom_Out_Of_Image_10 1 "TRUE" 0 "FALSE" ;
VAL_ 154 OBJ_Top_Out_Of_Image_V_10 1 "VALID" 0 "INVALID" ;
VAL_ 154 OBJ_Bottom_Out_Of_Image_V_10 1 "VALID" 0 "INVALID" ;
VAL_ 154 OBJ_Lane_Assignment_10 5 "RIGHT_RIGHT" 4 "RIGHT" 3 "HOST" 2 "LEFT" 1 "LEFT_LEFT" 0 "UNKNOWN" ;
VAL_ 154 OBJ_Lane_Assignment_V_10 1 "VALID" 0 "INVALID" ;
VAL_ 154 OBJ_Age_Seconds_V_10 1 "VALID" 0 "INVALID" ;
VAL_ 154 OBJ_Width_V_10 1 "VALID" 0 "INVALID" ;
VAL_ 154 OBJ_Width_STD_V_10 1 "VALID" 0 "INVALID" ;
VAL_ 154 OBJ_Length_V_10 1 "VALID" 0 "INVALID" ;
VAL_ 154 OBJ_Length_STD_V_10 1 "VALID" 0 "INVALID" ;
VAL_ 154 OBJ_Height_V_10 1 "VALID" 0 "INVALID" ;
VAL_ 154 OBJ_Height_STD_V_10 1 "VALID" 0 "INVALID" ;
VAL_ 154 OBJ_Abs_Long_Velocity_V_10 1 "VALID" 0 "INVALID" ;
VAL_ 154 OBJ_Abs_Long_Vel_STD_V_10 1 "VALID" 0 "INVALID" ;
VAL_ 154 OBJ_Abs_Lat_Velocity_V_10 1 "VALID" 0 "INVALID" ;
VAL_ 154 OBJ_Abs_Lat_Vel_STD_V_10 1 "VALID" 0 "INVALID" ;
VAL_ 154 OBJ_Abs_Long_Acc_V_10 1 "VALID" 0 "INVALID" ;
VAL_ 154 OBJ_Abs_Long_Acc_STD_V_10 1 "VALID" 0 "INVALID" ;
VAL_ 154 OBJ_Abs_Lat_Acc_V_10 1 "VALID" 0 "INVALID" ;
VAL_ 154 OBJ_Abs_Lat_Acc_STD_V_10 1 "VALID" 0 "INVALID" ;
VAL_ 154 OBJ_Abs_Acceleration_V_10 1 "VALID" 0 "INVALID" ;
VAL_ 154 OBJ_Abs_Acc_STD_V_10 1 "VALID" 0 "INVALID" ;
VAL_ 154 OBJ_Inv_TTC_V_10 1 "VALID" 0 "INVALID" ;
VAL_ 154 OBJ_Inv_TTC_STD_V_10 1 "VALID" 0 "INVALID" ;
VAL_ 154 OBJ_Relative_Long_Acc_V_10 1 "VALID" 0 "INVALID" ;
VAL_ 154 OBJ_Rel_Long_Acc_STD_V_10 1 "VALID" 0 "INVALID" ;
VAL_ 154 OBJ_Relative_Long_Velocity_V_10 1 "VALID" 0 "INVALID" ;
VAL_ 154 OBJ_Rel_Long_Vel_STD_V_10 1 "VALID" 0 "INVALID" ;
VAL_ 154 OBJ_Relative_Lat_Velocity_V_10 1 "VALID" 0 "INVALID" ;
VAL_ 154 OBJ_Rel_Lat_Vel_STD_V_10 1 "VALID" 0 "INVALID" ;
VAL_ 154 OBJ_Long_Distance_V_10 1 "VALID" 0 "INVALID" ;
VAL_ 154 OBJ_Long_Distance_STD_V_10 1 "VALID" 0 "INVALID" ;
VAL_ 154 OBJ_Lat_Distance_V_10 1 "VALID" 0 "INVALID" ;
VAL_ 154 OBJ_Lat_Distance_STD_V_10 1 "VALID" 0 "INVALID" ;
VAL_ 154 OBJ_Absolute_Speed_V_10 1 "VALID" 0 "INVALID" ;
VAL_ 154 OBJ_Absolute_Speed_STD_V_10 1 "VALID" 0 "INVALID" ;
VAL_ 154 OBJ_Heading_V_10 1 "VALID" 0 "INVALID" ;
VAL_ 154 OBJ_Heading_STD_V_10 1 "VALID" 0 "INVALID" ;
VAL_ 154 OBJ_Angle_Rate_STD_V_10 1 "VALID" 0 "INVALID" ;
VAL_ 154 OBJ_Angle_Rate_V_10 1 "VALID" 0 "INVALID" ;
VAL_ 154 OBJ_Angle_Right_V_10 1 "VALID" 0 "INVALID" ;
VAL_ 154 OBJ_Angle_Right_STD_V_10 1 "VALID" 0 "INVALID" ;
VAL_ 154 OBJ_Angle_Left_V_10 1 "VALID" 0 "INVALID" ;
VAL_ 154 OBJ_Angle_Left_STD_V_10 1 "VALID" 0 "INVALID" ;
VAL_ 154 OBJ_Angle_Side_V_10 1 "VALID" 0 "INVALID" ;
VAL_ 154 OBJ_Angle_Side_STD_V_10 1 "VALID" 0 "INVALID" ;
VAL_ 154 OBJ_Angle_Mid_V_10 1 "VALID" 0 "INVALID" ;
VAL_ 154 OBJ_Angle_Mid_STD_V_10 1 "VALID" 0 "INVALID" ;
VAL_ 154 OBJ_Angle_Bottom_V_10 1 "VALID" 0 "INVALID" ;
VAL_ 154 OBJ_Angle_Bottom_STD_V_10 1 "VALID" 0 "INVALID" ;
VAL_ 154 OBJ_Visibility_Side_V_10 1 "VALID" 0 "INVALID" ;
VAL_ 154 OBJ_Visibility_Side_10 2 "REAR" 1 "FRONT" 0 "NOT_VISIBLE" ;
VAL_ 154 OBJ_Is_In_Drivable_Area_10 1 "TRUE" 0 "FALSE" ;
VAL_ 154 OBJ_Is_In_Drivable_Area_V_10 1 "VALID" 0 "INVALID" ;
VAL_ 154 OBJ_Is_VeryClose_10 1 "TRUE" 0 "FALSE" ;
VAL_ 154 OBJ_Is_VeryClose_V_10 1 "VALID" 0 "INVALID" ;
VAL_ 154 OBJ_Occlusion_RL_10 2 "OCCLUDED" 1 "NOT_OCCLUDED" 0 "NOT_RELEVANT" ;
VAL_ 154 OBJ_Occlusion_RR_10 2 "OCCLUDED" 1 "NOT_OCCLUDED" 0 "NOT_RELEVANT" ;
VAL_ 154 OBJ_Occlusion_FR_10 2 "OCCLUDED" 1 "NOT_OCCLUDED" 0 "NOT_RELEVANT" ;
VAL_ 154 OBJ_Occlusion_FL_10 2 "OCCLUDED" 1 "NOT_OCCLUDED" 0 "NOT_RELEVANT" ;
VAL_ 154 OBJ_Triggered_SDM_11 2 "NOT_TRIGGERED" 1 "TRIGGERED" 0 "NOT_AVAILABLE" ;
VAL_ 154 OBJ_Motion_Category_11 13 "ONCOMING" 12 "PRECEEDING" 11 "MOVING" 10 "RTAP" 9 "LTAP" 8 "CROSSING" 7 "MOVING_OUT" 6 "MOVING_IN" 5 "CLOSE_CUT_IN" 4 "PASSING_OUT" 3 "PASSING_IN" 2 "PASSING" 1 "UNDEFINED" 0 "UNFILLED" ;
VAL_ 154 OBJ_Measuring_Status_11 2 "(BIT_2)NOT_VALID_OR_VALID" 1 "(BIT_1)PREDICTED_OR_MEASURED" 0 "(BIT_0)OLD_OR_NEW" ;
VAL_ 154 OBJ_Object_Class_11 8 "UNCERTAIN_VCL" 7 "ANIMAL" 6 "GENERAL_OBJECT" 5 "PEDESTRIAN" 4 "BICYCLE" 3 "MOTORBIKE" 2 "TRUCK" 1 "CAR" 0 "UNFILLED" ;
VAL_ 154 OBJ_Camera_Source_11 11 "PARKING_RIGHT" 10 "PARKING_LEFT" 9 "PARKING_REAR" 8 "PARKING_FRONT" 7 "FRONT_CORNER_RIGHT" 6 "FRONT_CORNER_LEFT" 5 "REAR_CORNER_RIGHT" 4 "REAR_CORNER_LEFT" 3 "REAR" 2 "FRONT_FISHEYE" 1 "FRONT_NARROW" 0 "FRONT_MAIN" ;
VAL_ 154 OBJ_Motion_Status_11 5 "MOVING_SLOWLY" 4 "STOPPED" 3 "STATIONARY" 2 "MOVING" 1 "UNKNOWN" 0 "INVALID" ;
VAL_ 154 OBJ_Motion_Orientation_11 13 "UNKNOWN" 12 "PRECEEDING" 11 "DRIFTING_LEFT" 9 "CROSSING_LEFT" 7 "OC_DRIFTING_LEFT" 6 "ONCOMING" 5 "OC_DRIFTING_RIGHT" 3 "CROSSING_RIGHT" 1 "DRIFTING_RIGHT" 0 "INVALID" ;
VAL_ 154 OBJ_Has_Cut_Lane_11 1 "TRUE" 0 "FALSE" ;
VAL_ 154 OBJ_Has_Cut_Path_11 1 "TRUE" 0 "FALSE" ;
VAL_ 154 OBJ_Brake_Light_11 1 "TRUE" 0 "FALSE" ;
VAL_ 154 OBJ_Turn_Indicator_Right_11 1 "TRUE" 0 "FALSE" ;
VAL_ 154 OBJ_Turn_Indicator_Left_11 1 "TRUE" 0 "FALSE" ;
VAL_ 154 OBJ_Light_Indicator_Validity_11 1 "TRUE" 0 "FALSE" ;
VAL_ 154 OBJ_Right_Out_Of_Image_11 1 "TRUE" 0 "FALSE" ;
VAL_ 154 OBJ_Left_Out_Of_Image_11 1 "TRUE" 0 "FALSE" ;
VAL_ 154 OBJ_Right_Out_Of_Image_V_11 1 "TRUE" 0 "FALSE" ;
VAL_ 154 OBJ_Left_Out_Of_Image_V_11 1 "TRUE" 0 "FALSE" ;
VAL_ 154 OBJ_Top_Out_Of_Image_11 1 "TRUE" 0 "FALSE" ;
VAL_ 154 OBJ_Bottom_Out_Of_Image_11 1 "TRUE" 0 "FALSE" ;
VAL_ 154 OBJ_Top_Out_Of_Image_V_11 1 "VALID" 0 "INVALID" ;
VAL_ 154 OBJ_Bottom_Out_Of_Image_V_11 1 "VALID" 0 "INVALID" ;
VAL_ 154 OBJ_Lane_Assignment_11 5 "RIGHT_RIGHT" 4 "RIGHT" 3 "HOST" 2 "LEFT" 1 "LEFT_LEFT" 0 "UNKNOWN" ;
VAL_ 154 OBJ_Lane_Assignment_V_11 1 "VALID" 0 "INVALID" ;
VAL_ 154 OBJ_Age_Seconds_V_11 1 "VALID" 0 "INVALID" ;
VAL_ 154 OBJ_Width_V_11 1 "VALID" 0 "INVALID" ;
VAL_ 154 OBJ_Width_STD_V_11 1 "VALID" 0 "INVALID" ;
VAL_ 154 OBJ_Length_V_11 1 "VALID" 0 "INVALID" ;
VAL_ 154 OBJ_Length_STD_V_11 1 "VALID" 0 "INVALID" ;
VAL_ 154 OBJ_Height_V_11 1 "VALID" 0 "INVALID" ;
VAL_ 154 OBJ_Height_STD_V_11 1 "VALID" 0 "INVALID" ;
VAL_ 154 OBJ_Abs_Long_Velocity_V_11 1 "VALID" 0 "INVALID" ;
VAL_ 154 OBJ_Abs_Long_Vel_STD_V_11 1 "VALID" 0 "INVALID" ;
VAL_ 154 OBJ_Abs_Lat_Velocity_V_11 1 "VALID" 0 "INVALID" ;
VAL_ 154 OBJ_Abs_Lat_Vel_STD_V_11 1 "VALID" 0 "INVALID" ;
VAL_ 154 OBJ_Abs_Long_Acc_V_11 1 "VALID" 0 "INVALID" ;
VAL_ 154 OBJ_Abs_Long_Acc_STD_V_11 1 "VALID" 0 "INVALID" ;
VAL_ 154 OBJ_Abs_Lat_Acc_V_11 1 "VALID" 0 "INVALID" ;
VAL_ 154 OBJ_Abs_Lat_Acc_STD_V_11 1 "VALID" 0 "INVALID" ;
VAL_ 154 OBJ_Abs_Acceleration_V_11 1 "VALID" 0 "INVALID" ;
VAL_ 154 OBJ_Abs_Acc_STD_V_11 1 "VALID" 0 "INVALID" ;
VAL_ 154 OBJ_Inv_TTC_V_11 1 "VALID" 0 "INVALID" ;
VAL_ 154 OBJ_Inv_TTC_STD_V_11 1 "VALID" 0 "INVALID" ;
VAL_ 154 OBJ_Relative_Long_Acc_V_11 1 "VALID" 0 "INVALID" ;
VAL_ 154 OBJ_Rel_Long_Acc_STD_V_11 1 "VALID" 0 "INVALID" ;
VAL_ 154 OBJ_Relative_Long_Velocity_V_11 1 "VALID" 0 "INVALID" ;
VAL_ 154 OBJ_Rel_Long_Vel_STD_V_11 1 "VALID" 0 "INVALID" ;
VAL_ 154 OBJ_Relative_Lat_Velocity_V_11 1 "VALID" 0 "INVALID" ;
VAL_ 154 OBJ_Rel_Lat_Vel_STD_V_11 1 "VALID" 0 "INVALID" ;
VAL_ 154 OBJ_Long_Distance_V_11 1 "VALID" 0 "INVALID" ;
VAL_ 154 OBJ_Long_Distance_STD_V_11 1 "VALID" 0 "INVALID" ;
VAL_ 154 OBJ_Lat_Distance_V_11 1 "VALID" 0 "INVALID" ;
VAL_ 154 OBJ_Lat_Distance_STD_V_11 1 "VALID" 0 "INVALID" ;
VAL_ 154 OBJ_Absolute_Speed_V_11 1 "VALID" 0 "INVALID" ;
VAL_ 154 OBJ_Absolute_Speed_STD_V_11 1 "VALID" 0 "INVALID" ;
VAL_ 154 OBJ_Heading_V_11 1 "VALID" 0 "INVALID" ;
VAL_ 154 OBJ_Heading_STD_V_11 1 "VALID" 0 "INVALID" ;
VAL_ 154 OBJ_Angle_Rate_STD_V_11 1 "VALID" 0 "INVALID" ;
VAL_ 154 OBJ_Angle_Rate_V_11 1 "VALID" 0 "INVALID" ;
VAL_ 154 OBJ_Angle_Right_V_11 1 "VALID" 0 "INVALID" ;
VAL_ 154 OBJ_Angle_Right_STD_V_11 1 "VALID" 0 "INVALID" ;
VAL_ 154 OBJ_Angle_Left_V_11 1 "VALID" 0 "INVALID" ;
VAL_ 154 OBJ_Angle_Left_STD_V_11 1 "VALID" 0 "INVALID" ;
VAL_ 154 OBJ_Angle_Side_V_11 1 "VALID" 0 "INVALID" ;
VAL_ 154 OBJ_Angle_Side_STD_V_11 1 "VALID" 0 "INVALID" ;
VAL_ 154 OBJ_Angle_Mid_V_11 1 "VALID" 0 "INVALID" ;
VAL_ 154 OBJ_Angle_Mid_STD_V_11 1 "VALID" 0 "INVALID" ;
VAL_ 154 OBJ_Angle_Bottom_V_11 1 "VALID" 0 "INVALID" ;
VAL_ 154 OBJ_Angle_Bottom_STD_V_11 1 "VALID" 0 "INVALID" ;
VAL_ 154 OBJ_Visibility_Side_V_11 1 "VALID" 0 "INVALID" ;
VAL_ 154 OBJ_Visibility_Side_11 2 "REAR" 1 "FRONT" 0 "NOT_VISIBLE" ;
VAL_ 154 OBJ_Is_In_Drivable_Area_11 1 "TRUE" 0 "FALSE" ;
VAL_ 154 OBJ_Is_In_Drivable_Area_V_11 1 "VALID" 0 "INVALID" ;
VAL_ 154 OBJ_Is_VeryClose_11 1 "TRUE" 0 "FALSE" ;
VAL_ 154 OBJ_Is_VeryClose_V_11 1 "VALID" 0 "INVALID" ;
VAL_ 154 OBJ_Occlusion_RL_11 2 "OCCLUDED" 1 "NOT_OCCLUDED" 0 "NOT_RELEVANT" ;
VAL_ 154 OBJ_Occlusion_RR_11 2 "OCCLUDED" 1 "NOT_OCCLUDED" 0 "NOT_RELEVANT" ;
VAL_ 154 OBJ_Occlusion_FR_11 2 "OCCLUDED" 1 "NOT_OCCLUDED" 0 "NOT_RELEVANT" ;
VAL_ 154 OBJ_Occlusion_FL_11 2 "OCCLUDED" 1 "NOT_OCCLUDED" 0 "NOT_RELEVANT" ;
VAL_ 154 OBJ_Triggered_SDM_12 2 "NOT_TRIGGERED" 1 "TRIGGERED" 0 "NOT_AVAILABLE" ;
VAL_ 154 OBJ_Motion_Category_12 13 "ONCOMING" 12 "PRECEEDING" 11 "MOVING" 10 "RTAP" 9 "LTAP" 8 "CROSSING" 7 "MOVING_OUT" 6 "MOVING_IN" 5 "CLOSE_CUT_IN" 4 "PASSING_OUT" 3 "PASSING_IN" 2 "PASSING" 1 "UNDEFINED" 0 "UNFILLED" ;
VAL_ 154 OBJ_Measuring_Status_12 2 "(BIT_2)NOT_VALID_OR_VALID" 1 "(BIT_1)PREDICTED_OR_MEASURED" 0 "(BIT_0)OLD_OR_NEW" ;
VAL_ 154 OBJ_Object_Class_12 8 "UNCERTAIN_VCL" 7 "ANIMAL" 6 "GENERAL_OBJECT" 5 "PEDESTRIAN" 4 "BICYCLE" 3 "MOTORBIKE" 2 "TRUCK" 1 "CAR" 0 "UNFILLED" ;
VAL_ 154 OBJ_Camera_Source_12 11 "PARKING_RIGHT" 10 "PARKING_LEFT" 9 "PARKING_REAR" 8 "PARKING_FRONT" 7 "FRONT_CORNER_RIGHT" 6 "FRONT_CORNER_LEFT" 5 "REAR_CORNER_RIGHT" 4 "REAR_CORNER_LEFT" 3 "REAR" 2 "FRONT_FISHEYE" 1 "FRONT_NARROW" 0 "FRONT_MAIN" ;
VAL_ 154 OBJ_Motion_Status_12 5 "MOVING_SLOWLY" 4 "STOPPED" 3 "STATIONARY" 2 "MOVING" 1 "UNKNOWN" 0 "INVALID" ;
VAL_ 154 OBJ_Motion_Orientation_12 13 "UNKNOWN" 12 "PRECEEDING" 11 "DRIFTING_LEFT" 9 "CROSSING_LEFT" 7 "OC_DRIFTING_LEFT" 6 "ONCOMING" 5 "OC_DRIFTING_RIGHT" 3 "CROSSING_RIGHT" 1 "DRIFTING_RIGHT" 0 "INVALID" ;
VAL_ 154 OBJ_Has_Cut_Lane_12 1 "TRUE" 0 "FALSE" ;
VAL_ 154 OBJ_Has_Cut_Path_12 1 "TRUE" 0 "FALSE" ;
VAL_ 154 OBJ_Brake_Light_12 1 "TRUE" 0 "FALSE" ;
VAL_ 154 OBJ_Turn_Indicator_Right_12 1 "TRUE" 0 "FALSE" ;
VAL_ 154 OBJ_Turn_Indicator_Left_12 1 "TRUE" 0 "FALSE" ;
VAL_ 154 OBJ_Light_Indicator_Validity_12 1 "TRUE" 0 "FALSE" ;
VAL_ 154 OBJ_Right_Out_Of_Image_12 1 "TRUE" 0 "FALSE" ;
VAL_ 154 OBJ_Left_Out_Of_Image_12 1 "TRUE" 0 "FALSE" ;
VAL_ 154 OBJ_Right_Out_Of_Image_V_12 1 "TRUE" 0 "FALSE" ;
VAL_ 154 OBJ_Left_Out_Of_Image_V_12 1 "TRUE" 0 "FALSE" ;
VAL_ 154 OBJ_Top_Out_Of_Image_12 1 "TRUE" 0 "FALSE" ;
VAL_ 154 OBJ_Bottom_Out_Of_Image_12 1 "TRUE" 0 "FALSE" ;
VAL_ 154 OBJ_Top_Out_Of_Image_V_12 1 "VALID" 0 "INVALID" ;
VAL_ 154 OBJ_Bottom_Out_Of_Image_V_12 1 "VALID" 0 "INVALID" ;
VAL_ 154 OBJ_Lane_Assignment_12 5 "RIGHT_RIGHT" 4 "RIGHT" 3 "HOST" 2 "LEFT" 1 "LEFT_LEFT" 0 "UNKNOWN" ;
VAL_ 154 OBJ_Lane_Assignment_V_12 1 "VALID" 0 "INVALID" ;
VAL_ 154 OBJ_Age_Seconds_V_12 1 "VALID" 0 "INVALID" ;
VAL_ 154 OBJ_Width_V_12 1 "VALID" 0 "INVALID" ;
VAL_ 154 OBJ_Width_STD_V_12 1 "VALID" 0 "INVALID" ;
VAL_ 154 OBJ_Length_V_12 1 "VALID" 0 "INVALID" ;
VAL_ 154 OBJ_Length_STD_V_12 1 "VALID" 0 "INVALID" ;
VAL_ 154 OBJ_Height_V_12 1 "VALID" 0 "INVALID" ;
VAL_ 154 OBJ_Height_STD_V_12 1 "VALID" 0 "INVALID" ;
VAL_ 154 OBJ_Abs_Long_Velocity_V_12 1 "VALID" 0 "INVALID" ;
VAL_ 154 OBJ_Abs_Long_Vel_STD_V_12 1 "VALID" 0 "INVALID" ;
VAL_ 154 OBJ_Abs_Lat_Velocity_V_12 1 "VALID" 0 "INVALID" ;
VAL_ 154 OBJ_Abs_Lat_Vel_STD_V_12 1 "VALID" 0 "INVALID" ;
VAL_ 154 OBJ_Abs_Long_Acc_V_12 1 "VALID" 0 "INVALID" ;
VAL_ 154 OBJ_Abs_Long_Acc_STD_V_12 1 "VALID" 0 "INVALID" ;
VAL_ 154 OBJ_Abs_Lat_Acc_V_12 1 "VALID" 0 "INVALID" ;
VAL_ 154 OBJ_Abs_Lat_Acc_STD_V_12 1 "VALID" 0 "INVALID" ;
VAL_ 154 OBJ_Abs_Acceleration_V_12 1 "VALID" 0 "INVALID" ;
VAL_ 154 OBJ_Abs_Acc_STD_V_12 1 "VALID" 0 "INVALID" ;
VAL_ 154 OBJ_Inv_TTC_V_12 1 "VALID" 0 "INVALID" ;
VAL_ 154 OBJ_Inv_TTC_STD_V_12 1 "VALID" 0 "INVALID" ;
VAL_ 154 OBJ_Relative_Long_Acc_V_12 1 "VALID" 0 "INVALID" ;
VAL_ 154 OBJ_Rel_Long_Acc_STD_V_12 1 "VALID" 0 "INVALID" ;
VAL_ 154 OBJ_Relative_Long_Velocity_V_12 1 "VALID" 0 "INVALID" ;
VAL_ 154 OBJ_Rel_Long_Vel_STD_V_12 1 "VALID" 0 "INVALID" ;
VAL_ 154 OBJ_Relative_Lat_Velocity_V_12 1 "VALID" 0 "INVALID" ;
VAL_ 154 OBJ_Rel_Lat_Vel_STD_V_12 1 "VALID" 0 "INVALID" ;
VAL_ 154 OBJ_Long_Distance_V_12 1 "VALID" 0 "INVALID" ;
VAL_ 154 OBJ_Long_Distance_STD_V_12 1 "VALID" 0 "INVALID" ;
VAL_ 154 OBJ_Lat_Distance_V_12 1 "VALID" 0 "INVALID" ;
VAL_ 154 OBJ_Lat_Distance_STD_V_12 1 "VALID" 0 "INVALID" ;
VAL_ 154 OBJ_Absolute_Speed_V_12 1 "VALID" 0 "INVALID" ;
VAL_ 154 OBJ_Absolute_Speed_STD_V_12 1 "VALID" 0 "INVALID" ;
VAL_ 154 OBJ_Heading_V_12 1 "VALID" 0 "INVALID" ;
VAL_ 154 OBJ_Heading_STD_V_12 1 "VALID" 0 "INVALID" ;
VAL_ 154 OBJ_Angle_Rate_STD_V_12 1 "VALID" 0 "INVALID" ;
VAL_ 154 OBJ_Angle_Rate_V_12 1 "VALID" 0 "INVALID" ;
VAL_ 154 OBJ_Angle_Right_V_12 1 "VALID" 0 "INVALID" ;
VAL_ 154 OBJ_Angle_Right_STD_V_12 1 "VALID" 0 "INVALID" ;
VAL_ 154 OBJ_Angle_Left_V_12 1 "VALID" 0 "INVALID" ;
VAL_ 154 OBJ_Angle_Left_STD_V_12 1 "VALID" 0 "INVALID" ;
VAL_ 154 OBJ_Angle_Side_V_12 1 "VALID" 0 "INVALID" ;
VAL_ 154 OBJ_Angle_Side_STD_V_12 1 "VALID" 0 "INVALID" ;
VAL_ 154 OBJ_Angle_Mid_V_12 1 "VALID" 0 "INVALID" ;
VAL_ 154 OBJ_Angle_Mid_STD_V_12 1 "VALID" 0 "INVALID" ;
VAL_ 154 OBJ_Angle_Bottom_V_12 1 "VALID" 0 "INVALID" ;
VAL_ 154 OBJ_Angle_Bottom_STD_V_12 1 "VALID" 0 "INVALID" ;
VAL_ 154 OBJ_Visibility_Side_V_12 1 "VALID" 0 "INVALID" ;
VAL_ 154 OBJ_Visibility_Side_12 2 "REAR" 1 "FRONT" 0 "NOT_VISIBLE" ;
VAL_ 154 OBJ_Is_In_Drivable_Area_12 1 "TRUE" 0 "FALSE" ;
VAL_ 154 OBJ_Is_In_Drivable_Area_V_12 1 "VALID" 0 "INVALID" ;
VAL_ 154 OBJ_Is_VeryClose_12 1 "TRUE" 0 "FALSE" ;
VAL_ 154 OBJ_Is_VeryClose_V_12 1 "VALID" 0 "INVALID" ;
VAL_ 154 OBJ_Occlusion_RL_12 2 "OCCLUDED" 1 "NOT_OCCLUDED" 0 "NOT_RELEVANT" ;
VAL_ 154 OBJ_Occlusion_RR_12 2 "OCCLUDED" 1 "NOT_OCCLUDED" 0 "NOT_RELEVANT" ;
VAL_ 154 OBJ_Occlusion_FR_12 2 "OCCLUDED" 1 "NOT_OCCLUDED" 0 "NOT_RELEVANT" ;
VAL_ 154 OBJ_Occlusion_FL_12 2 "OCCLUDED" 1 "NOT_OCCLUDED" 0 "NOT_RELEVANT" ;
VAL_ 154 OBJ_Triggered_SDM_13 2 "NOT_TRIGGERED" 1 "TRIGGERED" 0 "NOT_AVAILABLE" ;
VAL_ 154 OBJ_Motion_Category_13 13 "ONCOMING" 12 "PRECEEDING" 11 "MOVING" 10 "RTAP" 9 "LTAP" 8 "CROSSING" 7 "MOVING_OUT" 6 "MOVING_IN" 5 "CLOSE_CUT_IN" 4 "PASSING_OUT" 3 "PASSING_IN" 2 "PASSING" 1 "UNDEFINED" 0 "UNFILLED" ;
VAL_ 154 OBJ_Measuring_Status_13 2 "(BIT_2)NOT_VALID_OR_VALID" 1 "(BIT_1)PREDICTED_OR_MEASURED" 0 "(BIT_0)OLD_OR_NEW" ;
VAL_ 154 OBJ_Object_Class_13 8 "UNCERTAIN_VCL" 7 "ANIMAL" 6 "GENERAL_OBJECT" 5 "PEDESTRIAN" 4 "BICYCLE" 3 "MOTORBIKE" 2 "TRUCK" 1 "CAR" 0 "UNFILLED" ;
VAL_ 154 OBJ_Camera_Source_13 11 "PARKING_RIGHT" 10 "PARKING_LEFT" 9 "PARKING_REAR" 8 "PARKING_FRONT" 7 "FRONT_CORNER_RIGHT" 6 "FRONT_CORNER_LEFT" 5 "REAR_CORNER_RIGHT" 4 "REAR_CORNER_LEFT" 3 "REAR" 2 "FRONT_FISHEYE" 1 "FRONT_NARROW" 0 "FRONT_MAIN" ;
VAL_ 154 OBJ_Motion_Status_13 5 "MOVING_SLOWLY" 4 "STOPPED" 3 "STATIONARY" 2 "MOVING" 1 "UNKNOWN" 0 "INVALID" ;
VAL_ 154 OBJ_Motion_Orientation_13 13 "UNKNOWN" 12 "PRECEEDING" 11 "DRIFTING_LEFT" 9 "CROSSING_LEFT" 7 "OC_DRIFTING_LEFT" 6 "ONCOMING" 5 "OC_DRIFTING_RIGHT" 3 "CROSSING_RIGHT" 1 "DRIFTING_RIGHT" 0 "INVALID" ;
VAL_ 154 OBJ_Has_Cut_Lane_13 1 "TRUE" 0 "FALSE" ;
VAL_ 154 OBJ_Has_Cut_Path_13 1 "TRUE" 0 "FALSE" ;
VAL_ 154 OBJ_Brake_Light_13 1 "TRUE" 0 "FALSE" ;
VAL_ 154 OBJ_Turn_Indicator_Right_13 1 "TRUE" 0 "FALSE" ;
VAL_ 154 OBJ_Turn_Indicator_Left_13 1 "TRUE" 0 "FALSE" ;
VAL_ 154 OBJ_Light_Indicator_Validity_13 1 "TRUE" 0 "FALSE" ;
VAL_ 154 OBJ_Right_Out_Of_Image_13 1 "TRUE" 0 "FALSE" ;
VAL_ 154 OBJ_Left_Out_Of_Image_13 1 "TRUE" 0 "FALSE" ;
VAL_ 154 OBJ_Right_Out_Of_Image_V_13 1 "TRUE" 0 "FALSE" ;
VAL_ 154 OBJ_Left_Out_Of_Image_V_13 1 "TRUE" 0 "FALSE" ;
VAL_ 154 OBJ_Top_Out_Of_Image_13 1 "TRUE" 0 "FALSE" ;
VAL_ 154 OBJ_Bottom_Out_Of_Image_13 1 "TRUE" 0 "FALSE" ;
VAL_ 154 OBJ_Top_Out_Of_Image_V_13 1 "VALID" 0 "INVALID" ;
VAL_ 154 OBJ_Bottom_Out_Of_Image_V_13 1 "VALID" 0 "INVALID" ;
VAL_ 154 OBJ_Lane_Assignment_13 5 "RIGHT_RIGHT" 4 "RIGHT" 3 "HOST" 2 "LEFT" 1 "LEFT_LEFT" 0 "UNKNOWN" ;
VAL_ 154 OBJ_Lane_Assignment_V_13 1 "VALID" 0 "INVALID" ;
VAL_ 154 OBJ_Age_Seconds_V_13 1 "VALID" 0 "INVALID" ;
VAL_ 154 OBJ_Width_V_13 1 "VALID" 0 "INVALID" ;
VAL_ 154 OBJ_Width_STD_V_13 1 "VALID" 0 "INVALID" ;
VAL_ 154 OBJ_Length_V_13 1 "VALID" 0 "INVALID" ;
VAL_ 154 OBJ_Length_STD_V_13 1 "VALID" 0 "INVALID" ;
VAL_ 154 OBJ_Height_V_13 1 "VALID" 0 "INVALID" ;
VAL_ 154 OBJ_Height_STD_V_13 1 "VALID" 0 "INVALID" ;
VAL_ 154 OBJ_Abs_Long_Velocity_V_13 1 "VALID" 0 "INVALID" ;
VAL_ 154 OBJ_Abs_Long_Vel_STD_V_13 1 "VALID" 0 "INVALID" ;
VAL_ 154 OBJ_Abs_Lat_Velocity_V_13 1 "VALID" 0 "INVALID" ;
VAL_ 154 OBJ_Abs_Lat_Vel_STD_V_13 1 "VALID" 0 "INVALID" ;
VAL_ 154 OBJ_Abs_Long_Acc_V_13 1 "VALID" 0 "INVALID" ;
VAL_ 154 OBJ_Abs_Long_Acc_STD_V_13 1 "VALID" 0 "INVALID" ;
